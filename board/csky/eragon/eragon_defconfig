## board/csky/eragon/eragon_defconfig
```kconfig
CONFIG_CROSS_COMPILE="csky-abiv2-linux-"
CONFIG_COMPILE_TEST=y
CONFIG_DEFAULT_HOSTNAME="github.com/c-sky"
# CONFIG_SWAP is not set
CONFIG_SYSVIPC=y
CONFIG_POSIX_MQUEUE=y
# CONFIG_FHANDLE is not set
CONFIG_USELIB=y
CONFIG_AUDIT=y
CONFIG_IRQ_DOMAIN_DEBUG=y
CONFIG_NO_HZ_IDLE=y
CONFIG_HIGH_RES_TIMERS=y
CONFIG_BSD_PROCESS_ACCT=y
CONFIG_BSD_PROCESS_ACCT_V3=y
CONFIG_RELAY=y
CONFIG_BLK_DEV_INITRD=y
CONFIG_INITRAMFS_SOURCE="${BR_BINARIES_DIR}/rootfs.cpio"
CONFIG_SYSCTL_SYSCALL=y
CONFIG_KALLSYMS_ALL=y
# CONFIG_AIO is not set
CONFIG_USERFAULTFD=y
CONFIG_EMBEDDED=y
# CONFIG_PERF_EVENTS is not set
# CONFIG_SLUB_DEBUG is not set
# CONFIG_COMPAT_BRK is not set
CONFIG_PROFILING=y
CONFIG_OPROFILE=y
CONFIG_MODULES=y
CONFIG_MODULE_UNLOAD=y
CONFIG_BLK_DEV_BSGLIB=y
CONFIG_BLK_DEV_INTEGRITY=y
CONFIG_PARTITION_ADVANCED=y
CONFIG_ACORN_PARTITION=y
CONFIG_ACORN_PARTITION_ICS=y
CONFIG_ACORN_PARTITION_RISCIX=y
CONFIG_AIX_PARTITION=y
CONFIG_OSF_PARTITION=y
CONFIG_AMIGA_PARTITION=y
CONFIG_ATARI_PARTITION=y
CONFIG_MAC_PARTITION=y
CONFIG_BSD_DISKLABEL=y
CONFIG_MINIX_SUBPARTITION=y
CONFIG_SOLARIS_X86_PARTITION=y
CONFIG_UNIXWARE_DISKLABEL=y
CONFIG_LDM_PARTITION=y
CONFIG_SGI_PARTITION=y
CONFIG_ULTRIX_PARTITION=y
CONFIG_SUN_PARTITION=y
CONFIG_KARMA_PARTITION=y
CONFIG_SYSV68_PARTITION=y
CONFIG_CMDLINE_PARTITION=y
CONFIG_DEFAULT_DEADLINE=y
CONFIG_DEBUG_PINCTRL=y
CONFIG_PINCTRL_ERAGON=y
CONFIG_CSKY_DEBUG_INFO=y
CONFIG_CPU_CK807=y
CONFIG_RAM_BASE=0x0
# CONFIG_NATIONALCHIP_IRQ is not set
# CONFIG_NATIONALCHIP_TIMER is not set
# CONFIG_SUSPEND is not set
# CONFIG_COMPACTION is not set
CONFIG_NET=y
CONFIG_PACKET=y
CONFIG_UNIX=y
CONFIG_INET=y
CONFIG_IP_MULTICAST=y
CONFIG_IP_PNP=y
CONFIG_IP_PNP_DHCP=y
CONFIG_IP_PNP_BOOTP=y
CONFIG_IP_PNP_RARP=y
# CONFIG_IPV6 is not set
# CONFIG_WIRELESS is not set
CONFIG_DEVTMPFS=y
CONFIG_DEVTMPFS_MOUNT=y
# CONFIG_STANDALONE is not set
CONFIG_BLK_DEV_LOOP=y
CONFIG_BLK_DEV_RAM=y
CONFIG_BLK_DEV_RAM_SIZE=65536
CONFIG_VIRTIO_BLK=y
CONFIG_SRAM=y
CONFIG_SCSI=y
# CONFIG_SCSI_PROC_FS is not set
CONFIG_BLK_DEV_SD=y
CONFIG_SCSI_SPI_ATTRS=y
# CONFIG_SCSI_LOWLEVEL is not set
CONFIG_NETDEVICES=y
# CONFIG_NET_VENDOR_ARC is not set
# CONFIG_NET_CADENCE is not set
# CONFIG_NET_VENDOR_BROADCOM is not set
# CONFIG_NET_VENDOR_EZCHIP is not set
# CONFIG_NET_VENDOR_INTEL is not set
# CONFIG_NET_VENDOR_MARVELL is not set
# CONFIG_NET_VENDOR_MICREL is not set
# CONFIG_NET_VENDOR_NATSEMI is not set
# CONFIG_NET_VENDOR_NETRONOME is not set
# CONFIG_NET_VENDOR_QUALCOMM is not set
# CONFIG_NET_VENDOR_RENESAS is not set
# CONFIG_NET_VENDOR_ROCKER is not set
# CONFIG_NET_VENDOR_SAMSUNG is not set
# CONFIG_NET_VENDOR_SEEQ is not set
CONFIG_STMMAC_ETH=y
# CONFIG_NET_VENDOR_SYNOPSYS is not set
# CONFIG_NET_VENDOR_VIA is not set
# CONFIG_NET_VENDOR_WIZNET is not set
# CONFIG_USB_NET_DRIVERS is not set
# CONFIG_WLAN is not set
CONFIG_INPUT_EVDEV=y
# CONFIG_MOUSE_PS2 is not set
# CONFIG_SERIO_SERPORT is not set
CONFIG_VT_HW_CONSOLE_BINDING=y
CONFIG_LEGACY_PTY_COUNT=4
CONFIG_SERIAL_NONSTANDARD=y
# CONFIG_DEVKMEM is not set
CONFIG_SERIAL_8250=y
# CONFIG_SERIAL_8250_DEPRECATED_OPTIONS is not set
CONFIG_SERIAL_8250_CONSOLE=y
CONFIG_SERIAL_8250_NR_UARTS=5
CONFIG_SERIAL_8250_RUNTIME_UARTS=5
CONFIG_SERIAL_8250_DW=y
CONFIG_TTY_PRINTK=y
CONFIG_VIRTIO_CONSOLE=y
CONFIG_IPMI_HANDLER=y
CONFIG_HW_RANDOM=y
# CONFIG_HW_RANDOM_TPM is not set
CONFIG_I2C_CHARDEV=y
# CONFIG_I2C_BRCMSTB is not set
CONFIG_I2C_DESIGNWARE_PLATFORM=y
CONFIG_DEBUG_GPIO=y
CONFIG_GPIO_SYSFS=y
CONFIG_POWER_RESET=y
CONFIG_POWER_SUPPLY=y
# CONFIG_HWMON is not set
CONFIG_MEDIA_SUPPORT=y
CONFIG_MEDIA_CAMERA_SUPPORT=y
CONFIG_MEDIA_USB_SUPPORT=y
CONFIG_USB_VIDEO_CLASS=y
# CONFIG_USB_GSPCA is not set
CONFIG_BACKLIGHT_LCD_SUPPORT=y
# CONFIG_LCD_CLASS_DEVICE is not set
CONFIG_BACKLIGHT_CLASS_DEVICE=y
# CONFIG_BACKLIGHT_GENERIC is not set
# CONFIG_VGA_CONSOLE is not set
CONFIG_HID_PID=y
CONFIG_USB_HIDDEV=y
CONFIG_USB=y
CONFIG_USB_EHCI_HCD=y
CONFIG_USB_EHCI_HCD_PLATFORM=y
CONFIG_USB_OHCI_HCD=y
CONFIG_USB_STORAGE=y
CONFIG_USB_DWC2=y
CONFIG_USB_DWC2_DEBUG=y
CONFIG_USB_DWC2_VERBOSE=y
CONFIG_MMC=y
CONFIG_MMC_DEBUG=y
CONFIG_MMC_DW=y
CONFIG_NEW_LEDS=y
CONFIG_LEDS_CLASS=y
CONFIG_LEDS_GPIO=y
CONFIG_LEDS_TRIGGERS=y
CONFIG_LEDS_TRIGGER_CPU=y
CONFIG_RTC_CLASS=y
CONFIG_RTC_DRV_PCF8563=y
# CONFIG_RTC_DRV_SPEAR is not set
CONFIG_RTC_DRV_XGENE=y
CONFIG_VIRTIO_BALLOON=y
CONFIG_VIRTIO_MMIO=y
CONFIG_VIRTIO_MMIO_CMDLINE_DEVICES=y
# CONFIG_IOMMU_SUPPORT is not set
CONFIG_PM_DEVFREQ=y
CONFIG_DEVFREQ_GOV_SIMPLE_ONDEMAND=y
CONFIG_DEVFREQ_GOV_PERFORMANCE=y
CONFIG_DEVFREQ_GOV_POWERSAVE=y
CONFIG_DEVFREQ_GOV_USERSPACE=y
CONFIG_EXT2_FS=y
CONFIG_EXT2_FS_XATTR=y
CONFIG_EXT2_FS_POSIX_ACL=y
CONFIG_EXT2_FS_SECURITY=y
CONFIG_EXT3_FS=y
CONFIG_EXT3_FS_POSIX_ACL=y
CONFIG_EXT3_FS_SECURITY=y
CONFIG_FANOTIFY=y
CONFIG_FANOTIFY_ACCESS_PERMISSIONS=y
CONFIG_QUOTA=y
# CONFIG_PRINT_QUOTA_WARNING is not set
CONFIG_FSCACHE=m
CONFIG_FSCACHE_STATS=y
CONFIG_CACHEFILES=m
CONFIG_MSDOS_FS=y
CONFIG_VFAT_FS=y
CONFIG_FAT_DEFAULT_UTF8=y
CONFIG_NTFS_FS=y
CONFIG_PROC_KCORE=y
CONFIG_PROC_CHILDREN=y
CONFIG_TMPFS=y
CONFIG_TMPFS_POSIX_ACL=y
CONFIG_CONFIGFS_FS=y
CONFIG_CRAMFS=y
CONFIG_ROMFS_FS=y
CONFIG_NFS_FS=y
CONFIG_ROOT_NFS=y
CONFIG_NLS_DEFAULT="utf8"
CONFIG_NLS_CODEPAGE_437=y
CONFIG_NLS_CODEPAGE_737=y
CONFIG_NLS_CODEPAGE_775=y
CONFIG_NLS_CODEPAGE_850=y
CONFIG_NLS_CODEPAGE_852=y
CONFIG_NLS_CODEPAGE_855=y
CONFIG_NLS_CODEPAGE_857=y
CONFIG_NLS_CODEPAGE_860=y
CONFIG_NLS_CODEPAGE_861=y
CONFIG_NLS_CODEPAGE_863=y
CONFIG_NLS_CODEPAGE_864=y
CONFIG_NLS_CODEPAGE_865=y
CONFIG_NLS_CODEPAGE_866=y
CONFIG_NLS_CODEPAGE_869=y
CONFIG_NLS_CODEPAGE_936=y
CONFIG_NLS_CODEPAGE_950=y
CONFIG_NLS_CODEPAGE_932=y
CONFIG_NLS_CODEPAGE_1250=y
CONFIG_NLS_CODEPAGE_1251=y
CONFIG_NLS_ISO8859_1=y
CONFIG_NLS_UTF8=y
CONFIG_PRINTK_TIME=y
# CONFIG_ENABLE_WARN_DEPRECATED is not set
# CONFIG_ENABLE_MUST_CHECK is not set
CONFIG_UNUSED_SYMBOLS=y
CONFIG_DEBUG_FS=y
CONFIG_MAGIC_SYSRQ=y
CONFIG_LOCKUP_DETECTOR=y
# CONFIG_SCHED_DEBUG is not set
CONFIG_RBTREE_TEST=m
CONFIG_INTERVAL_TREE_TEST=m
CONFIG_PERCPU_TEST=m
CONFIG_TEST_STRING_HELPERS=m
CONFIG_TEST_KSTRTOX=m
CONFIG_PERSISTENT_KEYRINGS=y
CONFIG_TRUSTED_KEYS=y
CONFIG_SECURITY=y
CONFIG_SECURITY_NETWORK=y
CONFIG_SECURITY_PATH=y
CONFIG_SECURITY_YAMA=y
CONFIG_INTEGRITY_SIGNATURE=y
CONFIG_INTEGRITY_ASYMMETRIC_KEYS=y
CONFIG_IMA=y
CONFIG_IMA_APPRAISE=y
CONFIG_EVM=y
# CONFIG_CRYPTO_ECHAINIV is not set
CONFIG_CRYPTO_ECB=y
CONFIG_CRYPTO_SHA512=y
CONFIG_CRYPTO_LZO=y
CONFIG_DDR=y
```

## configs/csky_610_gx6622_4.14_uclibc_br_defconfig
```kconfig
# Architecture
BR2_csky=y

# Kernel headers
BR2_PACKAGE_HOST_LINUX_HEADERS_CUSTOM_4_14=y

# Kernel configuration
BR2_LINUX_KERNEL=y
BR2_LINUX_KERNEL_VMLINUX=y
BR2_LINUX_KERNEL_CUSTOM_VERSION=y
BR2_LINUX_KERNEL_CUSTOM_VERSION_VALUE="4.14.66"
BR2_LINUX_KERNEL_DEFCONFIG="gx66xx"
BR2_LINUX_KERNEL_DTS_SUPPORT=y
BR2_LINUX_KERNEL_USE_CUSTOM_DTS=y
BR2_LINUX_KERNEL_CUSTOM_DTS_PATH="board/nationalchip/gx66xx/gx6622_ci.dts"

# Kernel addons & extentions
BR2_LINUX_KERNEL_EXT_CSKY_ARCH=y

# Kernel patches
BR2_GLOBAL_PATCH_DIR="board/nationalchip/gx66xx/patches"

# System configuration
BR2_OPTIMIZE_2=y

# Rootfs
BR2_SHARED_STATIC_LIBS=y
BR2_TARGET_GENERIC_GETTY_PORT="ttyS0"
BR2_ROOTFS_OVERLAY="board/nationalchip/gx66xx/fs-overlay/"
BR2_ROOTFS_POST_IMAGE_SCRIPT="board/nationalchip/gx66xx/post-image-ci.sh"
BR2_ROOTFS_DEVICE_CREATION_DYNAMIC_MDEV=y

# Toolchain & C library
BR2_TOOLCHAIN_BUILDROOT=y
BR2_TOOLCHAIN_BUILDROOT_UCLIBC=y
BR2_TOOLCHAIN_BUILDROOT_CXX=y
BR2_TOOLCHAIN_BUILDROOT_WCHAR=y
BR2_PTHREAD_DEBUG=y

# Packages on host
BR2_PACKAGE_HOST_CSKY_DEBUG=y
BR2_PACKAGE_HOST_GDB=y

# Packages on board
BR2_PACKAGE_GDB=y
BR2_PACKAGE_GDB_SERVER=y

# Gitlab-CI
BR2_PACKAGE_CSKY_CI=y

# CI Testcases
BR2_PACKAGE_LTP_CI=y
BR2_PACKAGE_LMBENCH_CI=y
#BR2_PACKAGE_DHRYSTONE_CI=y
#BR2_PACKAGE_WHETSTONE_CI=y
#BR2_PACKAGE_GREENLET_CI=y Can't compile python in uclibc
BR2_PACKAGE_UCLIBC_CI=y
```

## configs/csky_610_gx6622_4.19_glibc_br_defconfig
```kconfig
# Architecture
BR2_csky=y

# Kernel headers
BR2_PACKAGE_HOST_LINUX_HEADERS_CUSTOM_4_19=y

# Kernel configuration
BR2_LINUX_KERNEL=y
BR2_LINUX_KERNEL_VMLINUX=y
BR2_LINUX_KERNEL_CUSTOM_VERSION=y
BR2_LINUX_KERNEL_CUSTOM_VERSION_VALUE="4.19.10"
BR2_LINUX_KERNEL_USE_CUSTOM_CONFIG=y
BR2_LINUX_KERNEL_CUSTOM_CONFIG_FILE="board/nationalchip/gx66xx/gx66xx.config"
BR2_LINUX_KERNEL_DTS_SUPPORT=y
BR2_LINUX_KERNEL_USE_CUSTOM_DTS=y
BR2_LINUX_KERNEL_CUSTOM_DTS_PATH="board/nationalchip/gx66xx/gx6622_ci.dts"

# Kernel addons & extentions
BR2_LINUX_KERNEL_EXT_CSKY_ARCH=y

# Kernel patches
BR2_GLOBAL_PATCH_DIR="board/nationalchip/gx66xx/patches"

# System configuration
BR2_OPTIMIZE_2=y

# Rootfs
BR2_SHARED_STATIC_LIBS=y
BR2_TARGET_GENERIC_GETTY_PORT="ttyS0"
BR2_ROOTFS_OVERLAY="board/nationalchip/gx66xx/fs-overlay/"
BR2_ROOTFS_POST_IMAGE_SCRIPT="board/nationalchip/gx66xx/post-image-ci.sh"
BR2_ROOTFS_DEVICE_CREATION_DYNAMIC_MDEV=y

# Toolchain & C library
BR2_TOOLCHAIN_BUILDROOT=y
BR2_TOOLCHAIN_BUILDROOT_GLIBC=y
BR2_TOOLCHAIN_BUILDROOT_CXX=y

# Packages on host
BR2_PACKAGE_HOST_CSKY_DEBUG=y
BR2_PACKAGE_HOST_GDB=y

# Packages on board
BR2_PACKAGE_GDB=y
BR2_PACKAGE_GDB_SERVER=y

# Gitlab-CI
BR2_PACKAGE_CSKY_CI=y

# CI Testcases
#BR2_PACKAGE_LTP_CI=y
#BR2_PACKAGE_LMBENCH_CI=y
#BR2_PACKAGE_DHRYSTONE_CI=y
#BR2_PACKAGE_WHETSTONE_CI=y
#BR2_PACKAGE_GREENLET_CI=y

# Python for glibc
BR2_PACKAGE_PYTHON=y
BR2_PACKAGE_PYTHON_GPIO=y
```

## configs/csky_807_eragon_4.9_glibc_br_defconfig
```kconfig
# Architecture
BR2_csky=y
BR2_ck807=y

# Kernel headers
BR2_PACKAGE_HOST_LINUX_HEADERS_CUSTOM_4_9=y

# Kernel configuration
BR2_LINUX_KERNEL=y
BR2_LINUX_KERNEL_VMLINUX=y
BR2_LINUX_KERNEL_CUSTOM_VERSION=y
BR2_LINUX_KERNEL_CUSTOM_VERSION_VALUE="4.9.56"
BR2_LINUX_KERNEL_USE_CUSTOM_CONFIG=y
BR2_LINUX_KERNEL_CUSTOM_CONFIG_FILE="board/csky/eragon_evb/linux_ci_nodriver_nofpu.config"
BR2_LINUX_KERNEL_DTS_SUPPORT=y
BR2_LINUX_KERNEL_USE_CUSTOM_DTS=y
BR2_LINUX_KERNEL_CUSTOM_DTS_PATH="board/csky/eragon_evb/eragon_evb_ci.dts board/csky/eragon_evb/*.dtsi"

# Kernel addons & extentions
BR2_LINUX_KERNEL_EXT_CSKY_ARCH=y
BR2_LINUX_KERNEL_EXT_CSKY_ADDONS=y
BR2_LINUX_KERNEL_EXT_CSKY_ADDONS_GIT=y
BR2_LINUX_KERNEL_EXT_CSKY_ADDONS_VERSION="b0355ffbd5689883966cd8bd4b5acc8c355167da"
BR2_LINUX_KERNEL_EXT_CSKY_ADDONS_GIT_URL="https://github.com/c-sky/linux-csky-addons.git"

# Kernel patches
BR2_GLOBAL_PATCH_DIR="board/csky/common/linux-$(BR2_LINUX_KERNEL_CUSTOM_VERSION_VALUE)-patches"

# System configuration
BR2_OPTIMIZE_2=y

# Rootfs
BR2_TARGET_ROOTFS_INITRAMFS=y
BR2_ROOTFS_OVERLAY="board/csky/eragon_evb/fs-overlay"
BR2_ROOTFS_POST_IMAGE_SCRIPT="board/csky/eragon_evb/post-image-ci.sh"
BR2_ROOTFS_DEVICE_CREATION_DYNAMIC_MDEV=y

# Toolchain & C library
BR2_TOOLCHAIN_BUILDROOT=y
BR2_TOOLCHAIN_BUILDROOT_GLIBC=y
BR2_TOOLCHAIN_BUILDROOT_CXX=y

# Packages on host
BR2_PACKAGE_HOST_CSKY_DEBUG=y
BR2_PACKAGE_HOST_GDB=y

# Packages on board
BR2_PACKAGE_GDB=y
BR2_PACKAGE_GDB_SERVER=y

# Gitlab-CI
BR2_PACKAGE_CSKY_CI=y

# Testcases
BR2_PACKAGE_DHRYSTONE=y
BR2_PACKAGE_LMBENCH=y
BR2_PACKAGE_LTP_TESTSUITE_ARCH_SUPPORTS=y
BR2_PACKAGE_LTP_TESTSUITE=y
BR2_PACKAGE_WHETSTONE=y

# Others
BR2_PACKAGE_OVERRIDE_FILE="board/csky/eragon_evb/local.mk"
BR2_PACKAGE_BUSYBOX_CONFIG="board/csky/eragon/busybox.config"
```

## configs/csky_807_eragon_4.9_uclibc_br_defconfig
```kconfig
BR2_csky=y
BR2_ck807=y
BR2_OPTIMIZE_2=y
BR2_PACKAGE_OVERRIDE_FILE="board/csky/eragon_evb/local.mk"
BR2_GLOBAL_PATCH_DIR="board/csky/common/linux-$(BR2_LINUX_KERNEL_CUSTOM_VERSION_VALUE)-patches"
BR2_ROOTFS_OVERLAY="board/csky/eragon_evb/fs-overlay"
BR2_ROOTFS_POST_IMAGE_SCRIPT="board/csky/eragon_evb/post-image-ci.sh"
BR2_LINUX_KERNEL=y
BR2_LINUX_KERNEL_CUSTOM_VERSION=y
BR2_LINUX_KERNEL_CUSTOM_VERSION_VALUE="4.9.56"
BR2_LINUX_KERNEL_USE_CUSTOM_CONFIG=y
BR2_LINUX_KERNEL_CUSTOM_CONFIG_FILE="board/csky/eragon_evb/linux_ci_nodriver_nofpu.config"
BR2_LINUX_KERNEL_DTS_SUPPORT=y
BR2_LINUX_KERNEL_USE_CUSTOM_DTS=y
BR2_LINUX_KERNEL_CUSTOM_DTS_PATH="board/csky/eragon_evb/eragon_evb_ci.dts board/csky/eragon_evb/*.dtsi"
BR2_LINUX_KERNEL_EXT_CSKY_ARCH=y
BR2_LINUX_KERNEL_EXT_CSKY_ADDONS=y
BR2_LINUX_KERNEL_EXT_CSKY_ADDONS_GIT=y
BR2_LINUX_KERNEL_EXT_CSKY_ADDONS_VERSION="b0355ffbd5689883966cd8bd4b5acc8c355167da"
BR2_LINUX_KERNEL_EXT_CSKY_ADDONS_GIT_URL="https://github.com/c-sky/linux-csky-addons.git"
BR2_LINUX_KERNEL_VMLINUX=y
BR2_TARGET_ROOTFS_INITRAMFS=y
BR2_PACKAGE_BUSYBOX_CONFIG="board/csky/eragon/busybox.config"
BR2_PACKAGE_HOST_CSKY_DEBUG=y
BR2_PACKAGE_HOST_LINUX_HEADERS_CUSTOM_4_9=y
BR2_TOOLCHAIN_BUILDROOT=y
BR2_TOOLCHAIN_BUILDROOT_UCLIBC=y
BR2_TOOLCHAIN_BUILDROOT_LIBC="uclibc"
BR2_TOOLCHAIN_BUILDROOT_CXX=y
BR2_GCC_ENABLE_LTO=y
BR2_GCC_ENABLE_OPENMP=y
BR2_ROOTFS_DEVICE_CREATION_DYNAMIC_MDEV=y
BR2_PACKAGE_HOST_GDB=y
BR2_PACKAGE_CSKY_CI=y
BR2_PACKAGE_DHRYSTONE=y
BR2_PACKAGE_LMBENCH=y
BR2_PACKAGE_LTP_TESTSUITE_ARCH_SUPPORTS=y
BR2_PACKAGE_LTP_TESTSUITE=y
BR2_PACKAGE_WHETSTONE=y
```

## configs/csky_807f_qemu_4.14_uclibc_br_defconfig
```kconfig
# Architecture
BR2_csky=y
BR2_ck807=y
BR2_CSKY_FPU=y

# Kernel headers
BR2_PACKAGE_HOST_LINUX_HEADERS_CUSTOM_4_9=y

# Kernel configuration
BR2_LINUX_KERNEL=y
BR2_LINUX_KERNEL_VMLINUX=y
BR2_LINUX_KERNEL_CUSTOM_VERSION=y
BR2_LINUX_KERNEL_CUSTOM_VERSION_VALUE="4.14.66"
BR2_LINUX_KERNEL_USE_CUSTOM_CONFIG=y
BR2_LINUX_KERNEL_CUSTOM_CONFIG_FILE="board/qemu/csky/qemu_ck807_defconfig"
BR2_LINUX_KERNEL_DTS_SUPPORT=y
BR2_LINUX_KERNEL_USE_CUSTOM_DTS=y
BR2_LINUX_KERNEL_CUSTOM_DTS_PATH="board/qemu/csky/qemu.dts"

# Kernel addons & extentions
BR2_LINUX_KERNEL_EXT_CSKY_ARCH=y

# Kernel patches
# None

# System configuration
BR2_OPTIMIZE_2=y

# Rootfs
BR2_TARGET_ROOTFS_INITRAMFS=y
BR2_SHARED_STATIC_LIBS=y
BR2_ROOTFS_DEVICE_TABLE="board/qemu/csky/device_table.txt"
BR2_ROOTFS_OVERLAY="board/qemu/csky/fs-overlay/"
BR2_ROOTFS_DEVICE_CREATION_DYNAMIC_MDEV=y

# Toolchain & C library
BR2_TOOLCHAIN_BUILDROOT=y
BR2_TOOLCHAIN_BUILDROOT_UCLIBC=y
BR2_TOOLCHAIN_BUILDROOT_CXX=y
BR2_TOOLCHAIN_BUILDROOT_WCHAR=y
BR2_PTHREAD_DEBUG=y

# Packages on host
BR2_PACKAGE_HOST_CSKY_QEMU=y
BR2_PACKAGE_HOST_GDB=y

# Packages on board
BR2_PACKAGE_GDB=y
BR2_PACKAGE_GDB_SERVER=y

# Gitlab-CI
BR2_PACKAGE_CSKY_CI=y

# CI Testcases
BR2_PACKAGE_LTP_CI=y
BR2_PACKAGE_LMBENCH_CI=y
#BR2_PACKAGE_DHRYSTONE_CI=y
BR2_PACKAGE_WHETSTONE_CI=y
#BR2_PACKAGE_GREENLET_CI=y Can't compile python in uclibc
BR2_PACKAGE_UCLIBC_CI=y

# Others
BR2_PACKAGE_BUSYBOX_SHOW_OTHERS=y
BR2_PACKAGE_BASH=y
```

## configs/csky_810f_dh7200_4.9_glibc_br_defconfig
```kconfig
# Architecture
BR2_csky=y
BR2_ck810=y
BR2_CSKY_FPU=y

# Kernel headers
BR2_PACKAGE_HOST_LINUX_HEADERS_CUSTOM_4_9=y

# Kernel configuration
BR2_LINUX_KERNEL=y
BR2_LINUX_KERNEL_VMLINUX=y
BR2_LINUX_KERNEL_CUSTOM_VERSION=y
BR2_LINUX_KERNEL_CUSTOM_VERSION_VALUE="4.9.56"
BR2_LINUX_KERNEL_USE_CUSTOM_CONFIG=y
BR2_LINUX_KERNEL_CUSTOM_CONFIG_FILE="board/dahua/dh7200/dh7200_defconfig"
BR2_LINUX_KERNEL_DTS_SUPPORT=y
BR2_LINUX_KERNEL_USE_CUSTOM_DTS=y
BR2_LINUX_KERNEL_CUSTOM_DTS_PATH="board/dahua/dh7200/dh7200_ci.dts"

# Kernel addons & extentions
BR2_LINUX_KERNEL_EXT_CSKY_ARCH=y

# Kernel patches
# None

# System configuration
BR2_OPTIMIZE_2=y

# Rootfs
BR2_TARGET_ROOTFS_INITRAMFS=y
BR2_SHARED_STATIC_LIBS=y
BR2_TARGET_GENERIC_GETTY_PORT="ttyS0"
BR2_ROOTFS_POST_IMAGE_SCRIPT="board/dahua/dh7200/post-image-ci.sh"
BR2_ROOTFS_DEVICE_CREATION_DYNAMIC_MDEV=y

# Toolchain & C library
BR2_TOOLCHAIN_BUILDROOT=y
BR2_TOOLCHAIN_BUILDROOT_GLIBC=y
BR2_TOOLCHAIN_BUILDROOT_CXX=y

# Packages on host
BR2_PACKAGE_HOST_CSKY_DEBUG=y
BR2_PACKAGE_HOST_GDB=y

# Packages on board
BR2_PACKAGE_GDB=y
BR2_PACKAGE_GDB_SERVER=y

# Gitlab-CI
BR2_PACKAGE_CSKY_CI=y

# CI Testcases
BR2_PACKAGE_LTP_CI=y
BR2_PACKAGE_LMBENCH_CI=y
#BR2_PACKAGE_DHRYSTONE_CI=y
BR2_PACKAGE_WHETSTONE_CI=y
BR2_PACKAGE_GREENLET_CI=y
```
