## configs/csky_810f_dh7200_4.9_uclibc_br_defconfig
```kconfig
BR2_csky=y
BR2_ck810=y
BR2_CSKY_FPU=y
BR2_OPTIMIZE_2=y
BR2_SHARED_STATIC_LIBS=y
BR2_TARGET_GENERIC_GETTY_PORT="ttyS0"
BR2_ROOTFS_POST_IMAGE_SCRIPT="board/dahua/dh7200/post-image-ci.sh"
BR2_LINUX_KERNEL=y
BR2_LINUX_KERNEL_CUSTOM_VERSION=y
BR2_LINUX_KERNEL_CUSTOM_VERSION_VALUE="4.9.56"
BR2_LINUX_KERNEL_VMLINUX=y
BR2_LINUX_KERNEL_USE_CUSTOM_CONFIG=y
BR2_LINUX_KERNEL_CUSTOM_CONFIG_FILE="board/dahua/dh7200/dh7200_defconfig"
BR2_LINUX_KERNEL_DTS_SUPPORT=y
BR2_LINUX_KERNEL_USE_CUSTOM_DTS=y
BR2_LINUX_KERNEL_CUSTOM_DTS_PATH="board/dahua/dh7200/dh7200_ci.dts"
BR2_LINUX_KERNEL_EXT_CSKY_ARCH=y
BR2_TARGET_ROOTFS_INITRAMFS=y
BR2_PACKAGE_HOST_CSKY_DEBUG=y
BR2_PACKAGE_HOST_LINUX_HEADERS_CUSTOM_4_9=y
BR2_TOOLCHAIN_BUILDROOT=y
BR2_TOOLCHAIN_BUILDROOT_UCLIBC=y
BR2_TOOLCHAIN_BUILDROOT_LIBC="uclibc"
BR2_TOOLCHAIN_BUILDROOT_CXX=y
BR2_ROOTFS_DEVICE_CREATION_DYNAMIC_MDEV=y
BR2_PACKAGE_HOST_GDB=y
BR2_PACKAGE_CSKY_CI=y
BR2_PACKAGE_DHRYSTONE=y
BR2_PACKAGE_LMBENCH=y
BR2_PACKAGE_LTP_TESTSUITE_ARCH_SUPPORTS=y
BR2_PACKAGE_LTP_TESTSUITE=y
BR2_PACKAGE_WHETSTONE=y
```

## configs/csky_810f_qemu_4.20_glibc_br_defconfig
```kconfig
# Architecture
BR2_csky=y
BR2_ck810=y
BR2_CSKY_FPU=y
BR2_CSKY_UPSTREAM=y

# Kernel headers
BR2_PACKAGE_HOST_LINUX_HEADERS_CUSTOM_4_9=y

# Kernel configuration
BR2_LINUX_KERNEL=y
BR2_LINUX_KERNEL_VMLINUX=y
BR2_LINUX_KERNEL_CUSTOM_TARBALL=y
BR2_LINUX_KERNEL_CUSTOM_TARBALL_LOCATION="https://github.com/c-sky/csky-linux/archive/b8f80b1d20720f959d4fbfb442b04932587a9bb2.tar.gz"
BR2_LINUX_KERNEL_USE_CUSTOM_CONFIG=y
BR2_LINUX_KERNEL_CUSTOM_CONFIG_FILE="board/qemu/csky/qemu_ck810_ups_defconfig"
BR2_LINUX_KERNEL_DTS_SUPPORT=y
BR2_LINUX_KERNEL_USE_CUSTOM_DTS=y
BR2_LINUX_KERNEL_CUSTOM_DTS_PATH="board/qemu/csky/qemu.dts"

# Kernel addons & extentions

# Kernel patches
# None

# System configuration
BR2_OPTIMIZE_2=y

# Rootfs
BR2_TARGET_ROOTFS_INITRAMFS=y
BR2_SHARED_STATIC_LIBS=y
BR2_ROOTFS_DEVICE_TABLE="board/qemu/csky/device_table.txt"
BR2_ROOTFS_OVERLAY="board/qemu/csky/fs-overlay/"
BR2_ROOTFS_DEVICE_CREATION_DYNAMIC_MDEV=y

# Toolchain & C library
BR2_TOOLCHAIN_BUILDROOT=y
BR2_TOOLCHAIN_BUILDROOT_GLIBC=y
BR2_TOOLCHAIN_BUILDROOT_CXX=y

# Packages on host
BR2_PACKAGE_HOST_CSKY_QEMU=y
BR2_PACKAGE_HOST_GDB=y

# Packages on board

# Gitlab-CI
BR2_PACKAGE_CSKY_CI=y

# CI Testcases
#BR2_PACKAGE_LMBENCH_CI=y
#BR2_PACKAGE_DHRYSTONE_CI=y
#BR2_PACKAGE_WHETSTONE_CI=y
#BR2_PACKAGE_GREENLET_CI=y

# Others
BR2_PACKAGE_BUSYBOX_SHOW_OTHERS=y
BR2_PACKAGE_BASH=y
```

## configs/csky_860_fpga_4.14_uclibc_br_defconfig
```kconfig
# Architecture
BR2_csky=y
BR2_ck860=y
BR2_CSKY_FPGA=y
BR2_CSKY_FPGA_BITFILE="CK860MP_181127_MFV.bit"
BR2_CSKY_FPGA_DDRINIT="ddr_init_eragon3_sec_bypass_interrupt_non_secure_0305.elf"

# Kernel headers
BR2_PACKAGE_HOST_LINUX_HEADERS_CUSTOM_4_9=y

# Kernel configuration
BR2_LINUX_KERNEL=y
BR2_LINUX_KERNEL_VMLINUX=y
BR2_LINUX_KERNEL_CUSTOM_VERSION=y
BR2_LINUX_KERNEL_CUSTOM_VERSION_VALUE="4.14.66"
BR2_LINUX_KERNEL_USE_CUSTOM_CONFIG=y
BR2_LINUX_KERNEL_CUSTOM_CONFIG_FILE="board/csky/ck860_platform/linux_lite.config"
BR2_LINUX_KERNEL_DTS_SUPPORT=y
BR2_LINUX_KERNEL_USE_CUSTOM_DTS=y
BR2_LINUX_KERNEL_CUSTOM_DTS_PATH="board/csky/ck860_platform/ck860_platform_lite.dts"

# Kernel addons & extentions
BR2_LINUX_KERNEL_EXT_CSKY_ARCH=y

# Kernel patches
# None

# System configuration
BR2_OPTIMIZE_2=y

# Rootfs
BR2_TARGET_ROOTFS_INITRAMFS=y
BR2_ROOTFS_POST_IMAGE_SCRIPT="board/csky/ck860_platform/post-image.sh"
BR2_ROOTFS_DEVICE_CREATION_DYNAMIC_MDEV=y

# Toolchain & C library
BR2_TOOLCHAIN_BUILDROOT_UCLIBC=y
BR2_TOOLCHAIN_BUILDROOT_CXX=y
BR2_GCC_ENABLE_LTO=y

# Packages on host
BR2_PACKAGE_HOST_CSKY_DEBUG=y
BR2_PACKAGE_HOST_GDB=y

# Packages on board
# Gitlab-CI
BR2_PACKAGE_CSKY_CI=y

# Testcases
#BR2_PACKAGE_LMBENCH=y
#BR2_PACKAGE_LTP_TESTSUITE=y

# Others
BR2_PACKAGE_BUSYBOX_CONFIG="board/csky/ck860_platform/busybox.config"
BR2_PACKAGE_OVERRIDE_FILE="board/csky/ck860_platform/local.mk"
```

## configs/csky_860_qemu_4.9_glibc_br_defconfig
```kconfig
# Architecture
BR2_csky=y
BR2_ck860=y
BR2_CSKY_QEMU=y

# Kernel headers
BR2_PACKAGE_HOST_LINUX_HEADERS_CUSTOM_4_9=y

# Kernel configuration
BR2_LINUX_KERNEL=y
BR2_LINUX_KERNEL_VMLINUX=y
BR2_LINUX_KERNEL_CUSTOM_VERSION=y
BR2_LINUX_KERNEL_CUSTOM_VERSION_VALUE="4.9.56"
BR2_LINUX_KERNEL_USE_CUSTOM_CONFIG=y
BR2_LINUX_KERNEL_CUSTOM_CONFIG_FILE="board/qemu/csky/qemu_ck860_defconfig"

# Kernel addons & extentions
BR2_LINUX_KERNEL_EXT_CSKY_ARCH=y

# Kernel patches
# None

# System configuration
BR2_OPTIMIZE_2=y
BR2_TARGET_OPTIMIZATION="-mbacktrace"

# Rootfs
BR2_TARGET_ROOTFS_INITRAMFS=y
BR2_SHARED_STATIC_LIBS=y
BR2_ROOTFS_DEVICE_TABLE="board/qemu/csky/device_table.txt"
BR2_ROOTFS_OVERLAY="board/qemu/csky/fs-overlay/"
BR2_ROOTFS_DEVICE_CREATION_DYNAMIC_MDEV=y

# Toolchain & C library
BR2_TOOLCHAIN_BUILDROOT=y
BR2_TOOLCHAIN_BUILDROOT_GLIBC=y
BR2_TOOLCHAIN_BUILDROOT_CXX=y

# Packages on host
BR2_PACKAGE_HOST_CSKY_QEMU=y
BR2_PACKAGE_HOST_GDB=y

# Packages on board
BR2_PACKAGE_GDB=y
BR2_PACKAGE_GDB_SERVER=y

# Gitlab-CI
BR2_PACKAGE_CSKY_CI=y

# CI Testcases
BR2_PACKAGE_LTP_CI=y

# Others
BR2_PACKAGE_BUSYBOX_SHOW_OTHERS=y
BR2_PACKAGE_BASH=y
```

## configs/csky_860_qemu_next_glibc_br_defconfig
```kconfig
BR2_csky=y
BR2_ck860=y
BR2_OPTIMIZE_2=y
BR2_SHARED_STATIC_LIBS=y
BR2_TOOLCHAIN_BUILDROOT_CXX=y
BR2_PACKAGE_HOST_GDB=y
BR2_TARGET_OPTIMIZATION="-mbacktrace"
BR2_ROOTFS_DEVICE_CREATION_DYNAMIC_MDEV=y
BR2_ROOTFS_DEVICE_TABLE="board/csky-ci/device_table.txt"
BR2_LINUX_KERNEL=y
BR2_LINUX_KERNEL_CUSTOM_TARBALL=y
BR2_LINUX_KERNEL_CUSTOM_TARBALL_LOCATION="https://github.com/c-sky/csky-linux/archive/$(CSKY_LINUX_NEXT_VERSION).tar.gz"
BR2_LINUX_KERNEL_USE_CUSTOM_CONFIG=y
BR2_LINUX_KERNEL_CUSTOM_CONFIG_FILE="board/csky-ci/defconfigs/qemu_ck860_defconfig"
BR2_PACKAGE_LINUX_TOOLS_PERF=y
BR2_PACKAGE_BUSYBOX_SHOW_OTHERS=y
BR2_PACKAGE_BASH=y
BR2_TARGET_ROOTFS_INITRAMFS=y
BR2_PACKAGE_HOST_QEMU=y
BR2_PACKAGE_HOST_QEMU_SYSTEM_MODE=y
```

## configs/csky_860s_fpga_4.9_glibc_br_defconfig
```kconfig
# Architecture
BR2_csky=y
BR2_ck860=y
BR2_CSKY_FPGA=y
BR2_CSKY_FPGA_BITFILE="CK860SP_181127_BTB2048_L2512.bit"
BR2_CSKY_FPGA_DDRINIT="ddr_init_eragon3_sec_bypass_interrupt_non_secure_0305.elf"

# Kernel headers
BR2_PACKAGE_HOST_LINUX_HEADERS_CUSTOM_4_9=y

# Kernel configuration
BR2_LINUX_KERNEL=y
BR2_LINUX_KERNEL_VMLINUX=y
BR2_LINUX_KERNEL_CUSTOM_VERSION=y
BR2_LINUX_KERNEL_CUSTOM_VERSION_VALUE="4.9.56"
BR2_LINUX_KERNEL_USE_CUSTOM_CONFIG=y
BR2_LINUX_KERNEL_CUSTOM_CONFIG_FILE="board/csky/ck860_single_platform/linux_lite.config"
BR2_LINUX_KERNEL_DTS_SUPPORT=y
BR2_LINUX_KERNEL_USE_CUSTOM_DTS=y
BR2_LINUX_KERNEL_CUSTOM_DTS_PATH="board/csky/ck860_single_platform/ck860_platform_lite.dts"

# Kernel addons & extentions
BR2_LINUX_KERNEL_EXT_CSKY_ARCH=y

# Kernel patches
# None

# System configuration
BR2_OPTIMIZE_2=y
BR2_TARGET_OPTIMIZATION="-mbacktrace"

# Rootfs
BR2_TARGET_ROOTFS_INITRAMFS=y
BR2_ROOTFS_POST_IMAGE_SCRIPT="board/csky/ck860_single_platform/post-image.sh"
BR2_ROOTFS_DEVICE_CREATION_DYNAMIC_MDEV=y

# Toolchain & C library
BR2_TOOLCHAIN_BUILDROOT=y
BR2_TOOLCHAIN_BUILDROOT_GLIBC=y
BR2_TOOLCHAIN_BUILDROOT_CXX=y

# Packages on host
BR2_PACKAGE_HOST_CSKY_DEBUG=y
BR2_PACKAGE_HOST_GDB=y
BR2_PACKAGE_HOST_CSKY_QEMU=y

# Packages on board
BR2_PACKAGE_GDB=y
BR2_PACKAGE_GDB_SERVER=y
BR2_PACKAGE_LRZSZ=y

# Gitlab-CI
BR2_PACKAGE_CSKY_CI=y

# CI Testcases

# Others
BR2_PACKAGE_BUSYBOX_CONFIG="board/csky/ck860_platform/busybox.config"
BR2_PACKAGE_OVERRIDE_FILE="board/csky/ck860_platform/local.mk"
```

## configs/csky_anole_ck810_gerrit_defconfig
```kconfig
BR2_csky=y
BR2_ck810=y
BR2_CSKY_FPU=y
BR2_CSKY_GERRIT_REPO=y
BR2_PACKAGE_CSKY_EXAMPLES=y
BR2_PACKAGE_CSKY_EXAMPLES_VERSION="ca202e3d80b724d28002ae33f86c5e790fdd6ded"
# BR2_PACKAGE_CSKY_EXAMPLES_V4L2_DECODE is not set
# BR2_PACKAGE_CSKY_EXAMPLES_V4L2_ENCODE is not set
# BR2_PACKAGE_CSKY_EXAMPLES_FFMPEG_PLAYER is not set
BR2_PACKAGE_CSKY_AI=y
BR2_PACKAGE_CSKY_AI_VERSION="938215155541184fd3606fdbaf1de35e280b9f45"
BR2_PACKAGE_CSKY_NPU_TEST_CASES=y
BR2_PACKAGE_CSKY_NPU_TEST_HANDWRITE_NUMBER=y
BR2_OPTIMIZE_2=y
BR2_PACKAGE_OVERRIDE_FILE="board/csky/anole_ck810/local.mk"
BR2_GLOBAL_PATCH_DIR="board/csky/common/linux-$(BR2_LINUX_KERNEL_CUSTOM_VERSION_VALUE)-patches"
BR2_TOOLCHAIN_EXTERNAL=y
BR2_TOOLCHAIN_EXTERNAL_CUSTOM=y
BR2_TOOLCHAIN_EXTERNAL_DOWNLOAD=y
BR2_TOOLCHAIN_EXTERNAL_URL="https://gitlab.com/c-sky/buildroot/-/jobs/95233415/artifacts/raw/output/images/csky_toolchain_qemu_csky_ck810f_4.16_glibc_defconfig_e9cc5a5b66c4555bef62fbb3c2cb425889a0cadb.tar.xz"
BR2_TOOLCHAIN_EXTERNAL_GCC_6=y
BR2_TOOLCHAIN_EXTERNAL_HEADERS_4_15=y
BR2_TOOLCHAIN_EXTERNAL_CUSTOM_GLIBC=y
BR2_TOOLCHAIN_EXTERNAL_CXX=y
BR2_TARGET_OPTIMIZATION="-mhard-float"
BR2_ROOTFS_DEVICE_CREATION_DYNAMIC_MDEV=y
BR2_ROOTFS_OVERLAY="$(BASE_DIR)/build/linux-$(BR2_LINUX_KERNEL_CUSTOM_VERSION_VALUE)/addons/fs-overlay/anole"
BR2_ROOTFS_POST_IMAGE_SCRIPT="board/csky/anole_ck810/post-image.sh"
BR2_LINUX_KERNEL=y
BR2_LINUX_KERNEL_CUSTOM_VERSION=y
BR2_LINUX_KERNEL_CUSTOM_VERSION_VALUE="4.16.2"
BR2_LINUX_KERNEL_USE_CUSTOM_CONFIG=y
BR2_LINUX_KERNEL_CUSTOM_CONFIG_FILE="board/csky/anole_ck810/linux.config"
BR2_LINUX_KERNEL_DTS_SUPPORT=y
BR2_LINUX_KERNEL_USE_CUSTOM_DTS=y
BR2_LINUX_KERNEL_CUSTOM_DTS_PATH="board/csky/anole_ck810/anole_ck810.dts"
BR2_LINUX_KERNEL_EXT_CSKY_ARCH=y
BR2_LINUX_KERNEL_EXT_CSKY_ARCH_VERSION="9a4910fbef3a93d55ce521edf40acf2cfd7b6189"
BR2_LINUX_KERNEL_EXT_CSKY_ADDONS=y
BR2_LINUX_KERNEL_EXT_CSKY_ADDONS_VERSION="bddaca2f2f1de00a6052f1aaf95891e311a52fd6"
BR2_PACKAGE_BUSYBOX_CONFIG="board/csky/anole_ck810/busybox.config"
BR2_PACKAGE_TREE=y
BR2_PACKAGE_E2FSPROGS=y
BR2_PACKAGE_E2FSPROGS_E2IMAGE=y
BR2_PACKAGE_PICOCOM=y
BR2_PACKAGE_ETHTOOL=y
BR2_PACKAGE_IPERF3=y
BR2_TARGET_ROOTFS_INITRAMFS=y
BR2_TARGET_UBOOT=y
BR2_TARGET_UBOOT_BUILD_SYSTEM_KCONFIG=y
BR2_TARGET_UBOOT_CUSTOM_GIT=y
BR2_TARGET_UBOOT_CUSTOM_REPO_URL="ssh://${GITUSER}@192.168.0.78:29418/os/u-boot"
BR2_TARGET_UBOOT_CUSTOM_REPO_VERSION="8e3d6c57e14c347a704c50d637b4796c9a7d62e9"
BR2_TARGET_UBOOT_BOARD_DEFCONFIG="eragon"
BR2_TARGET_UBOOT_SPL=y
BR2_PACKAGE_HOST_GENEXT2FS=y
BR2_PACKAGE_HOST_CSKY_DEBUG=y
```

## configs/csky_anole_gerrit_defconfig
```kconfig
BR2_csky=y
BR2_ck860=y
BR2_PACKAGE_CSKY_EXAMPLES=y
BR2_PACKAGE_CSKY_EXAMPLES_GIT=y
BR2_PACKAGE_CSKY_EXAMPLES_VERSION="ca202e3d80b724d28002ae33f86c5e790fdd6ded"
BR2_PACKAGE_CSKY_EXAMPLES_GIT_URL="ssh://${GITUSER}@192.168.0.78:29418/test/linux_driver"
# BR2_PACKAGE_CSKY_EXAMPLES_V4L2_DECODE is not set
# BR2_PACKAGE_CSKY_EXAMPLES_V4L2_ENCODE is not set
# BR2_PACKAGE_CSKY_EXAMPLES_FFMPEG_PLAYER is not set
BR2_OPTIMIZE_2=y
BR2_PACKAGE_OVERRIDE_FILE="board/csky/anole/local.mk"
BR2_GLOBAL_PATCH_DIR="board/csky/common/linux-$(BR2_LINUX_KERNEL_CUSTOM_VERSION_VALUE)-patches"
BR2_TOOLCHAIN_EXTERNAL=y
BR2_TOOLCHAIN_EXTERNAL_CUSTOM=y
BR2_TOOLCHAIN_EXTERNAL_DOWNLOAD=y
BR2_TOOLCHAIN_EXTERNAL_URL="https://gitlab.com/c-sky/buildroot/-/jobs/79647863/artifacts/raw/output/images/csky_toolchain_csky_ck860_platform_defconfig_1b8a189c779026da67cfebd1920eb1bccccbf988.tar.xz"
BR2_TOOLCHAIN_EXTERNAL_GCC_6=y
BR2_TOOLCHAIN_EXTERNAL_HEADERS_4_15=y
BR2_TOOLCHAIN_EXTERNAL_LOCALE=y
BR2_TOOLCHAIN_EXTERNAL_HAS_SSP=y
BR2_TOOLCHAIN_EXTERNAL_CXX=y
BR2_ROOTFS_DEVICE_CREATION_DYNAMIC_MDEV=y
BR2_ROOTFS_OVERLAY="$(BASE_DIR)/build/linux-$(BR2_LINUX_KERNEL_CUSTOM_VERSION_VALUE)/addons/fs-overlay/anole"
BR2_ROOTFS_POST_IMAGE_SCRIPT="board/csky/anole/post-image.sh"
BR2_LINUX_KERNEL=y
BR2_LINUX_KERNEL_CUSTOM_VERSION=y
BR2_LINUX_KERNEL_CUSTOM_VERSION_VALUE="4.16.2"
BR2_LINUX_KERNEL_USE_CUSTOM_CONFIG=y
BR2_LINUX_KERNEL_CUSTOM_CONFIG_FILE="board/csky/anole/linux.config"
BR2_LINUX_KERNEL_DTS_SUPPORT=y
BR2_LINUX_KERNEL_USE_CUSTOM_DTS=y
BR2_LINUX_KERNEL_CUSTOM_DTS_PATH="board/csky/anole/anole.dts"
BR2_LINUX_KERNEL_EXT_CSKY_ARCH=y
BR2_LINUX_KERNEL_EXT_CSKY_ARCH_GIT=y
BR2_LINUX_KERNEL_EXT_CSKY_ARCH_VERSION="cf1df24e1144e6ce7d1f69d1c51bc1e9ec83974c"
BR2_LINUX_KERNEL_EXT_CSKY_ARCH_GIT_URL="ssh://${GITUSER}@192.168.0.78:29418/os/linux-csky"
BR2_LINUX_KERNEL_EXT_CSKY_ADDONS=y
BR2_LINUX_KERNEL_EXT_CSKY_ADDONS_GIT=y
BR2_LINUX_KERNEL_EXT_CSKY_ADDONS_VERSION="55d783400a30ccf908bc21410514cf1608b00887"
BR2_LINUX_KERNEL_EXT_CSKY_ADDONS_GIT_URL="ssh://${GITUSER}@192.168.0.78:29418/os/linux-csky-addons"
BR2_PACKAGE_BUSYBOX_CONFIG="board/csky/anole/busybox.config"
BR2_PACKAGE_LMBENCH=y
BR2_PACKAGE_TREE=y
BR2_PACKAGE_E2FSPROGS=y
BR2_PACKAGE_E2FSPROGS_E2IMAGE=y
BR2_PACKAGE_PICOCOM=y
BR2_PACKAGE_ETHTOOL=y
BR2_PACKAGE_IPERF3=y
BR2_TARGET_ROOTFS_INITRAMFS=y
BR2_PACKAGE_HOST_GENEXT2FS=y
BR2_PACKAGE_HOST_CSKY_DEBUG=y
```

## configs/csky_c860_sc_byhl_defconfig
```kconfig
BR2_csky=y
BR2_ck860=y
BR2_CSKY_FPU=y
BR2_CSKY_GERRIT_REPO=y
BR2_OPTIMIZE_2=y
BR2_PACKAGE_OVERRIDE_FILE=""
BR2_GLOBAL_PATCH_DIR="board/csky/common/linux-$(BR2_LINUX_KERNEL_CUSTOM_VERSION_VALUE)-patches"
BR2_TOOLCHAIN_EXTERNAL=y
BR2_TOOLCHAIN_EXTERNAL_PREINSTALLED=y
BR2_TOOLCHAIN_EXTERNAL_PATH="/home/ztw/work/toolchain/csky-linux-uclibcabiv2-tools-x86_64-uclibc-linux-4.9.56-20180929"
BR2_TOOLCHAIN_EXTERNAL_CSKY_UCLIBC=y
BR2_ROOTFS_DEVICE_CREATION_DYNAMIC_MDEV=y
BR2_ROOTFS_POST_IMAGE_SCRIPT="board/csky/c860_sc_byhl/post-image.sh"
BR2_LINUX_KERNEL=y
BR2_LINUX_KERNEL_CUSTOM_VERSION=y
BR2_LINUX_KERNEL_CUSTOM_VERSION_VALUE="4.9.56"
BR2_LINUX_KERNEL_USE_CUSTOM_CONFIG=y
BR2_LINUX_KERNEL_CUSTOM_CONFIG_FILE="board/csky/c860_sc_byhl/linux.config"
BR2_LINUX_KERNEL_VMLINUX=y
BR2_LINUX_KERNEL_DTS_SUPPORT=y
BR2_LINUX_KERNEL_USE_CUSTOM_DTS=y
BR2_LINUX_KERNEL_CUSTOM_DTS_PATH="board/csky/c860_sc_byhl/c860_sc_byhl.dts"
BR2_LINUX_KERNEL_EXT_CSKY_ARCH=y
BR2_LINUX_KERNEL_EXT_CSKY_ADDONS=y
BR2_LINUX_KERNEL_EXT_CSKY_ADDONS_VERSION="365ffea51afc467c5c252ee6670c252675fbb7a8"
BR2_PACKAGE_BUSYBOX_CONFIG="board/csky/c860_sc_byhl/busybox.config"
BR2_PACKAGE_GDB=y
BR2_PACKAGE_E2FSPROGS=y
BR2_PACKAGE_E2FSPROGS_E2IMAGE=y
BR2_PACKAGE_PICOCOM=y
BR2_PACKAGE_LIBTIRPC=y
BR2_PACKAGE_ETHTOOL=y
BR2_PACKAGE_IPERF3=y
BR2_TARGET_ROOTFS_INITRAMFS=y
BR2_PACKAGE_HOST_GENEXT2FS=y
BR2_PACKAGE_HOST_UBOOT_TOOLS=y
BR2_PACKAGE_HOST_CSKY_DEBUG=y
```

## configs/csky_ck807_eragon_bt_defconfig
```kconfig
BR2_csky=y
BR2_ck807=y
BR2_CSKY_FPU=y
BR2_OPTIMIZE_2=y
BR2_PACKAGE_OVERRIDE_FILE="board/csky/eragon/local.mk"
BR2_GLOBAL_PATCH_DIR="board/csky/common/linux-$(BR2_LINUX_KERNEL_CUSTOM_VERSION_VALUE)-patches"
BR2_ROOTFS_OVERLAY="board/csky/eragon/fs-overlay"
BR2_ROOTFS_POST_IMAGE_SCRIPT="board/csky/eragon_evb/post-image-ci.sh"
BR2_LINUX_KERNEL=y
BR2_LINUX_KERNEL_CUSTOM_VERSION=y
BR2_LINUX_KERNEL_CUSTOM_VERSION_VALUE="4.9.56"
BR2_LINUX_KERNEL_USE_CUSTOM_CONFIG=y
BR2_LINUX_KERNEL_CUSTOM_CONFIG_FILE="board/csky/eragon_evb/linux.config"
BR2_LINUX_KERNEL_DTS_SUPPORT=y
BR2_LINUX_KERNEL_USE_CUSTOM_DTS=y
BR2_LINUX_KERNEL_CUSTOM_DTS_PATH="board/csky/eragon_evb/eragon_evb.dts board/csky/eragon_evb/*.dtsi"
BR2_LINUX_KERNEL_EXT_CSKY_ARCH=y
BR2_LINUX_KERNEL_EXT_CSKY_ADDONS=y
BR2_LINUX_KERNEL_EXT_CSKY_ADDONS_GIT=y
BR2_LINUX_KERNEL_EXT_CSKY_ADDONS_VERSION="9fd2d0556a2cbc0dd563799380b2f6d3ccc3cebe"
BR2_LINUX_KERNEL_EXT_CSKY_ADDONS_GIT_URL="https://github.com/c-sky/linux-csky-addons.git"
BR2_LINUX_KERNEL_EXT_CSKY_EXAMPLES=y
BR2_LINUX_KERNEL_EXT_CSKY_EXAMPLES_GIT=y
BR2_LINUX_KERNEL_EXT_CSKY_EXAMPLES_VERSION="e9f43ac3ed15d43a44451277334a62568c9594ce"
BR2_LINUX_KERNEL_EXT_CSKY_EXAMPLES_GIT_URL="https://github.com/c-sky/linux-sdk-examples.git"
BR2_LINUX_KERNEL_VMLINUX=y
BR2_PACKAGE_BUSYBOX_CONFIG="board/csky/eragon/busybox.config"
BR2_PACKAGE_HOST_CSKY_DEBUG=y
BR2_PACKAGE_HOST_LINUX_HEADERS_CUSTOM_4_9=y
BR2_TOOLCHAIN_BUILDROOT=y
BR2_TOOLCHAIN_BUILDROOT_GLIBC=y
BR2_TOOLCHAIN_BUILDROOT_LIBC="glibc"
BR2_TOOLCHAIN_BUILDROOT_CXX=y
BR2_GCC_ENABLE_LTO=y
BR2_GCC_ENABLE_OPENMP=y
BR2_ROOTFS_DEVICE_CREATION_DYNAMIC_MDEV=y
BR2_PACKAGE_HOST_GDB=y
BR2_PACKAGE_CSKY_CI=y
BR2_PACKAGE_DHRYSTONE=y
BR2_PACKAGE_LMBENCH=y
BR2_PACKAGE_LTP_TESTSUITE_ARCH_SUPPORTS=y
BR2_PACKAGE_LTP_TESTSUITE=y
BR2_PACKAGE_WHETSTONE=y
```
