## configs/csky_ck860Mf_uclibc_test_defconfig
```kconfig
BR2_csky=y
BR2_ck860=y
BR2_CSKY_FPU=y
BR2_CSKY_VDSP=y
BR2_OPTIMIZE_2=y
BR2_PACKAGE_OVERRIDE_FILE="board/csky/ck860_platform/local.mk"
BR2_TOOLCHAIN_EXTERNAL=y
BR2_TOOLCHAIN_EXTERNAL_PREINSTALLED=y
BR2_TOOLCHAIN_EXTERNAL_PATH="$(TOPDIR)/../../install"
BR2_TOOLCHAIN_EXTERNAL_CSKY_UCLIBC=y
BR2_ROOTFS_DEVICE_CREATION_DYNAMIC_MDEV=y
BR2_SYSTEM_BIN_SH_BASH=y
BR2_ROOTFS_OVERLAY="board/csky-qa/fs-overlay/"
BR2_ROOTFS_POST_BUILD_SCRIPT="board/csky-qa/clean_lib.sh"
BR2_ROOTFS_POST_IMAGE_SCRIPT="board/csky/ck860_platform/post-image.sh"
BR2_LINUX_KERNEL=y
BR2_LINUX_KERNEL_CUSTOM_VERSION=y
BR2_LINUX_KERNEL_CUSTOM_VERSION_VALUE="4.16.2"
BR2_LINUX_KERNEL_USE_CUSTOM_CONFIG=y
BR2_LINUX_KERNEL_CUSTOM_CONFIG_FILE="board/csky/ck860_platform/linux_fpu_lite.config"
BR2_LINUX_KERNEL_VMLINUX=y
BR2_LINUX_KERNEL_DTS_SUPPORT=y
BR2_LINUX_KERNEL_USE_CUSTOM_DTS=y
BR2_LINUX_KERNEL_CUSTOM_DTS_PATH="board/csky/ck860_platform/ck860_platform_lite.dts"
BR2_LINUX_KERNEL_EXT_CSKY_ARCH=y
BR2_LINUX_KERNEL_EXT_CSKY_ARCH_GIT=y
BR2_LINUX_KERNEL_EXT_CSKY_ARCH_VERSION="f3f88fac4490b7ff64dfd4ce2451267b448a2031"
BR2_LINUX_KERNEL_EXT_CSKY_ARCH_GIT_URL="ssh://${GITUSER}@192.168.0.78:29418/os/linux-csky"
BR2_PACKAGE_BUSYBOX_CONFIG="board/csky/ck860_platform/busybox.config"
BR2_PACKAGE_BUSYBOX_CONFIG_FRAGMENT_FILES="board/csky-qa/busybox.fragment"
BR2_PACKAGE_BUSYBOX_SHOW_OTHERS=y
BR2_PACKAGE_E2FSPROGS=y
BR2_PACKAGE_E2FSPROGS_E2IMAGE=y
BR2_PACKAGE_MMC_UTILS=y
BR2_PACKAGE_PICOCOM=y
BR2_PACKAGE_ETHTOOL=y
BR2_TARGET_ROOTFS_INITRAMFS=y
BR2_PACKAGE_HOST_GENEXT2FS=y
BR2_PACKAGE_HOST_UBOOT_TOOLS=y
```

## configs/csky_ck860_eragon3_gerrit_defconfig
```kconfig
BR2_csky=y
BR2_ck860=y
BR2_CSKY_GERRIT_REPO=y
BR2_OPTIMIZE_2=y
BR2_PACKAGE_OVERRIDE_FILE="board/csky/eragon3/local.mk"
BR2_TOOLCHAIN_BUILDROOT_LOCALE=y
BR2_TOOLCHAIN_BUILDROOT_CXX=y
BR2_ROOTFS_DEVICE_CREATION_DYNAMIC_MDEV=y
BR2_ROOTFS_OVERLAY="board/csky/eragon3/fs-overlay"
BR2_LINUX_KERNEL=y
BR2_LINUX_KERNEL_CUSTOM_VERSION=y
BR2_LINUX_KERNEL_CUSTOM_VERSION_VALUE="4.16.2"
BR2_LINUX_KERNEL_USE_CUSTOM_CONFIG=y
BR2_LINUX_KERNEL_CUSTOM_CONFIG_FILE="board/csky/eragon3/linux_ck860.config"
BR2_LINUX_KERNEL_VMLINUX=y
BR2_LINUX_KERNEL_DTS_SUPPORT=y
BR2_LINUX_KERNEL_USE_CUSTOM_DTS=y
BR2_LINUX_KERNEL_CUSTOM_DTS_PATH="board/csky/eragon3/eragon3_ck860mp.dts"
BR2_LINUX_KERNEL_EXT_CSKY_ARCH=y
BR2_LINUX_KERNEL_EXT_CSKY_ARCH_GIT=y
BR2_LINUX_KERNEL_EXT_CSKY_ARCH_GIT_URL="ssh://${GITUSER}@192.168.0.78:29418/os/linux-csky"
BR2_LINUX_KERNEL_EXT_CSKY_ADDONS=y
BR2_LINUX_KERNEL_EXT_CSKY_ADDONS_GIT=y
BR2_LINUX_KERNEL_EXT_CSKY_ADDONS_VERSION="9fd2d0556a2cbc0dd563799380b2f6d3ccc3cebe"
BR2_LINUX_KERNEL_EXT_CSKY_ADDONS_GIT_URL="ssh://${GITUSER}@192.168.0.78:29418/os/linux-csky-addons"
BR2_PACKAGE_BUSYBOX_CONFIG="board/csky/eragon3/busybox.config"
BR2_PACKAGE_E2FSPROGS=y
BR2_PACKAGE_E2FSPROGS_E2IMAGE=y
BR2_PACKAGE_MMC_UTILS=y
BR2_PACKAGE_FB_TEST_APP=y
BR2_PACKAGE_PICOCOM=y
BR2_PACKAGE_LIBTIRPC=y
BR2_PACKAGE_ETHTOOL=y
BR2_PACKAGE_IPERF3=y
BR2_TARGET_ROOTFS_INITRAMFS=y
BR2_PACKAGE_HOST_GENEXT2FS=y
BR2_PACKAGE_HOST_UBOOT_TOOLS=y
BR2_PACKAGE_HOST_CSKY_DEBUG=y
```

## configs/csky_ck860_platform_4.9_defconfig
```kconfig
BR2_csky=y
BR2_ck860=y
BR2_OPTIMIZE_2=y
BR2_PACKAGE_OVERRIDE_FILE="board/csky/ck860_platform/local.mk"
BR2_PACKAGE_HOST_LINUX_HEADERS_CUSTOM_4_9=y
BR2_TOOLCHAIN_BUILDROOT_LOCALE=y
BR2_PTHREAD_DEBUG=y
BR2_TOOLCHAIN_BUILDROOT_USE_SSP=y
BR2_TOOLCHAIN_BUILDROOT_CXX=y
BR2_PACKAGE_HOST_GDB=y
BR2_ROOTFS_DEVICE_CREATION_DYNAMIC_MDEV=y
BR2_ROOTFS_POST_IMAGE_SCRIPT="board/csky/ck860_platform/post-image.sh"
BR2_LINUX_KERNEL=y
BR2_LINUX_KERNEL_CUSTOM_VERSION=y
BR2_LINUX_KERNEL_CUSTOM_VERSION_VALUE="4.9.56"
BR2_LINUX_KERNEL_USE_CUSTOM_CONFIG=y
BR2_LINUX_KERNEL_CUSTOM_CONFIG_FILE="board/csky/ck860_platform/linux_lite.config"
BR2_LINUX_KERNEL_VMLINUX=y
BR2_LINUX_KERNEL_DTS_SUPPORT=y
BR2_LINUX_KERNEL_USE_CUSTOM_DTS=y
BR2_LINUX_KERNEL_CUSTOM_DTS_PATH="board/csky/ck860_platform/ck860_platform_lite.dts"
BR2_LINUX_KERNEL_EXT_CSKY_ARCH=y
BR2_PACKAGE_BUSYBOX_CONFIG="board/csky/ck860_platform/busybox.config"
BR2_PACKAGE_GDB=y
BR2_PACKAGE_LMBENCH=y
BR2_PACKAGE_E2FSPROGS=y
BR2_PACKAGE_E2FSPROGS_E2IMAGE=y
BR2_PACKAGE_MMC_UTILS=y
BR2_PACKAGE_FB_TEST_APP=y
BR2_PACKAGE_PICOCOM=y
BR2_PACKAGE_ETHTOOL=y
BR2_PACKAGE_IPERF3=y
BR2_TARGET_ROOTFS_INITRAMFS=y
BR2_PACKAGE_HOST_GENEXT2FS=y
BR2_PACKAGE_HOST_UBOOT_TOOLS=y
BR2_PACKAGE_HOST_CSKY_DEBUG=y
```

## configs/csky_ck860_smp_platform_gerrit_defconfig
```kconfig
BR2_csky=y
BR2_ck860=y
BR2_PACKAGE_CSKY_EXAMPLES=y
BR2_PACKAGE_CSKY_EXAMPLES_GIT=y
BR2_PACKAGE_CSKY_EXAMPLES_VERSION="ca202e3d80b724d28002ae33f86c5e790fdd6ded"
BR2_PACKAGE_CSKY_EXAMPLES_GIT_URL="ssh://${GITUSER}@192.168.0.78:29418/test/linux_driver"
BR2_OPTIMIZE_2=y
BR2_PACKAGE_OVERRIDE_FILE="board/csky/ck860_smp_platform/local.mk"
BR2_GLOBAL_PATCH_DIR="board/csky/common/linux-$(BR2_LINUX_KERNEL_CUSTOM_VERSION_VALUE)-patches"
BR2_TOOLCHAIN_EXTERNAL=y
BR2_TOOLCHAIN_EXTERNAL_CUSTOM=y
BR2_TOOLCHAIN_EXTERNAL_DOWNLOAD=y
BR2_TOOLCHAIN_EXTERNAL_URL="https://gitlab.com/c-sky/buildroot/-/jobs/66831443/artifacts/raw/output/images/csky_toolchain_csky_ck860_eragon3_defconfig_da8aa66c410d90672ebbdee889d48009b6d5c3fc.tar.xz"
BR2_TOOLCHAIN_EXTERNAL_GCC_6=y
BR2_TOOLCHAIN_EXTERNAL_HEADERS_4_15=y
BR2_TOOLCHAIN_EXTERNAL_LOCALE=y
# BR2_TOOLCHAIN_EXTERNAL_HAS_THREADS_DEBUG is not set
BR2_TOOLCHAIN_EXTERNAL_CXX=y
BR2_ROOTFS_DEVICE_CREATION_DYNAMIC_MDEV=y
BR2_ROOTFS_OVERLAY="board/csky/ck860_smp_platform/fs-overlay"
BR2_ROOTFS_POST_IMAGE_SCRIPT="board/csky/ck860_smp_platform/post-image.sh"
BR2_LINUX_KERNEL=y
BR2_LINUX_KERNEL_CUSTOM_VERSION=y
BR2_LINUX_KERNEL_CUSTOM_VERSION_VALUE="4.16.2"
BR2_LINUX_KERNEL_USE_CUSTOM_CONFIG=y
BR2_LINUX_KERNEL_CUSTOM_CONFIG_FILE="board/csky/ck860_smp_platform/linux.config"
BR2_LINUX_KERNEL_VMLINUX=y
BR2_LINUX_KERNEL_DTS_SUPPORT=y
BR2_LINUX_KERNEL_USE_CUSTOM_DTS=y
BR2_LINUX_KERNEL_CUSTOM_DTS_PATH="board/csky/ck860_smp_platform/ck860_smp_platform.dts"
BR2_LINUX_KERNEL_EXT_CSKY_ARCH=y
BR2_LINUX_KERNEL_EXT_CSKY_ARCH_GIT=y
BR2_LINUX_KERNEL_EXT_CSKY_ARCH_VERSION="9e3313a92b16fa7441402a79181d34eba361577a"
BR2_LINUX_KERNEL_EXT_CSKY_ARCH_GIT_URL="ssh://${GITUSER}@192.168.0.78:29418/os/linux-csky"
BR2_LINUX_KERNEL_EXT_CSKY_ADDONS=y
BR2_LINUX_KERNEL_EXT_CSKY_ADDONS_GIT=y
BR2_LINUX_KERNEL_EXT_CSKY_ADDONS_VERSION="8c1988b3d0e4ad0555eb615ef860b048ac45e85f"
BR2_LINUX_KERNEL_EXT_CSKY_ADDONS_GIT_URL="ssh://${GITUSER}@192.168.0.78:29418/os/linux-csky-addons"
BR2_PACKAGE_BUSYBOX_CONFIG="board/csky/ck860_smp_platform/busybox.config"
BR2_PACKAGE_GDB=y
BR2_PACKAGE_LMBENCH=y
BR2_PACKAGE_ALSA_UTILS=y
BR2_PACKAGE_ALSA_UTILS_AMIXER=y
BR2_PACKAGE_ALSA_UTILS_APLAY=y
BR2_PACKAGE_FFMPEG=y
BR2_PACKAGE_E2FSPROGS=y
BR2_PACKAGE_E2FSPROGS_E2IMAGE=y
BR2_PACKAGE_MMC_UTILS=y
BR2_PACKAGE_FB_TEST_APP=y
BR2_PACKAGE_PICOCOM=y
BR2_PACKAGE_LIBTIRPC=y
BR2_PACKAGE_ETHTOOL=y
BR2_PACKAGE_IPERF3=y
BR2_TARGET_ROOTFS_INITRAMFS=y
BR2_PACKAGE_HOST_GENEXT2FS=y
BR2_PACKAGE_HOST_UBOOT_TOOLS=y
BR2_PACKAGE_HOST_CSKY_DEBUG=y
```

## configs/csky_ck860fpga_glibc_test_defconfig
```kconfig
BR2_csky=y
BR2_ck860=y
BR2_CSKY_FPU=y
BR2_CSKY_GERRIT_REPO=y
BR2_OPTIMIZE_2=y
BR2_PACKAGE_OVERRIDE_FILE="board/csky/ck860f_platform/local.mk"
BR2_GLOBAL_PATCH_DIR="board/csky/common/linux-$(BR2_LINUX_KERNEL_CUSTOM_VERSION_VALUE)-patches"
BR2_TOOLCHAIN_EXTERNAL=y
BR2_TOOLCHAIN_EXTERNAL_PREINSTALLED=y
BR2_TOOLCHAIN_EXTERNAL_PATH="$(TOPDIR)/../../install"
BR2_ROOTFS_DEVICE_CREATION_DYNAMIC_MDEV=y
BR2_SYSTEM_BIN_SH_BASH=y
BR2_ROOTFS_OVERLAY="board/csky-qa/fs-overlay/"
BR2_ROOTFS_POST_BUILD_SCRIPT="board/csky-qa/clean_lib.sh"
BR2_ROOTFS_POST_IMAGE_SCRIPT="board/csky/ck860f_platform/post-image.sh"
BR2_LINUX_KERNEL=y
BR2_LINUX_KERNEL_CUSTOM_VERSION=y
BR2_LINUX_KERNEL_CUSTOM_VERSION_VALUE="4.16.2"
BR2_LINUX_KERNEL_USE_CUSTOM_CONFIG=y
BR2_LINUX_KERNEL_CUSTOM_CONFIG_FILE="board/csky/ck860f_platform/linux.config"
BR2_LINUX_KERNEL_VMLINUX=y
BR2_LINUX_KERNEL_DTS_SUPPORT=y
BR2_LINUX_KERNEL_USE_CUSTOM_DTS=y
BR2_LINUX_KERNEL_CUSTOM_DTS_PATH="board/csky/ck860f_platform/ck860f_platform.dts"
BR2_LINUX_KERNEL_EXT_CSKY_ARCH=y
BR2_LINUX_KERNEL_EXT_CSKY_ARCH_GIT=y
BR2_LINUX_KERNEL_EXT_CSKY_ARCH_VERSION="27810c7649372b41b1add118bf6290deb1d3c6d1"
BR2_LINUX_KERNEL_EXT_CSKY_ARCH_GIT_URL="ssh://${GITUSER}@192.168.0.78:29418/os/linux-csky"
BR2_LINUX_KERNEL_EXT_CSKY_ADDONS=y
BR2_LINUX_KERNEL_EXT_CSKY_ADDONS_GIT=y
BR2_LINUX_KERNEL_EXT_CSKY_ADDONS_VERSION="a9fdac64a66783ab8a7971c2c9bb6ff79b1a69fe"
BR2_LINUX_KERNEL_EXT_CSKY_ADDONS_GIT_URL="ssh://${GITUSER}@192.168.0.78:29418/os/linux-csky-addons"
BR2_PACKAGE_BUSYBOX_CONFIG="board/csky/ck860f_platform/busybox.config"
BR2_PACKAGE_BUSYBOX_CONFIG_FRAGMENT_FILES="board/csky-qa/busybox.fragment"
BR2_PACKAGE_BUSYBOX_SHOW_OTHERS=y
BR2_PACKAGE_ALSA_UTILS=y
BR2_PACKAGE_ALSA_UTILS_AMIXER=y
BR2_PACKAGE_ALSA_UTILS_APLAY=y
BR2_PACKAGE_E2FSPROGS=y
BR2_PACKAGE_E2FSPROGS_E2IMAGE=y
BR2_PACKAGE_MMC_UTILS=y
BR2_PACKAGE_FB_TEST_APP=y
BR2_PACKAGE_PICOCOM=y
BR2_PACKAGE_ETHTOOL=y
BR2_PACKAGE_IPERF3=y
BR2_TARGET_ROOTFS_INITRAMFS=y
BR2_PACKAGE_HOST_GENEXT2FS=y
BR2_PACKAGE_HOST_UBOOT_TOOLS=y
```

## configs/csky_dh7200_defconfig
```kconfig
BR2_csky=y
BR2_ck810=y
BR2_CSKY_FPU=y
BR2_OPTIMIZE_2=y
BR2_SHARED_STATIC_LIBS=y
BR2_LINUX_KERNEL=y
BR2_LINUX_KERNEL_CUSTOM_VERSION=y
BR2_LINUX_KERNEL_CUSTOM_VERSION_VALUE="4.9.56"
BR2_LINUX_KERNEL_USE_CUSTOM_CONFIG=y
BR2_LINUX_KERNEL_CUSTOM_CONFIG_FILE="board/dahua/dh7200/dh7200_defconfig"
BR2_LINUX_KERNEL_VMLINUX=y
BR2_LINUX_KERNEL_DTS_SUPPORT=y
BR2_LINUX_KERNEL_USE_CUSTOM_DTS=y
BR2_LINUX_KERNEL_CUSTOM_DTS_PATH="board/dahua/dh7200/dh7200.dts"
BR2_LINUX_KERNEL_EXT_CSKY_ARCH=y
BR2_PACKAGE_ZLIB=y
BR2_PACKAGE_POPT=y
BR2_TARGET_ROOTFS_INITRAMFS=y
BR2_PACKAGE_HOST_CSKY_DEBUG=y
BR2_TOOLCHAIN_EXTERNAL=y
```

## configs/csky_dh7200_evb_ai_gerrit_defconfig
```kconfig
BR2_csky=y
BR2_ck810=y
BR2_CSKY_FPU=y
BR2_CSKY_GERRIT_REPO=y
BR2_PACKAGE_CSKY_EXAMPLES=y
BR2_PACKAGE_CSKY_EXAMPLES_VERSION="0399a0dbd64ff2a138ae1658ac6da8c393313320"
BR2_PACKAGE_CSKY_AI=y
BR2_PACKAGE_CSKY_AI_VERSION="69243198a6696ea2fc234ff70955c101418aef55"
BR2_OPTIMIZE_2=y
BR2_PACKAGE_OVERRIDE_FILE="board/csky/dh7200_evb_ai/local.mk"
BR2_TOOLCHAIN_EXTERNAL=y
BR2_TOOLCHAIN_EXTERNAL_CUSTOM=y
BR2_TOOLCHAIN_EXTERNAL_DOWNLOAD=y
BR2_TOOLCHAIN_EXTERNAL_URL="csky-abiv2-linux-tools-x86_64-glibc-linux-3.0.8-20180127.tar.gz"
BR2_TOOLCHAIN_EXTERNAL_CUSTOM_PREFIX="csky-abiv2-linux"
BR2_TOOLCHAIN_EXTERNAL_GCC_6=y
BR2_TOOLCHAIN_EXTERNAL_HEADERS_3_0=y
BR2_TOOLCHAIN_EXTERNAL_CUSTOM_GLIBC=y
BR2_TARGET_OPTIMIZATION="-mhard-float"
BR2_ROOTFS_DEVICE_CREATION_DYNAMIC_MDEV=y
BR2_ROOTFS_OVERLAY="$(BASE_DIR)/build/linux-$(BR2_LINUX_KERNEL_CUSTOM_REPO_VERSION)/fs-overlay/dh7200_evb_ai"
BR2_ROOTFS_POST_IMAGE_SCRIPT="board/csky/dh7200_evb_ai/post-image.sh"
BR2_LINUX_KERNEL=y
BR2_LINUX_KERNEL_CUSTOM_GIT=y
BR2_LINUX_KERNEL_CUSTOM_REPO_URL="ssh://${GITUSER}@192.168.0.78:29418/os/linux"
BR2_LINUX_KERNEL_CUSTOM_REPO_VERSION="csky-linux-3.0.8-dh7200-20171026"
BR2_LINUX_KERNEL_USE_CUSTOM_CONFIG=y
BR2_LINUX_KERNEL_CUSTOM_CONFIG_FILE="board/csky/dh7200_evb_ai/linux.config"
BR2_PACKAGE_BUSYBOX_CONFIG="board/csky/dh7200_evb_ai/busybox.config"
BR2_PACKAGE_GSTREAMER1=y
BR2_PACKAGE_GSTREAMER1_CHECK=y
BR2_PACKAGE_GST1_PLUGINS_BASE_PLUGIN_AUDIOTESTSRC=y
BR2_PACKAGE_GST1_PLUGINS_BASE_PLUGIN_ENCODING=y
BR2_PACKAGE_GST1_PLUGINS_BASE_PLUGIN_TCP=y
BR2_PACKAGE_GST1_PLUGINS_BASE_PLUGIN_VIDEOTESTSRC=y
BR2_PACKAGE_GST1_PLUGINS_GOOD_PLUGIN_ID3DEMUX=y
BR2_PACKAGE_GST1_PLUGINS_GOOD_PLUGIN_RTSP=y
BR2_PACKAGE_GST1_PLUGINS_UGLY=y
BR2_PACKAGE_GST1_PLUGINS_UGLY_PLUGIN_X264=y
BR2_PACKAGE_GST1_RTSP_SERVER=y
BR2_PACKAGE_E2FSPROGS=y
BR2_PACKAGE_E2FSPROGS_E2IMAGE=y
BR2_PACKAGE_FB_TEST_APP=y
BR2_PACKAGE_EVTEST=y
BR2_PACKAGE_PICOCOM=y
BR2_PACKAGE_LIBPTHREAD_STUBS=y
BR2_PACKAGE_ETHTOOL=y
BR2_PACKAGE_OPENSSH=y
BR2_PACKAGE_HOST_GENEXT2FS=y
BR2_PACKAGE_HOST_CSKY_DEBUG=y
```
