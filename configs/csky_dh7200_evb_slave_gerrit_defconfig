## configs/csky_kdgd_defconfig
```kconfig
BR2_csky=y
BR2_ck810=y
BR2_CSKY_FPU=y
BR2_OPTIMIZE_2=y
BR2_PACKAGE_OVERRIDE_FILE="board/csky/kdgd/local.mk"
BR2_GLOBAL_PATCH_DIR="board/csky/common/linux-$(BR2_LINUX_KERNEL_CUSTOM_VERSION_VALUE)-patches"
BR2_ROOTFS_DEVICE_CREATION_DYNAMIC_MDEV=y
BR2_ROOTFS_OVERLAY="board/csky/kdgd/fs-overlay"
BR2_ROOTFS_POST_IMAGE_SCRIPT="board/csky/kdgd/post-image.sh"
BR2_LINUX_KERNEL=y
BR2_LINUX_KERNEL_CUSTOM_VERSION=y
BR2_LINUX_KERNEL_CUSTOM_VERSION_VALUE="4.9.56"
BR2_LINUX_KERNEL_USE_CUSTOM_CONFIG=y
BR2_LINUX_KERNEL_CUSTOM_CONFIG_FILE="board/csky/kdgd/linux.config"
BR2_LINUX_KERNEL_DTS_SUPPORT=y
BR2_LINUX_KERNEL_USE_CUSTOM_DTS=y
BR2_LINUX_KERNEL_CUSTOM_DTS_PATH="board/csky/kdgd/kdgd.dts"
BR2_LINUX_KERNEL_EXT_CSKY_ARCH=y
BR2_LINUX_KERNEL_EXT_CSKY_ARCH_GIT=y
BR2_LINUX_KERNEL_EXT_CSKY_ARCH_GIT_URL="https://github.com/c-sky/csky-linux.git"
BR2_LINUX_KERNEL_EXT_CSKY_ADDONS=y
BR2_LINUX_KERNEL_EXT_CSKY_ADDONS_GIT=y
BR2_LINUX_KERNEL_EXT_CSKY_ADDONS_VERSION="67598e686384a07784fd0eefce9cef9c8c9eb7c1"
BR2_LINUX_KERNEL_EXT_CSKY_ADDONS_GIT_URL="https://github.com/c-sky/linux-csky-addons.git"
BR2_PACKAGE_BUSYBOX_CONFIG="board/csky/kdgd/busybox.config"
BR2_PACKAGE_PICOCOM=y
BR2_TARGET_ROOTFS_INITRAMFS=y
BR2_TARGET_UBOOT=y
BR2_TARGET_UBOOT_BUILD_SYSTEM_KCONFIG=y
BR2_TARGET_UBOOT_CUSTOM_GIT=y
BR2_TARGET_UBOOT_CUSTOM_REPO_URL="https://github.com/c-sky/csky_uboot.git"
BR2_TARGET_UBOOT_CUSTOM_REPO_VERSION="8e3d6c57e14c347a704c50d637b4796c9a7d62e9"
BR2_TARGET_UBOOT_BOARD_DEFCONFIG="kdgd"
BR2_TARGET_UBOOT_SPL=y
BR2_PACKAGE_HOST_CSKY_DEBUG=y
BR2_TOOLCHAIN_EXTERNAL=y
```

## configs/csky_kdgd_gerrit_defconfig
```kconfig
BR2_csky=y
BR2_ck810=y
BR2_CSKY_FPU=y
BR2_OPTIMIZE_2=y
BR2_PACKAGE_OVERRIDE_FILE="board/csky/kdgd/local.mk"
BR2_ROOTFS_DEVICE_CREATION_DYNAMIC_MDEV=y
BR2_ROOTFS_OVERLAY="board/csky/kdgd/fs-overlay"
BR2_LINUX_KERNEL=y
BR2_LINUX_KERNEL_CUSTOM_VERSION=y
BR2_LINUX_KERNEL_CUSTOM_VERSION_VALUE="4.9.25"
BR2_GLOBAL_PATCH_DIR="board/csky/common/linux-$(BR2_LINUX_KERNEL_CUSTOM_VERSION_VALUE)-patches"
BR2_LINUX_KERNEL_USE_CUSTOM_CONFIG=y
BR2_LINUX_KERNEL_CUSTOM_CONFIG_FILE="board/csky/kdgd/linux.config"
BR2_LINUX_KERNEL_DTS_SUPPORT=y
BR2_LINUX_KERNEL_USE_CUSTOM_DTS=y
BR2_LINUX_KERNEL_CUSTOM_DTS_PATH="board/csky/kdgd/kdgd.dts"
BR2_LINUX_KERNEL_EXT_CSKY_ARCH=y
BR2_LINUX_KERNEL_EXT_CSKY_ARCH_GIT=y
BR2_LINUX_KERNEL_EXT_CSKY_ARCH_VERSION="59d499a7536ea63e2d5bce941d11c2c39a5b751c"
BR2_LINUX_KERNEL_EXT_CSKY_ARCH_GIT_URL="ssh://${GITUSER}@192.168.0.78:29418/os/linux-csky"
BR2_LINUX_KERNEL_EXT_CSKY_ADDONS=y
BR2_LINUX_KERNEL_EXT_CSKY_ADDONS_GIT=y
BR2_LINUX_KERNEL_EXT_CSKY_ADDONS_VERSION="c3bf41b3b3d9f94a054185d2dea599ab739b669b"
BR2_LINUX_KERNEL_EXT_CSKY_ADDONS_GIT_URL="ssh://${GITUSER}@192.168.0.78:29418/os/linux-csky-addons"
BR2_PACKAGE_PICOCOM=y
BR2_TARGET_ROOTFS_INITRAMFS=y
BR2_TARGET_UBOOT=y
BR2_TARGET_UBOOT_BUILD_SYSTEM_KCONFIG=y
BR2_TARGET_UBOOT_CUSTOM_GIT=y
BR2_TARGET_UBOOT_CUSTOM_REPO_URL="ssh://${GITUSER}@192.168.0.78:29418/os/u-boot"
BR2_TARGET_UBOOT_CUSTOM_REPO_VERSION="9d020e276584062474bd00e5f3faa1c17e5cb035"
BR2_TARGET_UBOOT_BOARD_DEFCONFIG="kdgd"
BR2_PACKAGE_HOST_CSKY_DEBUG=y
```

## configs/csky_sc6138a_defconfig
```kconfig
BR2_csky=y
BR2_OPTIMIZE_2=y
BR2_SHARED_STATIC_LIBS=y
BR2_TARGET_GENERIC_GETTY_PORT="ttyAMA0"
BR2_LINUX_KERNEL=y
BR2_LINUX_KERNEL_CUSTOM_VERSION=y
BR2_LINUX_KERNEL_CUSTOM_VERSION_VALUE="4.9.25"
BR2_LINUX_KERNEL_USE_CUSTOM_CONFIG=y
BR2_LINUX_KERNEL_CUSTOM_CONFIG_FILE="board/silan/sc6138a/sc6138a_defconfig"
BR2_LINUX_KERNEL_VMLINUX=y
BR2_LINUX_KERNEL_DTS_SUPPORT=y
BR2_LINUX_KERNEL_USE_CUSTOM_DTS=y
BR2_LINUX_KERNEL_CUSTOM_DTS_PATH="board/silan/sc6138a/sc6138a.dts"
BR2_LINUX_KERNEL_EXT_CSKY_ARCH=y
BR2_LINUX_KERNEL_EXT_CSKY_ADDONS=y
BR2_TARGET_ROOTFS_CPIO=y
```

## configs/csky_sc8925_bt_defconfig
```kconfig
BR2_csky=y
BR2_ck810=y
BR2_CSKY_FPU=y
BR2_OPTIMIZE_2=y
BR2_SHARED_STATIC_LIBS=y
BR2_ROOTFS_DEVICE_TABLE="board/qemu/csky/device_table.txt"
BR2_ROOTFS_POST_IMAGE_SCRIPT="board/silan/sc8925/post-image-ci.sh"
BR2_TARGET_GENERIC_GETTY_PORT="ttyAMA0"
BR2_LINUX_KERNEL=y
BR2_LINUX_KERNEL_CUSTOM_VERSION=y
BR2_LINUX_KERNEL_CUSTOM_VERSION_VALUE="4.9.56"
BR2_LINUX_KERNEL_USE_CUSTOM_CONFIG=y
BR2_LINUX_KERNEL_CUSTOM_CONFIG_FILE="board/silan/sc8925/sc8925_defconfig"
BR2_LINUX_KERNEL_VMLINUX=y
BR2_LINUX_KERNEL_DTS_SUPPORT=y
BR2_LINUX_KERNEL_USE_CUSTOM_DTS=y
BR2_LINUX_KERNEL_CUSTOM_DTS_PATH="board/silan/sc8925/sc8925.dts"
BR2_LINUX_KERNEL_EXT_CSKY_ARCH=y
BR2_LINUX_KERNEL_EXT_CSKY_ADDONS=y
BR2_PACKAGE_ZLIB=y
BR2_PACKAGE_POPT=y
BR2_PACKAGE_HOST_CSKY_DEBUG=y
BR2_PACKAGE_HOST_LINUX_HEADERS_CUSTOM_4_9=y
BR2_TOOLCHAIN_BUILDROOT=y
BR2_TOOLCHAIN_BUILDROOT_GLIBC=y
BR2_TOOLCHAIN_BUILDROOT_LIBC="glibc"
BR2_TOOLCHAIN_BUILDROOT_CXX=y
BR2_GCC_ENABLE_LTO=y
BR2_GCC_ENABLE_OPENMP=y
BR2_ROOTFS_DEVICE_CREATION_DYNAMIC_MDEV=y
BR2_PACKAGE_HOST_GDB=y
BR2_PACKAGE_CSKY_CI=y
```

## configs/csky_sc8925_defconfig
```kconfig
BR2_csky=y
BR2_ck810=y
BR2_CSKY_FPU=y
BR2_OPTIMIZE_2=y
BR2_SHARED_STATIC_LIBS=y
BR2_ROOTFS_DEVICE_TABLE="board/qemu/csky/device_table.txt"
BR2_TARGET_GENERIC_GETTY_PORT="ttyAMA0"
BR2_LINUX_KERNEL=y
BR2_LINUX_KERNEL_CUSTOM_VERSION=y
BR2_LINUX_KERNEL_CUSTOM_VERSION_VALUE="4.9.25"
BR2_LINUX_KERNEL_USE_CUSTOM_CONFIG=y
BR2_LINUX_KERNEL_CUSTOM_CONFIG_FILE="board/silan/sc8925/sc8925_defconfig"
BR2_LINUX_KERNEL_VMLINUX=y
BR2_LINUX_KERNEL_DTS_SUPPORT=y
BR2_LINUX_KERNEL_USE_CUSTOM_DTS=y
BR2_LINUX_KERNEL_CUSTOM_DTS_PATH="board/silan/sc8925/sc8925.dts"
BR2_LINUX_KERNEL_EXT_CSKY_ARCH=y
BR2_LINUX_KERNEL_EXT_CSKY_ADDONS=y
BR2_PACKAGE_ZLIB=y
BR2_PACKAGE_POPT=y
BR2_TARGET_ROOTFS_INITRAMFS=y
BR2_PACKAGE_HOST_CSKY_DEBUG=y
```

## configs/csky_sc8925_glibc_test_defconfig
```kconfig
BR2_csky=y
BR2_ck810=y
BR2_OPTIMIZE_2=y
BR2_SHARED_STATIC_LIBS=y
BR2_TOOLCHAIN_EXTERNAL_CUSTOM=y
BR2_TOOLCHAIN_EXTERNAL_PATH="$(TOPDIR)/../install"
BR2_TOOLCHAIN_EXTERNAL_CUSTOM_PREFIX="$(ARCH)-abiv2-linux"
BR2_TOOLCHAIN_EXTERNAL_GCC_6=y
BR2_TOOLCHAIN_EXTERNAL_HEADERS_4_9=y
BR2_TOOLCHAIN_EXTERNAL_CUSTOM_GLIBC=y
BR2_TARGET_GENERIC_GETTY_PORT="ttyAMA0"
BR2_ROOTFS_OVERLAY="board/csky-qa/fs-overlay/"
BR2_LINUX_KERNEL=y
BR2_LINUX_KERNEL_CUSTOM_VERSION=y
BR2_LINUX_KERNEL_CUSTOM_VERSION_VALUE="4.9.25"
BR2_LINUX_KERNEL_USE_CUSTOM_CONFIG=y
BR2_LINUX_KERNEL_CUSTOM_CONFIG_FILE="board/silan/sc8925/sc8925_defconfig"
BR2_LINUX_KERNEL_VMLINUX=y
BR2_LINUX_KERNEL_DTS_SUPPORT=y
BR2_LINUX_KERNEL_USE_CUSTOM_DTS=y
BR2_LINUX_KERNEL_CUSTOM_DTS_PATH="board/silan/sc8925/sc8925.dts"
BR2_LINUX_KERNEL_EXT_CSKY_ARCH=y
BR2_LINUX_KERNEL_EXT_CSKY_ARCH_GIT=y
BR2_LINUX_KERNEL_EXT_CSKY_ARCH_VERSION="master"
BR2_LINUX_KERNEL_EXT_CSKY_ARCH_GIT_URL="ssh://${GITUSER}@192.168.0.78:29418/os/linux-csky"
BR2_LINUX_KERNEL_EXT_CSKY_ADDONS=y
BR2_LINUX_KERNEL_EXT_CSKY_ADDONS_GIT=y
BR2_LINUX_KERNEL_EXT_CSKY_ADDONS_VERSION="master"
BR2_LINUX_KERNEL_EXT_CSKY_ADDONS_GIT_URL="ssh://${GITUSER}@192.168.0.78:29418/os/linux-csky-addons-vendors"
BR2_PACKAGE_BUSYBOX_CONFIG="board/csky-qa/busybox-linux.config"
BR2_PACKAGE_BUSYBOX_SHOW_OTHERS=y
BR2_PACKAGE_E2FSPROGS=y
BR2_PACKAGE_PYTHON=y
BR2_PACKAGE_PYTHON_GPIO=y
BR2_PACKAGE_PYTHON_PEXPECT=y
BR2_PACKAGE_ZLIB=y
BR2_PACKAGE_POPT=y
BR2_PACKAGE_BASH=y
BR2_PACKAGE_HOST_CSKY_DEBUG=y
```

## configs/csky_sc8925_tianyajian_gerrit_gcc6_defconfig
```kconfig
BR2_csky=y
BR2_ck810=y
BR2_CSKY_FPU=y
BR2_OPTIMIZE_2=y
BR2_PACKAGE_OVERRIDE_FILE="board/csky/tianyajian/local.mk"
BR2_TOOLCHAIN_EXTERNAL=y
BR2_TOOLCHAIN_EXTERNAL_CUSTOM=y
BR2_TOOLCHAIN_EXTERNAL_DOWNLOAD=y
BR2_TOOLCHAIN_EXTERNAL_URL="csky-abiv2-linux-tools-x86_64-glibc-linux-3.0.8-20180127.tar.gz"
BR2_TOOLCHAIN_EXTERNAL_CUSTOM_PREFIX="csky-abiv2-linux"
BR2_TOOLCHAIN_EXTERNAL_GCC_6=y
BR2_TOOLCHAIN_EXTERNAL_HEADERS_3_0=y
BR2_TOOLCHAIN_EXTERNAL_CUSTOM_GLIBC=y
BR2_TARGET_OPTIMIZATION="-mhard-float"
BR2_ROOTFS_DEVICE_CREATION_DYNAMIC_MDEV=y
BR2_ROOTFS_OVERLAY="board/csky/tianyajian/fs-overlay"
BR2_ROOTFS_POST_IMAGE_SCRIPT="board/csky/tianyajian/post-image.sh"
BR2_LINUX_KERNEL=y
BR2_LINUX_KERNEL_CUSTOM_GIT=y
BR2_LINUX_KERNEL_CUSTOM_REPO_URL="ssh://${GITUSER}@192.168.0.78:29418/os/linux"
BR2_LINUX_KERNEL_CUSTOM_REPO_VERSION="csky-linux-v3.0.8-sc8925-LTS"
BR2_LINUX_KERNEL_USE_CUSTOM_CONFIG=y
BR2_LINUX_KERNEL_CUSTOM_CONFIG_FILE="board/csky/tianyajian/linux-gcc6.config"
BR2_LINUX_KERNEL_VMLINUX=y
BR2_PACKAGE_BUSYBOX_CONFIG="board/csky/tianyajian/busybox.config"
BR2_PACKAGE_E2FSPROGS=y
BR2_PACKAGE_E2FSPROGS_E2IMAGE=y
BR2_PACKAGE_FB_TEST_APP=y
BR2_PACKAGE_EVTEST=y
BR2_PACKAGE_PICOCOM=y
BR2_PACKAGE_LIBPTHREAD_STUBS=y
BR2_PACKAGE_ETHTOOL=y
BR2_TARGET_ROOTFS_INITRAMFS=y
BR2_PACKAGE_HOST_GENEXT2FS=y
BR2_PACKAGE_HOST_UBOOT_TOOLS=y
BR2_PACKAGE_HOST_CSKY_DEBUG=y
```

## configs/csky_sc8925_uclibc_test_defconfig
```kconfig
BR2_csky=y
BR2_ck810=y
BR2_CSKY_FPU=y
BR2_OPTIMIZE_2=y
BR2_SHARED_STATIC_LIBS=y
BR2_TOOLCHAIN_EXTERNAL_CUSTOM=y
BR2_TOOLCHAIN_EXTERNAL_PATH="$(TOPDIR)/../install"
BR2_TOOLCHAIN_EXTERNAL_LOCALE=y
# BR2_TOOLCHAIN_EXTERNAL_HAS_THREADS_DEBUG is not set
BR2_TOOLCHAIN_EXTERNAL_CUSTOM_PREFIX="$(ARCH)-abiv2-linux"
BR2_TOOLCHAIN_EXTERNAL_GCC_4_5=y
BR2_TOOLCHAIN_EXTERNAL_HEADERS_4_9=y
BR2_TARGET_GENERIC_GETTY_PORT="ttyAMA0"
BR2_ROOTFS_OVERLAY="board/csky-qa/fs-overlay/"
BR2_LINUX_KERNEL=y
BR2_LINUX_KERNEL_CUSTOM_VERSION=y
BR2_LINUX_KERNEL_CUSTOM_VERSION_VALUE="4.9.25"
BR2_LINUX_KERNEL_USE_CUSTOM_CONFIG=y
BR2_LINUX_KERNEL_CUSTOM_CONFIG_FILE="board/silan/sc8925/sc8925_defconfig"
BR2_LINUX_KERNEL_VMLINUX=y
BR2_LINUX_KERNEL_DTS_SUPPORT=y
BR2_LINUX_KERNEL_USE_CUSTOM_DTS=y
BR2_LINUX_KERNEL_CUSTOM_DTS_PATH="board/silan/sc8925/sc8925.dts"
BR2_LINUX_KERNEL_EXT_CSKY_ARCH=y
BR2_LINUX_KERNEL_EXT_CSKY_ARCH_GIT=y
BR2_LINUX_KERNEL_EXT_CSKY_ARCH_VERSION="master"
BR2_LINUX_KERNEL_EXT_CSKY_ARCH_GIT_URL="ssh://${GITUSER}@192.168.0.78:29418/os/linux-csky"
BR2_LINUX_KERNEL_EXT_CSKY_ADDONS=y
BR2_LINUX_KERNEL_EXT_CSKY_ADDONS_GIT=y
BR2_LINUX_KERNEL_EXT_CSKY_ADDONS_VERSION="master"
BR2_LINUX_KERNEL_EXT_CSKY_ADDONS_GIT_URL="ssh://${GITUSER}@192.168.0.78:29418/os/linux-csky-addons-vendors"
BR2_PACKAGE_BUSYBOX_SHOW_OTHERS=y
BR2_PACKAGE_DOSFSTOOLS=y
BR2_PACKAGE_DOSFSTOOLS_MKFS_FAT=y
BR2_PACKAGE_E2FSPROGS=y
BR2_PACKAGE_ZLIB=y
BR2_PACKAGE_POPT=y
BR2_PACKAGE_BASH=y
BR2_PACKAGE_HOST_CSKY_DEBUG=y
```

## configs/csky_trilobite_defconfig
```kconfig
BR2_csky=y
BR2_ck810=y
BR2_OPTIMIZE_2=y
BR2_SHARED_STATIC_LIBS=y
BR2_TOOLCHAIN_EXTERNAL=y
BR2_TOOLCHAIN_EXTERNAL_DOWNLOAD=y
BR2_TOOLCHAIN_EXTERNAL_URL="https://github.com/c-sky/tools/raw/master/csky-abiv2-linux-tools-x86_64-glibc-linux-4.9.2-20170228.tar.gz"
BR2_TOOLCHAIN_EXTERNAL_CUSTOM_PREFIX="csky-abiv2-linux"
BR2_TOOLCHAIN_EXTERNAL_GCC_4_5=y
BR2_TOOLCHAIN_EXTERNAL_HEADERS_4_9=y
BR2_TOOLCHAIN_EXTERNAL_CUSTOM_GLIBC=y
BR2_TOOLCHAIN_EXTERNAL_CXX=y
BR2_TARGET_GENERIC_GETTY_PORT="ttyS0"
BR2_ROOTFS_POST_SCRIPT_ARGS="trilobite"
BR2_LINUX_KERNEL=y
BR2_LINUX_KERNEL_USE_CUSTOM_CONFIG=y
BR2_LINUX_KERNEL_CUSTOM_CONFIG_FILE="board/csky/trilobite/trilobite_defconfig"
BR2_LINUX_KERNEL_VMLINUX=y
BR2_LINUX_KERNEL_DTS_SUPPORT=y
BR2_LINUX_KERNEL_USE_CUSTOM_DTS=y
BR2_LINUX_KERNEL_CUSTOM_DTS_PATH="board/csky/trilobite/trilobite.dts"
BR2_LINUX_KERNEL_EXT_CSKY_ARCH=y
BR2_LINUX_KERNEL_EXT_CSKY_ARCH_VERSION="3698631fc2d67209f1fce7fff3c0344880260d08"
BR2_LINUX_KERNEL_EXT_CSKY_ADDONS=y
BR2_LINUX_KERNEL_EXT_CSKY_ADDONS_VERSION="3753cb1e16dbb3a568bb262f87f45a6e392df71b"
BR2_PACKAGE_HOST_MKE2IMG=y
```

## configs/csky_ytlf_defconfig
```kconfig
BR2_csky=y
BR2_ck810=y
BR2_CSKY_FPU=y
BR2_OPTIMIZE_2=y
BR2_PACKAGE_OVERRIDE_FILE="board/csky/kdgd/local.mk"
BR2_GLOBAL_PATCH_DIR="board/csky/common/linux-$(BR2_LINUX_KERNEL_CUSTOM_VERSION_VALUE)-patches"
BR2_ROOTFS_DEVICE_CREATION_DYNAMIC_MDEV=y
BR2_ROOTFS_OVERLAY="board/csky/kdgd/fs-overlay"
BR2_LINUX_KERNEL=y
BR2_LINUX_KERNEL_CUSTOM_VERSION=y
BR2_LINUX_KERNEL_CUSTOM_VERSION_VALUE="4.9.56"
BR2_LINUX_KERNEL_USE_CUSTOM_CONFIG=y
BR2_LINUX_KERNEL_CUSTOM_CONFIG_FILE="board/csky/ytlf/ytlf_defconfig"
BR2_LINUX_KERNEL_VMLINUX=y
BR2_LINUX_KERNEL_DTS_SUPPORT=y
BR2_LINUX_KERNEL_USE_CUSTOM_DTS=y
BR2_LINUX_KERNEL_CUSTOM_DTS_PATH="board/csky/ytlf/ytlf.dts"
BR2_LINUX_KERNEL_EXT_CSKY_ARCH=y
BR2_LINUX_KERNEL_EXT_CSKY_ARCH_GIT=y
BR2_LINUX_KERNEL_EXT_CSKY_ARCH_GIT_URL="https://github.com/c-sky/csky-linux.git"
BR2_LINUX_KERNEL_EXT_CSKY_ADDONS=y
BR2_LINUX_KERNEL_EXT_CSKY_ADDONS_GIT=y
BR2_LINUX_KERNEL_EXT_CSKY_ADDONS_VERSION="9fd2d0556a2cbc0dd563799380b2f6d3ccc3cebe"
BR2_LINUX_KERNEL_EXT_CSKY_ADDONS_GIT_URL="https://github.com/c-sky/linux-csky-addons.git"
BR2_TARGET_ROOTFS_INITRAMFS=y
BR2_PACKAGE_HOST_UBOOT_TOOLS=y
BR2_PACKAGE_HOST_CSKY_DEBUG=y
BR2_TOOLCHAIN_EXTERNAL=y
```
