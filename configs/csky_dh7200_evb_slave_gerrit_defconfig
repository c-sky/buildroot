## configs/csky_eragon_defconfig
```kconfig
BR2_csky=y
BR2_ck807=y
BR2_CSKY_FPU=y
BR2_OPTIMIZE_2=y
BR2_PACKAGE_OVERRIDE_FILE="board/csky/eragon/local.mk"
BR2_GLOBAL_PATCH_DIR="board/csky/eragon/patches"
BR2_ROOTFS_DEVICE_CREATION_DYNAMIC_MDEV=y
BR2_ROOTFS_OVERLAY="board/csky/eragon/fs-overlay"
BR2_LINUX_KERNEL=y
BR2_LINUX_KERNEL_CUSTOM_VERSION=y
BR2_LINUX_KERNEL_CUSTOM_VERSION_VALUE="4.9.25"
BR2_LINUX_KERNEL_USE_CUSTOM_CONFIG=y
BR2_LINUX_KERNEL_CUSTOM_CONFIG_FILE="board/csky/eragon/eragon_defconfig"
BR2_LINUX_KERNEL_DTS_SUPPORT=y
BR2_LINUX_KERNEL_USE_CUSTOM_DTS=y
BR2_LINUX_KERNEL_CUSTOM_DTS_PATH="board/csky/eragon/eragon.dts"
BR2_LINUX_KERNEL_EXT_CSKY_ARCH=y
BR2_LINUX_KERNEL_EXT_CSKY_ARCH_GIT=y
BR2_LINUX_KERNEL_EXT_CSKY_ARCH_VERSION="f9e7136cb0a37de50dd6c392d49c62901f351766"
BR2_LINUX_KERNEL_EXT_CSKY_ARCH_GIT_URL="ssh://${GITUSER}@192.168.0.78:29418/os/linux-csky"
BR2_LINUX_KERNEL_EXT_CSKY_ADDONS=y
BR2_LINUX_KERNEL_EXT_CSKY_ADDONS_GIT=y
BR2_LINUX_KERNEL_EXT_CSKY_ADDONS_VERSION="c3bf41b3b3d9f94a054185d2dea599ab739b669b"
BR2_LINUX_KERNEL_EXT_CSKY_ADDONS_GIT_URL="ssh://${GITUSER}@192.168.0.78:29418/os/linux-csky-addons"
BR2_PACKAGE_BUSYBOX_CONFIG="board/csky/eragon/busybox_defconfig"
BR2_PACKAGE_FB_TEST_APP=y
BR2_PACKAGE_PICOCOM=y
BR2_TARGET_ROOTFS_INITRAMFS=y
BR2_TARGET_UBOOT=y
BR2_TARGET_UBOOT_BUILD_SYSTEM_KCONFIG=y
BR2_TARGET_UBOOT_CUSTOM_GIT=y
BR2_TARGET_UBOOT_CUSTOM_REPO_URL="ssh://${GITUSER}@192.168.0.78:29418/os/u-boot"
BR2_TARGET_UBOOT_CUSTOM_REPO_VERSION="927521513b2a28e2d10fadba9653eb105349a4e3"
BR2_TARGET_UBOOT_BOARD_DEFCONFIG="eragon"
BR2_PACKAGE_HOST_CSKY_DEBUG=y
```

## configs/csky_eragon_evb_defconfig
```kconfig
BR2_csky=y
BR2_ck807=y
BR2_CSKY_FPU=y
BR2_OPTIMIZE_2=y
BR2_PACKAGE_OVERRIDE_FILE="board/csky/eragon_evb/local.mk"
BR2_GLOBAL_PATCH_DIR="board/csky/common/linux-$(BR2_LINUX_KERNEL_CUSTOM_VERSION_VALUE)-patches"
BR2_TOOLCHAIN_EXTERNAL_GDB_SERVER_COPY=y
BR2_ROOTFS_DEVICE_CREATION_DYNAMIC_MDEV=y
BR2_ROOTFS_OVERLAY="board/csky/eragon_evb/fs-overlay"
BR2_ROOTFS_POST_IMAGE_SCRIPT="board/csky/eragon_evb/post-image.sh"
BR2_LINUX_KERNEL=y
BR2_LINUX_KERNEL_CUSTOM_VERSION=y
BR2_LINUX_KERNEL_CUSTOM_VERSION_VALUE="4.9.56"
BR2_LINUX_KERNEL_USE_CUSTOM_CONFIG=y
BR2_LINUX_KERNEL_CUSTOM_CONFIG_FILE="board/csky/eragon_evb/linux.config"
BR2_LINUX_KERNEL_DTS_SUPPORT=y
BR2_LINUX_KERNEL_USE_CUSTOM_DTS=y
BR2_LINUX_KERNEL_CUSTOM_DTS_PATH="board/csky/eragon_evb/eragon_evb.dts board/csky/eragon_evb/*.dtsi"
BR2_LINUX_KERNEL_EXT_CSKY_ARCH=y
BR2_LINUX_KERNEL_EXT_CSKY_ADDONS=y
BR2_LINUX_KERNEL_EXT_CSKY_ADDONS_GIT=y
BR2_LINUX_KERNEL_EXT_CSKY_ADDONS_VERSION="8c28cd29ac01f0d90ed9f76980981e72fa3880d0"
BR2_LINUX_KERNEL_EXT_CSKY_ADDONS_GIT_URL="https://github.com/c-sky/linux-csky-addons.git"
BR2_LINUX_KERNEL_EXT_CSKY_EXAMPLES=y
BR2_LINUX_KERNEL_EXT_CSKY_EXAMPLES_GIT=y
BR2_LINUX_KERNEL_EXT_CSKY_EXAMPLES_VERSION="54fec815ac77ea79bc0d711266b8dcba6adcc4d1"
BR2_LINUX_KERNEL_EXT_CSKY_EXAMPLES_GIT_URL="https://github.com/c-sky/linux-sdk-examples.git"
BR2_PACKAGE_BUSYBOX_CONFIG="board/csky/eragon_evb/busybox.config"
BR2_PACKAGE_ALSA_UTILS=y
# BR2_PACKAGE_ALSA_UTILS_ALSAMIXER is not set
BR2_PACKAGE_ALSA_UTILS_AMIXER=y
BR2_PACKAGE_ALSA_UTILS_APLAY=y
BR2_PACKAGE_FFMPEG=y
BR2_PACKAGE_E2FSPROGS=y
BR2_PACKAGE_E2FSPROGS_E2IMAGE=y
BR2_PACKAGE_FB_TEST_APP=y
BR2_PACKAGE_PICOCOM=y
BR2_PACKAGE_ETHTOOL=y
BR2_PACKAGE_OPENSSH=y
BR2_TARGET_ROOTFS_INITRAMFS=y
BR2_TARGET_UBOOT=y
BR2_TARGET_UBOOT_BUILD_SYSTEM_KCONFIG=y
BR2_TARGET_UBOOT_CUSTOM_GIT=y
BR2_TARGET_UBOOT_CUSTOM_REPO_URL="https://github.com/c-sky/csky_uboot.git"
BR2_TARGET_UBOOT_CUSTOM_REPO_VERSION="2e7deb69a45c74bf27d501f313808869b556a6c4"
BR2_TARGET_UBOOT_BOARD_DEFCONFIG="eragon_asic"
BR2_TARGET_UBOOT_SPL=y
BR2_PACKAGE_HOST_GENEXT2FS=y
BR2_PACKAGE_HOST_CSKY_DEBUG=y
```

## configs/csky_eragon_evb_gerrit_defconfig
```kconfig
BR2_csky=y
BR2_ck807=y
BR2_CSKY_FPU=y
BR2_OPTIMIZE_2=y
BR2_PACKAGE_OVERRIDE_FILE="board/csky/eragon_evb/local.mk"
BR2_GLOBAL_PATCH_DIR="board/csky/common/linux-$(BR2_LINUX_KERNEL_CUSTOM_VERSION_VALUE)-patches"
BR2_TOOLCHAIN_EXTERNAL_GDB_SERVER_COPY=y
BR2_ROOTFS_DEVICE_CREATION_DYNAMIC_MDEV=y
BR2_ROOTFS_OVERLAY="board/csky/eragon_evb/fs-overlay"
BR2_ROOTFS_POST_IMAGE_SCRIPT="board/csky/eragon_evb/post-image.sh"
BR2_LINUX_KERNEL=y
BR2_LINUX_KERNEL_CUSTOM_VERSION=y
BR2_LINUX_KERNEL_CUSTOM_VERSION_VALUE="4.9.56"
BR2_LINUX_KERNEL_USE_CUSTOM_CONFIG=y
BR2_LINUX_KERNEL_CUSTOM_CONFIG_FILE="board/csky/eragon_evb/linux.config"
BR2_LINUX_KERNEL_DTS_SUPPORT=y
BR2_LINUX_KERNEL_USE_CUSTOM_DTS=y
BR2_LINUX_KERNEL_CUSTOM_DTS_PATH="board/csky/eragon_evb/eragon_evb.dts board/csky/eragon_evb/*.dtsi"
BR2_LINUX_KERNEL_EXT_CSKY_ARCH=y
BR2_LINUX_KERNEL_EXT_CSKY_ARCH_GIT=y
BR2_LINUX_KERNEL_EXT_CSKY_ARCH_GIT_URL="ssh://${GITUSER}@192.168.0.78:29418/os/linux-csky"
BR2_LINUX_KERNEL_EXT_CSKY_ADDONS=y
BR2_LINUX_KERNEL_EXT_CSKY_ADDONS_GIT=y
BR2_LINUX_KERNEL_EXT_CSKY_ADDONS_VERSION="94fc363f9ca3cf0dc48ee28f95572c27e74495bb"
BR2_LINUX_KERNEL_EXT_CSKY_ADDONS_GIT_URL="ssh://${GITUSER}@192.168.0.78:29418/os/linux-csky-addons"
BR2_LINUX_KERNEL_EXT_CSKY_EXAMPLES=y
BR2_LINUX_KERNEL_EXT_CSKY_EXAMPLES_GIT=y
BR2_LINUX_KERNEL_EXT_CSKY_EXAMPLES_VERSION="e31abcadc541306e78953f1eb7d59ff94635e7d7"
BR2_LINUX_KERNEL_EXT_CSKY_EXAMPLES_GIT_URL="ssh://${GITUSER}@192.168.0.78:29418/test/linux_driver"
BR2_PACKAGE_BUSYBOX_CONFIG="board/csky/eragon_evb/busybox.config"
BR2_PACKAGE_ALSA_UTILS=y
# BR2_PACKAGE_ALSA_UTILS_ALSAMIXER is not set
BR2_PACKAGE_ALSA_UTILS_AMIXER=y
BR2_PACKAGE_ALSA_UTILS_APLAY=y
BR2_PACKAGE_FFMPEG=y
BR2_PACKAGE_E2FSPROGS=y
BR2_PACKAGE_E2FSPROGS_E2IMAGE=y
BR2_PACKAGE_FB_TEST_APP=y
BR2_PACKAGE_PICOCOM=y
BR2_PACKAGE_ETHTOOL=y
BR2_PACKAGE_OPENSSH=y
BR2_TARGET_ROOTFS_INITRAMFS=y
BR2_TARGET_UBOOT=y
BR2_TARGET_UBOOT_BUILD_SYSTEM_KCONFIG=y
BR2_TARGET_UBOOT_CUSTOM_GIT=y
BR2_TARGET_UBOOT_CUSTOM_REPO_URL="ssh://${GITUSER}@192.168.0.78:29418/os/u-boot"
BR2_TARGET_UBOOT_CUSTOM_REPO_VERSION="2e7deb69a45c74bf27d501f313808869b556a6c4"
BR2_TARGET_UBOOT_BOARD_DEFCONFIG="eragon_asic"
BR2_TARGET_UBOOT_SPL=y
BR2_PACKAGE_HOST_GENEXT2FS=y
BR2_PACKAGE_HOST_CSKY_DEBUG=y
```

## configs/csky_eragon_ls_defconfig
```kconfig
BR2_csky=y
BR2_ck807=y
BR2_CSKY_FPU=y
BR2_OPTIMIZE_2=y
BR2_PACKAGE_OVERRIDE_FILE="board/csky/eragon_ls/local.mk"
BR2_GLOBAL_PATCH_DIR="board/csky/common/linux-$(BR2_LINUX_KERNEL_CUSTOM_VERSION_VALUE)-patches"
BR2_ROOTFS_DEVICE_CREATION_DYNAMIC_MDEV=y
BR2_ROOTFS_OVERLAY="board/csky/eragon_ls/fs-overlay"
BR2_LINUX_KERNEL=y
BR2_LINUX_KERNEL_CUSTOM_VERSION=y
BR2_LINUX_KERNEL_CUSTOM_VERSION_VALUE="4.9.25"
BR2_LINUX_KERNEL_USE_CUSTOM_CONFIG=y
BR2_LINUX_KERNEL_CUSTOM_CONFIG_FILE="board/csky/eragon_ls/linux.config"
BR2_LINUX_KERNEL_DTS_SUPPORT=y
BR2_LINUX_KERNEL_USE_CUSTOM_DTS=y
BR2_LINUX_KERNEL_CUSTOM_DTS_PATH="board/csky/eragon_ls/eragon_ls.dts"
BR2_LINUX_KERNEL_EXT_CSKY_ARCH=y
BR2_LINUX_KERNEL_EXT_CSKY_ARCH_GIT=y
BR2_LINUX_KERNEL_EXT_CSKY_ARCH_VERSION="59d499a7536ea63e2d5bce941d11c2c39a5b751c"
BR2_LINUX_KERNEL_EXT_CSKY_ARCH_GIT_URL="ssh://${GITUSER}@192.168.0.78:29418/os/linux-csky"
BR2_LINUX_KERNEL_EXT_CSKY_ADDONS=y
BR2_LINUX_KERNEL_EXT_CSKY_ADDONS_GIT=y
BR2_LINUX_KERNEL_EXT_CSKY_ADDONS_VERSION="f7b54252b3e1d586c2da4dd23fa5684801aec40d"
BR2_LINUX_KERNEL_EXT_CSKY_ADDONS_GIT_URL="ssh://${GITUSER}@192.168.0.78:29418/os/linux-csky-addons"
BR2_PACKAGE_BUSYBOX_CONFIG="board/csky/eragon_ls/busybox.config"
BR2_PACKAGE_ALSA_UTILS=y
# BR2_PACKAGE_ALSA_UTILS_ALSAMIXER is not set
BR2_PACKAGE_ALSA_UTILS_AMIXER=y
BR2_PACKAGE_ALSA_UTILS_APLAY=y
BR2_PACKAGE_FB_TEST_APP=y
BR2_PACKAGE_PICOCOM=y
BR2_TARGET_ROOTFS_INITRAMFS=y
BR2_TARGET_UBOOT=y
BR2_TARGET_UBOOT_BUILD_SYSTEM_KCONFIG=y
BR2_TARGET_UBOOT_CUSTOM_GIT=y
BR2_TARGET_UBOOT_CUSTOM_REPO_URL="ssh://${GITUSER}@192.168.0.78:29418/os/u-boot"
BR2_TARGET_UBOOT_CUSTOM_REPO_VERSION="f859116a85d854cffd6e7f0b46655443ee5d6496"
BR2_TARGET_UBOOT_BOARD_DEFCONFIG="eragon_ls"
BR2_PACKAGE_HOST_CSKY_DEBUG=y
```

## configs/csky_gx6605s_defconfig
```kconfig
BR2_csky=y
BR2_OPTIMIZE_2=y
BR2_GLOBAL_PATCH_DIR="board/nationalchip/gx66xx/patches"
BR2_TOOLCHAIN_EXTERNAL_GDB_SERVER_COPY=y
BR2_TARGET_GENERIC_GETTY_PORT="ttyS0"
BR2_ROOTFS_OVERLAY="board/nationalchip/gx66xx/fs-overlay/"
BR2_ROOTFS_POST_IMAGE_SCRIPT="board/nationalchip/gx66xx/post-image.sh"
BR2_LINUX_KERNEL=y
BR2_LINUX_KERNEL_CUSTOM_VERSION=y
BR2_LINUX_KERNEL_CUSTOM_VERSION_VALUE="4.9.25"
BR2_LINUX_KERNEL_DEFCONFIG="gx66xx"
BR2_LINUX_KERNEL_DTS_SUPPORT=y
BR2_LINUX_KERNEL_USE_CUSTOM_DTS=y
BR2_LINUX_KERNEL_CUSTOM_DTS_PATH="board/nationalchip/gx66xx/gx6605s.dts"
BR2_LINUX_KERNEL_EXT_CSKY_ARCH=y
BR2_LINUX_KERNEL_EXT_CSKY_ARCH_VERSION="2b45a8c810e5d4810b3daff21ce6929e9e28f828"
BR2_PACKAGE_LINUX_FIRMWARE=y
BR2_PACKAGE_LINUX_FIRMWARE_MEDIATEK_MT7601U=y
BR2_PACKAGE_EVTEST=y
BR2_PACKAGE_PYTHON=y
BR2_PACKAGE_PYTHON_GPIO=y
BR2_PACKAGE_IW=y
BR2_PACKAGE_WIRELESS_TOOLS=y
BR2_PACKAGE_WIRELESS_TOOLS_LIB=y
BR2_PACKAGE_WPA_SUPPLICANT=y
BR2_PACKAGE_WPA_SUPPLICANT_CLI=y
BR2_PACKAGE_WPA_SUPPLICANT_WPA_CLIENT_SO=y
BR2_PACKAGE_WPA_SUPPLICANT_PASSPHRASE=y
BR2_TARGET_ROOTFS_EXT2=y
BR2_TARGET_ROOTFS_EXT2_4=y
BR2_PACKAGE_HOST_DOSFSTOOLS=y
BR2_PACKAGE_HOST_GENIMAGE=y
BR2_PACKAGE_HOST_MTOOLS=y
BR2_PACKAGE_HOST_CSKY_DEBUG=y
```

## configs/csky_gx6605s_fbcon_defconfig
```kconfig
BR2_csky=y
BR2_OPTIMIZE_2=y
BR2_GLOBAL_PATCH_DIR="board/nationalchip/gx66xx/patches"
BR2_TARGET_GENERIC_GETTY_PORT="tty0"
BR2_ROOTFS_OVERLAY="board/nationalchip/gx66xx/fs-overlay/"
BR2_ROOTFS_POST_IMAGE_SCRIPT="board/nationalchip/gx66xx/post-image.sh"
BR2_LINUX_KERNEL=y
BR2_LINUX_KERNEL_CUSTOM_VERSION=y
BR2_LINUX_KERNEL_CUSTOM_VERSION_VALUE="4.9.56"
BR2_LINUX_KERNEL_DEFCONFIG="gx66xx"
BR2_LINUX_KERNEL_DTS_SUPPORT=y
BR2_LINUX_KERNEL_INTREE_DTS_NAME="gx6605s"
BR2_LINUX_KERNEL_EXT_CSKY_ARCH=y
BR2_LINUX_KERNEL_EXT_CSKY_ADDONS=y
BR2_PACKAGE_LINUX_FIRMWARE=y
BR2_PACKAGE_LINUX_FIRMWARE_MEDIATEK_MT7601U=y
BR2_PACKAGE_EVTEST=y
BR2_PACKAGE_PYTHON=y
BR2_PACKAGE_PYTHON_GPIO=y
BR2_PACKAGE_IW=y
BR2_PACKAGE_WIRELESS_TOOLS=y
BR2_PACKAGE_WIRELESS_TOOLS_LIB=y
BR2_PACKAGE_WPA_SUPPLICANT=y
BR2_PACKAGE_WPA_SUPPLICANT_CLI=y
BR2_PACKAGE_WPA_SUPPLICANT_WPA_CLIENT_SO=y
BR2_PACKAGE_WPA_SUPPLICANT_PASSPHRASE=y
BR2_TARGET_ROOTFS_EXT2=y
BR2_TARGET_ROOTFS_EXT2_4=y
BR2_PACKAGE_HOST_DOSFSTOOLS=y
BR2_PACKAGE_HOST_GENIMAGE=y
BR2_PACKAGE_HOST_MTOOLS=y
BR2_PACKAGE_HOST_CSKY_DEBUG=y
BR2_PACKAGE_HOST_LINUX_HEADERS_CUSTOM_4_9=y
BR2_TOOLCHAIN_BUILDROOT=y
BR2_TOOLCHAIN_BUILDROOT_UCLIBC=y
BR2_TOOLCHAIN_BUILDROOT_LIBC="uclibc"
BR2_TOOLCHAIN_BUILDROOT_CXX=y
BR2_TOOLCHAIN_BUILDROOT_WCHAR=y
BR2_TOOLCHAIN_BUILDROOT_LOCALE=y
BR2_PACKAGE_HOST_GDB=y
```

## configs/csky_gx6605s_glibc_test_defconfig
```kconfig
BR2_csky=y
BR2_OPTIMIZE_2=y
BR2_SHARED_STATIC_LIBS=y
BR2_GLOBAL_PATCH_DIR="board/nationalchip/gx66xx/patches"
BR2_TOOLCHAIN_EXTERNAL_CUSTOM=y
BR2_TOOLCHAIN_EXTERNAL_PATH="$(TOPDIR)/../../install"
BR2_TOOLCHAIN_EXTERNAL_GCC_6=y
BR2_TOOLCHAIN_EXTERNAL_HEADERS_4_9=y
BR2_TOOLCHAIN_EXTERNAL_CUSTOM_GLIBC=y
BR2_TARGET_GENERIC_GETTY_PORT="ttyS0"
BR2_ROOTFS_OVERLAY="board/csky-qa/fs-overlay/"
BR2_ROOTFS_POST_BUILD_SCRIPT="board/csky-qa/clean_lib.sh"
BR2_LINUX_KERNEL=y
BR2_LINUX_KERNEL_CUSTOM_VERSION=y
BR2_LINUX_KERNEL_CUSTOM_VERSION_VALUE="4.9.56"
BR2_LINUX_KERNEL_DEFCONFIG="gx66xx"
BR2_LINUX_KERNEL_DTS_SUPPORT=y
BR2_LINUX_KERNEL_USE_CUSTOM_DTS=y
BR2_LINUX_KERNEL_CUSTOM_DTS_PATH="board/nationalchip/gx66xx/gx6605s.dts"
BR2_LINUX_KERNEL_EXT_CSKY_ARCH=y
BR2_LINUX_KERNEL_EXT_CSKY_ARCH_GIT=y
BR2_LINUX_KERNEL_EXT_CSKY_ARCH_GIT_URL="ssh://${GITUSER}@192.168.0.78:29418/os/linux-csky"
BR2_PACKAGE_BUSYBOX_SHOW_OTHERS=y
BR2_PACKAGE_E2FSPROGS=y
BR2_PACKAGE_EVTEST=y
BR2_PACKAGE_BASH=y
BR2_TARGET_ROOTFS_INITRAMFS=y
BR2_TOOLCHAIN_EXTERNAL=y
BR2_PACKAGE_BUSYBOX_CONFIG_FRAGMENT_FILES="board/csky-qa/busybox.fragment"
```

## configs/csky_gx6605s_uclibc_test_defconfig
```kconfig
BR2_csky=y
BR2_OPTIMIZE_2=y
BR2_GLOBAL_PATCH_DIR="board/nationalchip/gx66xx/patches"
BR2_TOOLCHAIN_EXTERNAL_CUSTOM=y
BR2_TOOLCHAIN_EXTERNAL_PATH="$(TOPDIR)/../install"
BR2_TOOLCHAIN_EXTERNAL_LOCALE=y
# BR2_TOOLCHAIN_EXTERNAL_HAS_THREADS_DEBUG is not set
BR2_TOOLCHAIN_EXTERNAL_GCC_4_5=y
BR2_TOOLCHAIN_EXTERNAL_HEADERS_4_9=y
BR2_TARGET_GENERIC_GETTY_PORT="ttyS0"
BR2_TARGET_TZ_INFO=y
BR2_ROOTFS_OVERLAY="board/csky-qa/fs-overlay/"
BR2_ROOTFS_POST_IMAGE_SCRIPT="board/nationalchip/gx66xx/post-image.sh"
BR2_LINUX_KERNEL=y
BR2_LINUX_KERNEL_CUSTOM_VERSION=y
BR2_LINUX_KERNEL_CUSTOM_VERSION_VALUE="4.9.25"
BR2_LINUX_KERNEL_DEFCONFIG="gx66xx"
BR2_LINUX_KERNEL_DTS_SUPPORT=y
BR2_LINUX_KERNEL_USE_CUSTOM_DTS=y
BR2_LINUX_KERNEL_CUSTOM_DTS_PATH="board/nationalchip/gx66xx/gx6605s.dts"
BR2_LINUX_KERNEL_EXT_CSKY_ARCH=y
BR2_LINUX_KERNEL_EXT_CSKY_ARCH_GIT=y
BR2_LINUX_KERNEL_EXT_CSKY_ARCH_VERSION="master"
BR2_LINUX_KERNEL_EXT_CSKY_ARCH_GIT_URL="ssh://${GITUSER}@192.168.0.78:29418/os/linux-csky"
BR2_LINUX_KERNEL_EXT_CSKY_ADDONS=y
BR2_LINUX_KERNEL_EXT_CSKY_ADDONS_GIT=y
BR2_LINUX_KERNEL_EXT_CSKY_ADDONS_VERSION="master"
BR2_LINUX_KERNEL_EXT_CSKY_ADDONS_GIT_URL="ssh://${GITUSER}@192.168.0.78:29418/os/linux-csky-addons-vendors"
BR2_PACKAGE_BUSYBOX_SHOW_OTHERS=y
BR2_PACKAGE_DOSFSTOOLS=y
BR2_PACKAGE_DOSFSTOOLS_MKFS_FAT=y
BR2_PACKAGE_E2FSPROGS=y
BR2_PACKAGE_LINUX_FIRMWARE=y
BR2_PACKAGE_LINUX_FIRMWARE_MEDIATEK_MT7601U=y
BR2_PACKAGE_EVTEST=y
BR2_PACKAGE_PYTHON3=y
BR2_PACKAGE_PYTHON_GPIO=y
BR2_PACKAGE_ZLIB=y
BR2_PACKAGE_IW=y
BR2_PACKAGE_WIRELESS_TOOLS=y
BR2_PACKAGE_WIRELESS_TOOLS_LIB=y
BR2_PACKAGE_WPA_SUPPLICANT=y
BR2_PACKAGE_WPA_SUPPLICANT_CLI=y
BR2_PACKAGE_WPA_SUPPLICANT_WPA_CLIENT_SO=y
BR2_PACKAGE_WPA_SUPPLICANT_PASSPHRASE=y
BR2_PACKAGE_BASH=y
BR2_TARGET_ROOTFS_EXT2=y
BR2_TARGET_ROOTFS_EXT2_4=y
BR2_PACKAGE_HOST_DOSFSTOOLS=y
BR2_PACKAGE_HOST_GENIMAGE=y
BR2_PACKAGE_HOST_MTOOLS=y
BR2_PACKAGE_HOST_CSKY_DEBUG=y
```

## configs/csky_gx6622_bt_defconfig
```kconfig
BR2_csky=y
BR2_OPTIMIZE_2=y
BR2_SHARED_STATIC_LIBS=y
BR2_GLOBAL_PATCH_DIR="board/nationalchip/gx66xx/patches"
BR2_TARGET_GENERIC_GETTY_PORT="ttyS0"
BR2_ROOTFS_OVERLAY="board/nationalchip/gx66xx/fs-overlay/"
BR2_ROOTFS_POST_IMAGE_SCRIPT="board/nationalchip/gx66xx/post-image-ci.sh"
BR2_LINUX_KERNEL=y
BR2_LINUX_KERNEL_CUSTOM_VERSION=y
BR2_LINUX_KERNEL_CUSTOM_VERSION_VALUE="4.9.56"
BR2_LINUX_KERNEL_DEFCONFIG="gx66xx"
BR2_LINUX_KERNEL_DTS_SUPPORT=y
BR2_LINUX_KERNEL_USE_CUSTOM_DTS=y
BR2_LINUX_KERNEL_CUSTOM_DTS_PATH="board/nationalchip/gx66xx/gx6622.dts"
BR2_LINUX_KERNEL_EXT_CSKY_ARCH=y
BR2_PACKAGE_LINUX_FIRMWARE=y
BR2_PACKAGE_LINUX_FIRMWARE_MEDIATEK_MT7601U=y
BR2_PACKAGE_EVTEST=y
BR2_PACKAGE_PYTHON=y
BR2_PACKAGE_PYTHON_GPIO=y
BR2_PACKAGE_IW=y
BR2_PACKAGE_WIRELESS_TOOLS=y
BR2_PACKAGE_WIRELESS_TOOLS_LIB=y
BR2_PACKAGE_WPA_SUPPLICANT=y
BR2_PACKAGE_WPA_SUPPLICANT_CLI=y
BR2_PACKAGE_WPA_SUPPLICANT_WPA_CLIENT_SO=y
BR2_PACKAGE_WPA_SUPPLICANT_PASSPHRASE=y
BR2_PACKAGE_HOST_CSKY_DEBUG=y
BR2_PACKAGE_HOST_LINUX_HEADERS_CUSTOM_4_9=y
BR2_TOOLCHAIN_BUILDROOT=y
BR2_TOOLCHAIN_BUILDROOT_GLIBC=y
BR2_TOOLCHAIN_BUILDROOT_LIBC="glibc"
BR2_TOOLCHAIN_BUILDROOT_CXX=y
BR2_ROOTFS_DEVICE_CREATION_DYNAMIC_MDEV=y
BR2_PACKAGE_HOST_GDB=y
BR2_PACKAGE_CSKY_CI=y
BR2_PACKAGE_DHRYSTONE=y
BR2_PACKAGE_LMBENCH=y
BR2_PACKAGE_WHETSTONE=y
```
