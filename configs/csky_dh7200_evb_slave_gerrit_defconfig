## configs/csky_dh7200_evb_slave_gerrit_defconfig
```kconfig
BR2_csky=y
BR2_ck810=y
BR2_CSKY_FPU=y
BR2_OPTIMIZE_2=y
BR2_PACKAGE_OVERRIDE_FILE="board/csky/dh7200_evb_slave/local.mk"
BR2_TOOLCHAIN_EXTERNAL=y
BR2_TOOLCHAIN_EXTERNAL_CUSTOM=y
BR2_TOOLCHAIN_EXTERNAL_DOWNLOAD=y
BR2_TOOLCHAIN_EXTERNAL_URL="csky-abiv2-linux-tools-x86_64-glibc-linux-3.0.8-20180127.tar.gz"
BR2_TOOLCHAIN_EXTERNAL_CUSTOM_PREFIX="csky-abiv2-linux"
BR2_TOOLCHAIN_EXTERNAL_GCC_6=y
BR2_TOOLCHAIN_EXTERNAL_HEADERS_3_0=y
BR2_TOOLCHAIN_EXTERNAL_CUSTOM_GLIBC=y
BR2_TARGET_OPTIMIZATION="-mhard-float"
BR2_ROOTFS_DEVICE_CREATION_DYNAMIC_MDEV=y
BR2_ROOTFS_OVERLAY="board/csky/dh7200_evb_slave/fs-overlay"
BR2_ROOTFS_POST_IMAGE_SCRIPT="board/csky/dh7200_evb_slave/post-image.sh"
BR2_LINUX_KERNEL=y
BR2_LINUX_KERNEL_CUSTOM_GIT=y
BR2_LINUX_KERNEL_CUSTOM_REPO_URL="ssh://${GITUSER}@192.168.0.78:29418/os/linux"
BR2_LINUX_KERNEL_CUSTOM_REPO_VERSION="csky-linux-3.0.8-dh7200-20171026"
BR2_LINUX_KERNEL_USE_CUSTOM_CONFIG=y
BR2_LINUX_KERNEL_CUSTOM_CONFIG_FILE="board/csky/dh7200_evb_slave/linux.config"
BR2_PACKAGE_BUSYBOX_CONFIG="board/csky/dh7200_evb_slave/busybox.config"
BR2_PACKAGE_E2FSPROGS=y
BR2_PACKAGE_E2FSPROGS_E2IMAGE=y
BR2_PACKAGE_FB_TEST_APP=y
BR2_PACKAGE_EVTEST=y
BR2_PACKAGE_PICOCOM=y
BR2_PACKAGE_LIBPTHREAD_STUBS=y
BR2_PACKAGE_ETHTOOL=y
BR2_TARGET_ROOTFS_INITRAMFS=y
BR2_PACKAGE_HOST_GENEXT2FS=y
BR2_PACKAGE_HOST_CSKY_DEBUG=y
```

## configs/csky_eragon2_evb_gerrit_defconfig
```kconfig
BR2_csky=y
BR2_ck807=y
BR2_CSKY_FPU=y
BR2_OPTIMIZE_2=y
BR2_PACKAGE_OVERRIDE_FILE="board/csky/eragon2_evb/local.mk"
BR2_GLOBAL_PATCH_DIR="board/csky/common/linux-$(BR2_LINUX_KERNEL_CUSTOM_VERSION_VALUE)-patches"
BR2_TOOLCHAIN_BUILDROOT_GLIBC=y
BR2_PACKAGE_HOST_LINUX_HEADERS_CUSTOM_4_9=y
BR2_TOOLCHAIN_BUILDROOT_CXX=y
BR2_PACKAGE_HOST_GDB=y
BR2_ROOTFS_DEVICE_CREATION_DYNAMIC_MDEV=y
BR2_ROOTFS_OVERLAY="board/csky/eragon2_evb/fs-overlay"
BR2_ROOTFS_POST_IMAGE_SCRIPT="board/csky/eragon2_evb/post-image.sh"
BR2_LINUX_KERNEL=y
BR2_LINUX_KERNEL_CUSTOM_VERSION=y
BR2_LINUX_KERNEL_CUSTOM_VERSION_VALUE="4.9.56"
BR2_LINUX_KERNEL_USE_CUSTOM_CONFIG=y
BR2_LINUX_KERNEL_CUSTOM_CONFIG_FILE="board/csky/eragon2_evb/linux.config"
BR2_LINUX_KERNEL_DTS_SUPPORT=y
BR2_LINUX_KERNEL_USE_CUSTOM_DTS=y
BR2_LINUX_KERNEL_CUSTOM_DTS_PATH="board/csky/eragon2_evb/eragon2_evb.dts board/csky/eragon2_evb/*.dtsi"
BR2_LINUX_KERNEL_EXT_CSKY_ARCH=y
BR2_LINUX_KERNEL_EXT_CSKY_ARCH_GIT=y
BR2_LINUX_KERNEL_EXT_CSKY_ARCH_GIT_URL="ssh://${GITUSER}@192.168.0.78:29418/os/linux-csky"
BR2_LINUX_KERNEL_EXT_CSKY_ADDONS=y
BR2_LINUX_KERNEL_EXT_CSKY_ADDONS_GIT=y
BR2_LINUX_KERNEL_EXT_CSKY_ADDONS_VERSION="0e18b37081f48399f154badc945d672f9cecc875"
BR2_LINUX_KERNEL_EXT_CSKY_ADDONS_GIT_URL="ssh://${GITUSER}@192.168.0.78:29418/os/linux-csky-addons"
BR2_PACKAGE_BUSYBOX_CONFIG="board/csky/eragon2_evb/busybox.config"
BR2_PACKAGE_ALSA_UTILS=y
# BR2_PACKAGE_ALSA_UTILS_ALSAMIXER is not set
BR2_PACKAGE_ALSA_UTILS_AMIXER=y
BR2_PACKAGE_ALSA_UTILS_APLAY=y
BR2_PACKAGE_FFMPEG=y
BR2_PACKAGE_E2FSPROGS=y
BR2_PACKAGE_E2FSPROGS_E2IMAGE=y
BR2_PACKAGE_FB_TEST_APP=y
BR2_LINUX_KERNEL_EXT_CSKY_EXAMPLES=y
BR2_LINUX_KERNEL_EXT_CSKY_EXAMPLES_GIT=y
BR2_LINUX_KERNEL_EXT_CSKY_EXAMPLES_VERSION="26846cc390397d9bdc8da9aad74140dce9e11b7c"
BR2_LINUX_KERNEL_EXT_CSKY_EXAMPLES_GIT_URL="ssh://${GITUSER}@192.168.0.78:29418/test/linux_driver"
BR2_PACKAGE_PICOCOM=y
BR2_PACKAGE_LIBDRM=y
BR2_PACKAGE_ETHTOOL=y
BR2_TARGET_ROOTFS_INITRAMFS=y
BR2_TARGET_UBOOT=y
BR2_TARGET_UBOOT_BUILD_SYSTEM_KCONFIG=y
BR2_TARGET_UBOOT_CUSTOM_GIT=y
BR2_TARGET_UBOOT_CUSTOM_REPO_URL="ssh://${GITUSER}@192.168.0.78:29418/os/u-boot"
BR2_TARGET_UBOOT_CUSTOM_REPO_VERSION="2cf57cd3b70d0c5bb96083794ed0aeda604242ac"
BR2_TARGET_UBOOT_BOARD_DEFCONFIG="eragon2"
BR2_TARGET_UBOOT_SPL=y
BR2_PACKAGE_HOST_GENEXT2FS=y
BR2_PACKAGE_HOST_CSKY_DEBUG=y
```

## configs/csky_eragon2_gerrit_defconfig
```kconfig
BR2_csky=y
BR2_ck807=y
BR2_CSKY_FPU=y
BR2_CSKY_GERRIT_REPO=y
BR2_PACKAGE_CSKY_EXAMPLES=y
BR2_PACKAGE_CSKY_EXAMPLES_VERSION="5cfd4c3e5625adfc9912b6aabc25ba8c2117f71a"
BR2_OPTIMIZE_2=y
BR2_PACKAGE_OVERRIDE_FILE="board/csky/eragon2/local.mk"
BR2_GLOBAL_PATCH_DIR="board/csky/common/linux-$(BR2_LINUX_KERNEL_CUSTOM_VERSION_VALUE)-patches"
BR2_TOOLCHAIN_EXTERNAL=y
BR2_TOOLCHAIN_EXTERNAL_CUSTOM=y
BR2_TOOLCHAIN_EXTERNAL_DOWNLOAD=y
BR2_TOOLCHAIN_EXTERNAL_URL="https://gitlab.com/c-sky/buildroot/-/jobs/87906461/artifacts/raw/output/images/csky_toolchain_qemu_csky_ck807f_4.16_glibc_defconfig_bc18a18453dc2d3f112ca0597d83a7ce2e7fd488.tar.xz"
BR2_TOOLCHAIN_EXTERNAL_GCC_6=y
BR2_TOOLCHAIN_EXTERNAL_HEADERS_4_15=y
BR2_TOOLCHAIN_EXTERNAL_CUSTOM_GLIBC=y
BR2_TOOLCHAIN_EXTERNAL_CXX=y
BR2_TOOLCHAIN_EXTERNAL_GDB_SERVER_COPY=y
BR2_TARGET_OPTIMIZATION="-mhard-float"
BR2_ROOTFS_DEVICE_CREATION_DYNAMIC_MDEV=y
BR2_ROOTFS_OVERLAY="$(BASE_DIR)/build/linux-$(BR2_LINUX_KERNEL_CUSTOM_VERSION_VALUE)/addons/fs-overlay/eragon2"
BR2_ROOTFS_POST_IMAGE_SCRIPT="board/csky/eragon2/post-image.sh"
BR2_LINUX_KERNEL=y
BR2_LINUX_KERNEL_CUSTOM_VERSION=y
BR2_LINUX_KERNEL_CUSTOM_VERSION_VALUE="4.16.2"
BR2_LINUX_KERNEL_USE_CUSTOM_CONFIG=y
BR2_LINUX_KERNEL_CUSTOM_CONFIG_FILE="board/csky/eragon2/linux.config"
BR2_LINUX_KERNEL_DTS_SUPPORT=y
BR2_LINUX_KERNEL_USE_CUSTOM_DTS=y
BR2_LINUX_KERNEL_CUSTOM_DTS_PATH="board/csky/eragon2/eragon2.dts"
BR2_LINUX_KERNEL_EXT_CSKY_ARCH=y
BR2_LINUX_KERNEL_EXT_CSKY_ARCH_VERSION="e4b82844637109ba84f045b7ba63290709953544"
BR2_LINUX_KERNEL_EXT_CSKY_ADDONS=y
BR2_LINUX_KERNEL_EXT_CSKY_ADDONS_VERSION="b0355ffbd5689883966cd8bd4b5acc8c355167da"
BR2_PACKAGE_BUSYBOX_CONFIG="board/csky/eragon2/busybox.config"
BR2_PACKAGE_ALSA_UTILS=y
# BR2_PACKAGE_ALSA_UTILS_ALSAMIXER is not set
BR2_PACKAGE_ALSA_UTILS_AMIXER=y
BR2_PACKAGE_ALSA_UTILS_APLAY=y
BR2_PACKAGE_FFMPEG=y
BR2_PACKAGE_E2FSPROGS=y
BR2_PACKAGE_E2FSPROGS_E2IMAGE=y
BR2_PACKAGE_FB_TEST_APP=y
BR2_PACKAGE_PICOCOM=y
BR2_PACKAGE_LIBDRM=y
BR2_PACKAGE_ETHTOOL=y
BR2_TARGET_ROOTFS_INITRAMFS=y
BR2_TARGET_UBOOT=y
BR2_TARGET_UBOOT_BUILD_SYSTEM_KCONFIG=y
BR2_TARGET_UBOOT_CUSTOM_GIT=y
BR2_TARGET_UBOOT_CUSTOM_REPO_VERSION="2cf57cd3b70d0c5bb96083794ed0aeda604242ac"
BR2_TARGET_UBOOT_BOARD_DEFCONFIG="eragon2"
BR2_TARGET_UBOOT_SPL=y
BR2_PACKAGE_HOST_GENEXT2FS=y
BR2_PACKAGE_HOST_CSKY_DEBUG=y
```

## configs/csky_eragon2_scpu_evb_gerrit_defconfig
```kconfig
BR2_csky=y
BR2_ck807=y
BR2_CSKY_FPU=y
BR2_PACKAGE_CSKY_EXAMPLES=y
BR2_PACKAGE_CSKY_EXAMPLES_GIT=y
BR2_PACKAGE_CSKY_EXAMPLES_VERSION="5cfd4c3e5625adfc9912b6aabc25ba8c2117f71a"
BR2_PACKAGE_CSKY_EXAMPLES_GIT_URL="ssh://${GITUSER}@192.168.0.78:29418/test/linux_driver"
BR2_OPTIMIZE_2=y
BR2_PACKAGE_OVERRIDE_FILE="board/csky/eragon2_scpu_evb/local.mk"
BR2_GLOBAL_PATCH_DIR="board/csky/common/linux-$(BR2_LINUX_KERNEL_CUSTOM_VERSION_VALUE)-patches"
BR2_TOOLCHAIN_EXTERNAL=y
BR2_TOOLCHAIN_EXTERNAL_CUSTOM=y
BR2_TOOLCHAIN_EXTERNAL_DOWNLOAD=y
BR2_TOOLCHAIN_EXTERNAL_URL="https://gitlab.com/c-sky/buildroot/-/jobs/82846774/artifacts/raw/output/images/csky_toolchain_qemu_csky_ck807f_4.16_glibc_defconfig_5ee58647581fe712cc1cc1fc63c636a1af72fae4.tar.xz"
BR2_TOOLCHAIN_EXTERNAL_GCC_6=y
BR2_TOOLCHAIN_EXTERNAL_HEADERS_4_15=y
BR2_TOOLCHAIN_EXTERNAL_CUSTOM_GLIBC=y
BR2_TOOLCHAIN_EXTERNAL_CXX=y
BR2_TOOLCHAIN_EXTERNAL_GDB_SERVER_COPY=y
BR2_TARGET_OPTIMIZATION="-mhard-float"
BR2_ROOTFS_DEVICE_CREATION_DYNAMIC_MDEV=y
BR2_ROOTFS_OVERLAY="$(BASE_DIR)/build/linux-$(BR2_LINUX_KERNEL_CUSTOM_VERSION_VALUE)/addons/fs-overlay/eragon2_scpu_evb"
BR2_ROOTFS_POST_IMAGE_SCRIPT="board/csky/eragon2_evb/post-image.sh"
BR2_LINUX_KERNEL=y
BR2_LINUX_KERNEL_CUSTOM_VERSION=y
BR2_LINUX_KERNEL_CUSTOM_VERSION_VALUE="4.16.2"
BR2_LINUX_KERNEL_USE_CUSTOM_CONFIG=y
BR2_LINUX_KERNEL_CUSTOM_CONFIG_FILE="board/csky/eragon2_scpu_evb/linux.config"
BR2_LINUX_KERNEL_DTS_SUPPORT=y
BR2_LINUX_KERNEL_USE_CUSTOM_DTS=y
BR2_LINUX_KERNEL_CUSTOM_DTS_PATH="board/csky/eragon2_scpu_evb/eragon2_scpu_evb.dts board/csky/eragon2_scpu_evb/*.dtsi"
BR2_LINUX_KERNEL_EXT_CSKY_ARCH=y
BR2_LINUX_KERNEL_EXT_CSKY_ARCH_GIT=y
BR2_LINUX_KERNEL_EXT_CSKY_ARCH_VERSION="4d51829d4e8678cfaced40c98d0de7c19645f522"
BR2_LINUX_KERNEL_EXT_CSKY_ARCH_GIT_URL="ssh://${GITUSER}@192.168.0.78:29418/os/linux-csky"
BR2_LINUX_KERNEL_EXT_CSKY_ADDONS=y
BR2_LINUX_KERNEL_EXT_CSKY_ADDONS_GIT=y
BR2_LINUX_KERNEL_EXT_CSKY_ADDONS_VERSION="e169d3a5492251d5d12f0615d46d1413b2395617"
BR2_LINUX_KERNEL_EXT_CSKY_ADDONS_GIT_URL="ssh://${GITUSER}@192.168.0.78:29418/os/linux-csky-addons"
BR2_PACKAGE_BUSYBOX_CONFIG="board/csky/eragon2_scpu_evb/busybox.config"
BR2_PACKAGE_ALSA_UTILS=y
# BR2_PACKAGE_ALSA_UTILS_ALSAMIXER is not set
BR2_PACKAGE_ALSA_UTILS_AMIXER=y
BR2_PACKAGE_ALSA_UTILS_APLAY=y
BR2_PACKAGE_FFMPEG=y
BR2_PACKAGE_E2FSPROGS=y
BR2_PACKAGE_E2FSPROGS_E2IMAGE=y
BR2_PACKAGE_FB_TEST_APP=y
BR2_PACKAGE_PICOCOM=y
BR2_PACKAGE_LIBDRM=y
BR2_PACKAGE_ETHTOOL=y
BR2_TARGET_ROOTFS_INITRAMFS=y
BR2_TARGET_UBOOT=y
BR2_TARGET_UBOOT_BUILD_SYSTEM_KCONFIG=y
BR2_TARGET_UBOOT_CUSTOM_GIT=y
BR2_TARGET_UBOOT_CUSTOM_REPO_URL="ssh://${GITUSER}@192.168.0.78:29418/os/u-boot"
BR2_TARGET_UBOOT_CUSTOM_REPO_VERSION="a02a5c3f2f1baac91d6268725be2a84e88c6eb90"
BR2_TARGET_UBOOT_BOARD_DEFCONFIG="eragon2_scpu_asic"
BR2_TARGET_UBOOT_SPL=y
BR2_PACKAGE_HOST_GENEXT2FS=y
BR2_PACKAGE_HOST_CSKY_DEBUG=y
```

## configs/csky_eragon2_uclibc_test_defconfig
```kconfig
BR2_csky=y
BR2_ck807=y
BR2_CSKY_FPU=y
BR2_PACKAGE_CSKY_EXAMPLES=y
BR2_PACKAGE_CSKY_EXAMPLES_GIT=y
BR2_PACKAGE_CSKY_EXAMPLES_VERSION="5cfd4c3e5625adfc9912b6aabc25ba8c2117f71a"
BR2_PACKAGE_CSKY_EXAMPLES_GIT_URL="ssh://${GITUSER}@192.168.0.78:29418/test/linux_driver"
BR2_OPTIMIZE_2=y
BR2_PACKAGE_OVERRIDE_FILE="board/csky/eragon2_evb/local.mk"
BR2_GLOBAL_PATCH_DIR="board/csky/common/linux-$(BR2_LINUX_KERNEL_CUSTOM_VERSION_VALUE)-patches"
BR2_TOOLCHAIN_EXTERNAL=y
BR2_TOOLCHAIN_EXTERNAL_PREINSTALLED=y
BR2_TOOLCHAIN_EXTERNAL_PATH="$(TOPDIR)/../../install"
BR2_TOOLCHAIN_EXTERNAL_CSKY_UCLIBC=y
BR2_ROOTFS_DEVICE_CREATION_DYNAMIC_MDEV=y
BR2_ROOTFS_OVERLAY="board/csky-qa/fs-overlay/"
BR2_ROOTFS_POST_BUILD_SCRIPT="board/csky-qa/clean_lib.sh"
BR2_ROOTFS_POST_IMAGE_SCRIPT="board/csky/eragon2_evb/post-image.sh"
BR2_LINUX_KERNEL=y
BR2_LINUX_KERNEL_CUSTOM_VERSION=y
BR2_LINUX_KERNEL_CUSTOM_VERSION_VALUE="4.16.2"
BR2_LINUX_KERNEL_USE_CUSTOM_CONFIG=y
BR2_LINUX_KERNEL_CUSTOM_CONFIG_FILE="board/csky/eragon2_evb/linux.config"
BR2_LINUX_KERNEL_DTS_SUPPORT=y
BR2_LINUX_KERNEL_USE_CUSTOM_DTS=y
BR2_LINUX_KERNEL_CUSTOM_DTS_PATH="board/csky/eragon2_evb/eragon2_evb.dts board/csky/eragon2_evb/*.dtsi"
BR2_LINUX_KERNEL_EXT_CSKY_ARCH=y
BR2_LINUX_KERNEL_EXT_CSKY_ARCH_GIT=y
BR2_LINUX_KERNEL_EXT_CSKY_ARCH_VERSION="4d51829d4e8678cfaced40c98d0de7c19645f522"
BR2_LINUX_KERNEL_EXT_CSKY_ARCH_GIT_URL="ssh://${GITUSER}@192.168.0.78:29418/os/linux-csky"
BR2_LINUX_KERNEL_EXT_CSKY_ADDONS=y
BR2_LINUX_KERNEL_EXT_CSKY_ADDONS_GIT=y
BR2_LINUX_KERNEL_EXT_CSKY_ADDONS_VERSION="f8624dbd64fbb17139338d04a6a014647742feba"
BR2_LINUX_KERNEL_EXT_CSKY_ADDONS_GIT_URL="ssh://${GITUSER}@192.168.0.78:29418/os/linux-csky-addons"
BR2_PACKAGE_BUSYBOX_CONFIG="board/csky/eragon2_evb/busybox.config"
BR2_PACKAGE_BUSYBOX_CONFIG_FRAGMENT_FILES="board/csky-qa/busybox.fragment"
BR2_PACKAGE_ALSA_UTILS=y
# BR2_PACKAGE_ALSA_UTILS_ALSAMIXER is not set
BR2_PACKAGE_ALSA_UTILS_AMIXER=y
BR2_PACKAGE_ALSA_UTILS_APLAY=y
BR2_PACKAGE_FFMPEG=y
BR2_PACKAGE_E2FSPROGS=y
BR2_PACKAGE_E2FSPROGS_E2IMAGE=y
BR2_PACKAGE_FB_TEST_APP=y
BR2_PACKAGE_PICOCOM=y
BR2_PACKAGE_LIBDRM=y
BR2_PACKAGE_ETHTOOL=y
BR2_TARGET_ROOTFS_INITRAMFS=y
BR2_TARGET_UBOOT=y
BR2_TARGET_UBOOT_BUILD_SYSTEM_KCONFIG=y
BR2_TARGET_UBOOT_CUSTOM_GIT=y
BR2_TARGET_UBOOT_CUSTOM_REPO_URL="ssh://${GITUSER}@192.168.0.78:29418/os/u-boot"
BR2_TARGET_UBOOT_CUSTOM_REPO_VERSION="a02a5c3f2f1baac91d6268725be2a84e88c6eb90"
BR2_TARGET_UBOOT_BOARD_DEFCONFIG="eragon2_asic"
BR2_TARGET_UBOOT_SPL=y
BR2_PACKAGE_HOST_GENEXT2FS=y
BR2_PACKAGE_HOST_CSKY_DEBUG=y
```

## configs/csky_eragon3_gerrit_defconfig
```kconfig
BR2_csky=y
BR2_ck810=y
BR2_CSKY_FPU=y
BR2_CSKY_TEE=y
BR2_PACKAGE_CSKY_EXAMPLES=y
BR2_PACKAGE_CSKY_EXAMPLES_GIT=y
BR2_PACKAGE_CSKY_EXAMPLES_VERSION="53e121a2c287f97129205f6ba1c9510deaab722c"
BR2_PACKAGE_CSKY_EXAMPLES_GIT_URL="ssh://${GITUSER}@192.168.0.78:29418/test/linux_driver"
BR2_OPTIMIZE_2=y
BR2_PACKAGE_OVERRIDE_FILE="board/csky/eragon3/local.mk"
BR2_GLOBAL_PATCH_DIR="board/csky/common/linux-$(BR2_LINUX_KERNEL_CUSTOM_VERSION_VALUE)-patches"
BR2_TOOLCHAIN_EXTERNAL=y
BR2_TOOLCHAIN_EXTERNAL_CUSTOM=y
BR2_TOOLCHAIN_EXTERNAL_DOWNLOAD=y
BR2_TOOLCHAIN_EXTERNAL_URL="https://gitlab.com/c-sky/buildroot/-/jobs/78302783/artifacts/raw/output/images/csky_toolchain_qemu_csky_ck810f_4.16_glibc_defconfig_6335802b7b81ca1eab4b49b466e021838f18f773.tar.xz"
BR2_TOOLCHAIN_EXTERNAL_GCC_6=y
BR2_TOOLCHAIN_EXTERNAL_HEADERS_4_15=y
BR2_TOOLCHAIN_EXTERNAL_CUSTOM_GLIBC=y
BR2_TOOLCHAIN_EXTERNAL_CXX=y
BR2_PACKAGE_HOST_GDB=y
BR2_TARGET_OPTIMIZATION="-mhard-float"
BR2_ROOTFS_DEVICE_CREATION_DYNAMIC_MDEV=y
BR2_ROOTFS_OVERLAY="$(BASE_DIR)/build/linux-$(BR2_LINUX_KERNEL_CUSTOM_VERSION_VALUE)/addons/fs-overlay/eragon3"
BR2_ROOTFS_POST_IMAGE_SCRIPT="board/csky/eragon3/post-image.sh"
BR2_LINUX_KERNEL=y
BR2_LINUX_KERNEL_CUSTOM_VERSION=y
BR2_LINUX_KERNEL_CUSTOM_VERSION_VALUE="4.16.2"
BR2_LINUX_KERNEL_USE_CUSTOM_CONFIG=y
BR2_LINUX_KERNEL_CUSTOM_CONFIG_FILE="board/csky/eragon3/linux.config"
BR2_LINUX_KERNEL_DTS_SUPPORT=y
BR2_LINUX_KERNEL_USE_CUSTOM_DTS=y
BR2_LINUX_KERNEL_CUSTOM_DTS_PATH="board/csky/eragon3/eragon3.dts"
BR2_LINUX_KERNEL_EXT_CSKY_ARCH=y
BR2_LINUX_KERNEL_EXT_CSKY_ARCH_GIT=y
BR2_LINUX_KERNEL_EXT_CSKY_ARCH_VERSION="4eab702cc461d5110356b5839083ef009c3a5a58"
BR2_LINUX_KERNEL_EXT_CSKY_ARCH_GIT_URL="ssh://${GITUSER}@192.168.0.78:29418/os/linux-csky"
BR2_LINUX_KERNEL_EXT_CSKY_ADDONS=y
BR2_LINUX_KERNEL_EXT_CSKY_ADDONS_GIT=y
BR2_LINUX_KERNEL_EXT_CSKY_ADDONS_VERSION="6d4504b5482eea5b094600b211a24d4df605c71d"
BR2_LINUX_KERNEL_EXT_CSKY_ADDONS_GIT_URL="ssh://${GITUSER}@192.168.0.78:29418/os/linux-csky-addons"
BR2_PACKAGE_BUSYBOX_CONFIG="board/csky/eragon3/busybox.config"
BR2_PACKAGE_ALSA_UTILS=y
# BR2_PACKAGE_ALSA_UTILS_ALSAMIXER is not set
BR2_PACKAGE_ALSA_UTILS_AMIXER=y
BR2_PACKAGE_ALSA_UTILS_APLAY=y
BR2_PACKAGE_FFMPEG=y
BR2_PACKAGE_E2FSPROGS=y
BR2_PACKAGE_E2FSPROGS_E2IMAGE=y
BR2_PACKAGE_MMC_UTILS=y
BR2_PACKAGE_FB_TEST_APP=y
BR2_PACKAGE_PICOCOM=y
BR2_PACKAGE_ETHTOOL=y
BR2_TARGET_ROOTFS_INITRAMFS=y
BR2_TARGET_UBOOT=y
BR2_TARGET_UBOOT_BUILD_SYSTEM_KCONFIG=y
BR2_TARGET_UBOOT_CUSTOM_GIT=y
BR2_TARGET_UBOOT_CUSTOM_REPO_URL="ssh://${GITUSER}@192.168.0.78:29418/os/u-boot"
BR2_TARGET_UBOOT_CUSTOM_REPO_VERSION="f85d25fe94dcdd51a4a0eb9131c050a773dda4eb"
BR2_TARGET_UBOOT_BOARD_DEFCONFIG="eragon_asic"
BR2_TARGET_UBOOT_SPL=y
BR2_PACKAGE_HOST_GENEXT2FS=y
BR2_PACKAGE_HOST_CSKY_DEBUG=y
```
