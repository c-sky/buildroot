## configs/csky_ytlf_gerrit_defconfig
```kconfig
BR2_csky=y
BR2_ck810=y
BR2_CSKY_FPU=y
BR2_OPTIMIZE_2=y
BR2_PACKAGE_OVERRIDE_FILE="board/csky/ytlf/local.mk"
BR2_GLOBAL_PATCH_DIR="board/csky/common/linux-$(BR2_LINUX_KERNEL_CUSTOM_VERSION_VALUE)-patches"
BR2_PACKAGE_HOST_LINUX_HEADERS_CUSTOM_4_9=y
BR2_TOOLCHAIN_BUILDROOT_LOCALE=y
BR2_PTHREAD_DEBUG=y
BR2_TOOLCHAIN_BUILDROOT_USE_SSP=y
BR2_TOOLCHAIN_BUILDROOT_CXX=y
BR2_PACKAGE_HOST_GDB=y
BR2_ROOTFS_DEVICE_CREATION_DYNAMIC_MDEV=y
BR2_ROOTFS_OVERLAY="$(BASE_DIR)/build/linux-$(BR2_LINUX_KERNEL_CUSTOM_VERSION_VALUE)/addons/fs-overlay/ytlf"
BR2_ROOTFS_POST_IMAGE_SCRIPT="board/csky/ytlf/post-image.sh"
BR2_LINUX_KERNEL=y
BR2_LINUX_KERNEL_CUSTOM_VERSION=y
BR2_LINUX_KERNEL_CUSTOM_VERSION_VALUE="4.9.56"
BR2_LINUX_KERNEL_USE_CUSTOM_CONFIG=y
BR2_LINUX_KERNEL_CUSTOM_CONFIG_FILE="board/csky/ytlf/linux.config"
BR2_LINUX_KERNEL_DTS_SUPPORT=y
BR2_LINUX_KERNEL_USE_CUSTOM_DTS=y
BR2_LINUX_KERNEL_CUSTOM_DTS_PATH="board/csky/ytlf/ytlf-mini.dts"
BR2_LINUX_KERNEL_EXT_CSKY_ARCH=y
BR2_LINUX_KERNEL_EXT_CSKY_ARCH_GIT=y
BR2_LINUX_KERNEL_EXT_CSKY_ARCH_GIT_URL="ssh://${GITUSER}@192.168.0.78:29418/os/linux-csky"
BR2_LINUX_KERNEL_EXT_CSKY_ADDONS=y
BR2_LINUX_KERNEL_EXT_CSKY_ADDONS_GIT=y
BR2_LINUX_KERNEL_EXT_CSKY_ADDONS_VERSION="5173f1a7985550bfa24c3d9d32e2b04696064f58"
BR2_LINUX_KERNEL_EXT_CSKY_ADDONS_GIT_URL="ssh://${GITUSER}@192.168.0.78:29418/os/linux-csky-addons"
BR2_TARGET_ROOTFS_INITRAMFS=y
BR2_PACKAGE_HOST_CSKY_DEBUG=y
```

## configs/csky_ytlf_uclibc_test_defconfig
```kconfig
BR2_csky=y
BR2_ck810=y
BR2_CSKY_FPU=y
BR2_OPTIMIZE_2=y
BR2_PACKAGE_OVERRIDE_FILE="board/csky/ytlf/local.mk"
BR2_GLOBAL_PATCH_DIR="board/csky/common/linux-$(BR2_LINUX_KERNEL_CUSTOM_VERSION_VALUE)-patches"
BR2_TOOLCHAIN_EXTERNAL=y
BR2_TOOLCHAIN_EXTERNAL_PREINSTALLED=y
BR2_TOOLCHAIN_EXTERNAL_PATH="$(TOPDIR)/../../install"
BR2_TOOLCHAIN_EXTERNAL_CSKY_UCLIBC=y
BR2_ROOTFS_DEVICE_CREATION_DYNAMIC_MDEV=y
BR2_SYSTEM_BIN_SH_BASH=y
BR2_ROOTFS_OVERLAY="$(BASE_DIR)/build/linux-$(BR2_LINUX_KERNEL_CUSTOM_VERSION_VALUE)/addons/fs-overlay/ytlf"
BR2_ROOTFS_POST_BUILD_SCRIPT="board/csky-qa/clean_lib.sh"
BR2_ROOTFS_POST_IMAGE_SCRIPT="board/csky/ytlf/post-image.sh"
BR2_LINUX_KERNEL=y
BR2_LINUX_KERNEL_CUSTOM_VERSION=y
BR2_LINUX_KERNEL_CUSTOM_VERSION_VALUE="4.9.56"
BR2_LINUX_KERNEL_USE_CUSTOM_CONFIG=y
BR2_LINUX_KERNEL_CUSTOM_CONFIG_FILE="board/csky/ytlf/linux.config"
BR2_LINUX_KERNEL_DTS_SUPPORT=y
BR2_LINUX_KERNEL_USE_CUSTOM_DTS=y
BR2_LINUX_KERNEL_CUSTOM_DTS_PATH="board/csky/ytlf/ytlf-mini.dts"
BR2_LINUX_KERNEL_EXT_CSKY_ARCH=y
BR2_LINUX_KERNEL_EXT_CSKY_ADDONS=y
BR2_LINUX_KERNEL_EXT_CSKY_ADDONS_VERSION="841f3b89c1a48626698bee303375c2ef92b3ef23"
BR2_PACKAGE_BUSYBOX_CONFIG_FRAGMENT_FILES="board/csky-qa/busybox.fragment"
BR2_PACKAGE_BUSYBOX_SHOW_OTHERS=y
BR2_PACKAGE_E2FSPROGS=y
BR2_TARGET_ROOTFS_INITRAMFS=y
```

## configs/qemu_ck810_defconfig
```kconfig
BR2_csky=y
BR2_ck810=y
BR2_OPTIMIZE_2=y
BR2_SHARED_STATIC_LIBS=y
BR2_TOOLCHAIN_EXTERNAL=y
BR2_TOOLCHAIN_EXTERNAL_DOWNLOAD=y
BR2_TOOLCHAIN_EXTERNAL_URL="https://github.com/c-sky/tools/raw/master/csky-abiv2-linux-tools-x86_64-glibc-linux-4.9.2-20170228.tar.gz"
BR2_TOOLCHAIN_EXTERNAL_CUSTOM_PREFIX="csky-abiv2-linux"
BR2_TOOLCHAIN_EXTERNAL_GCC_4_5=y
BR2_TOOLCHAIN_EXTERNAL_HEADERS_4_9=y
BR2_TOOLCHAIN_EXTERNAL_CUSTOM_GLIBC=y
BR2_TOOLCHAIN_EXTERNAL_CXX=y
BR2_TARGET_ROOTFS_INITRAMFS=y
BR2_ROOTFS_DEVICE_TABLE="board/qemu/csky/device_table.txt"
BR2_ROOTFS_POST_SCRIPT_ARGS="csky"
BR2_LINUX_KERNEL=y
BR2_LINUX_KERNEL_CUSTOM_VERSION=y
BR2_LINUX_KERNEL_CUSTOM_VERSION_VALUE="4.9.25"
BR2_LINUX_KERNEL_USE_CUSTOM_CONFIG=y
BR2_LINUX_KERNEL_CUSTOM_CONFIG_FILE="board/qemu/csky/qemu_ck810_defconfig"
BR2_LINUX_KERNEL_VMLINUX=y
BR2_LINUX_KERNEL_DTS_SUPPORT=y
BR2_LINUX_KERNEL_USE_CUSTOM_DTS=y
BR2_LINUX_KERNEL_CUSTOM_DTS_PATH="board/qemu/csky/ck810.dts"
BR2_LINUX_KERNEL_EXT_CSKY_ARCH=y
BR2_LINUX_KERNEL_EXT_CSKY_ARCH_VERSION="69e9e4f2b547ac3cd438f41831d103d498fcf780"
BR2_LINUX_KERNEL_EXT_CSKY_ADDONS=y
BR2_LINUX_KERNEL_EXT_CSKY_ADDONS_VERSION="fecfa3e0511b5686b734fa999a20d0418761fc60"
BR2_PACKAGE_HOST_MKE2IMG=y
```

## configs/qemu_csky_ck610_defconfig
```kconfig
BR2_csky=y
BR2_OPTIMIZE_2=y
BR2_SHARED_STATIC_LIBS=y
BR2_TOOLCHAIN_EXTERNAL_GDB_SERVER_COPY=y
BR2_ROOTFS_DEVICE_TABLE="board/qemu/csky/device_table.txt"
BR2_ROOTFS_OVERLAY="board/qemu/csky/fs-overlay/"
BR2_LINUX_KERNEL=y
BR2_LINUX_KERNEL_CUSTOM_VERSION=y
BR2_LINUX_KERNEL_CUSTOM_VERSION_VALUE="4.9.25"
BR2_LINUX_KERNEL_USE_CUSTOM_CONFIG=y
BR2_LINUX_KERNEL_CUSTOM_CONFIG_FILE="board/qemu/csky/qemu_ck610_defconfig"
BR2_LINUX_KERNEL_VMLINUX=y
BR2_LINUX_KERNEL_DTS_SUPPORT=y
BR2_LINUX_KERNEL_USE_CUSTOM_DTS=y
BR2_LINUX_KERNEL_CUSTOM_DTS_PATH="board/qemu/csky/ck610.dts"
BR2_LINUX_KERNEL_EXT_CSKY_ARCH=y
BR2_LINUX_KERNEL_EXT_CSKY_ARCH_VERSION="59d499a7536ea63e2d5bce941d11c2c39a5b751c"
BR2_LINUX_KERNEL_EXT_CSKY_ADDONS=y
BR2_LINUX_KERNEL_EXT_CSKY_ADDONS_VERSION="f8bb730e035f9665b8a8cd0981c46b473f39c9a9"
BR2_PACKAGE_PYTHON=y
BR2_PACKAGE_PYTHON_GPIO=y
BR2_TARGET_ROOTFS_INITRAMFS=y
BR2_PACKAGE_HOST_MKE2IMG=y
BR2_PACKAGE_HOST_CSKY_QEMU=y
```

## configs/qemu_csky_ck610_uclibc_test_defconfig
```kconfig
BR2_csky=y
BR2_OPTIMIZE_2=y
BR2_SHARED_STATIC_LIBS=y
BR2_TOOLCHAIN_EXTERNAL_CUSTOM=y
BR2_TOOLCHAIN_EXTERNAL_PATH="$(TOPDIR)/../install"
BR2_TOOLCHAIN_EXTERNAL_LOCALE=y
# BR2_TOOLCHAIN_EXTERNAL_HAS_THREADS_DEBUG is not set
BR2_TOOLCHAIN_EXTERNAL_GCC_4_5=y
BR2_TOOLCHAIN_EXTERNAL_HEADERS_4_9=y
BR2_ROOTFS_DEVICE_TABLE="board/qemu/csky/device_table.txt"
BR2_ROOTFS_OVERLAY="board/csky-qa/fs-overlay/"
BR2_LINUX_KERNEL=y
BR2_LINUX_KERNEL_CUSTOM_VERSION=y
BR2_LINUX_KERNEL_CUSTOM_VERSION_VALUE="4.9.25"
BR2_LINUX_KERNEL_USE_CUSTOM_CONFIG=y
BR2_LINUX_KERNEL_CUSTOM_CONFIG_FILE="board/qemu/csky/qemu_ck610_defconfig"
BR2_LINUX_KERNEL_VMLINUX=y
BR2_LINUX_KERNEL_DTS_SUPPORT=y
BR2_LINUX_KERNEL_USE_CUSTOM_DTS=y
BR2_LINUX_KERNEL_CUSTOM_DTS_PATH="board/qemu/csky/ck610.dts"
BR2_LINUX_KERNEL_EXT_CSKY_ARCH=y
BR2_LINUX_KERNEL_EXT_CSKY_ARCH_GIT=y
BR2_LINUX_KERNEL_EXT_CSKY_ARCH_VERSION="master"
BR2_LINUX_KERNEL_EXT_CSKY_ARCH_GIT_URL="ssh://${GITUSER}@192.168.0.78:29418/os/linux-csky"
BR2_LINUX_KERNEL_EXT_CSKY_ADDONS=y
BR2_LINUX_KERNEL_EXT_CSKY_ADDONS_GIT=y
BR2_LINUX_KERNEL_EXT_CSKY_ADDONS_VERSION="master"
BR2_LINUX_KERNEL_EXT_CSKY_ADDONS_GIT_URL="ssh://${GITUSER}@192.168.0.78:29418/os/linux-csky-addons-vendors"
BR2_PACKAGE_BUSYBOX_SHOW_OTHERS=y
BR2_PACKAGE_DOSFSTOOLS=y
BR2_PACKAGE_DOSFSTOOLS_MKFS_FAT=y
BR2_PACKAGE_E2FSPROGS=y
BR2_PACKAGE_LIBFFI=y
BR2_PACKAGE_BASH=y
BR2_TARGET_ROOTFS_INITRAMFS=y
BR2_PACKAGE_HOST_MKE2IMG=y
BR2_PACKAGE_HOST_CSKY_QEMU=y
```

## configs/qemu_csky_ck807_4.16_uclibc_defconfig
```kconfig
BR2_csky=y
BR2_ck807=y
BR2_OPTIMIZE_2=y
BR2_SHARED_STATIC_LIBS=y
BR2_TOOLCHAIN_BUILDROOT_LOCALE=y
BR2_TOOLCHAIN_BUILDROOT_USE_SSP=y
BR2_TOOLCHAIN_BUILDROOT_CXX=y
BR2_ROOTFS_DEVICE_CREATION_DYNAMIC_MDEV=y
BR2_ROOTFS_DEVICE_TABLE="board/qemu/csky/device_table.txt"
BR2_ROOTFS_OVERLAY="board/qemu/csky/fs-overlay/"
BR2_LINUX_KERNEL=y
BR2_LINUX_KERNEL_CUSTOM_VERSION=y
BR2_LINUX_KERNEL_CUSTOM_VERSION_VALUE="4.16.2"
BR2_LINUX_KERNEL_USE_CUSTOM_CONFIG=y
BR2_LINUX_KERNEL_CUSTOM_CONFIG_FILE="board/qemu/csky/qemu_ck807_defconfig"
BR2_LINUX_KERNEL_VMLINUX=y
BR2_LINUX_KERNEL_DTS_SUPPORT=y
BR2_LINUX_KERNEL_USE_CUSTOM_DTS=y
BR2_LINUX_KERNEL_CUSTOM_DTS_PATH="board/qemu/csky/qemu.dts"
BR2_LINUX_KERNEL_EXT_CSKY_ARCH=y
BR2_PACKAGE_BUSYBOX_SHOW_OTHERS=y
BR2_PACKAGE_CSKY_CI=y
BR2_PACKAGE_HOST_GDB=y
BR2_PACKAGE_LTP_TESTSUITE=y
BR2_PACKAGE_BASH=y
BR2_TARGET_ROOTFS_INITRAMFS=y
BR2_PACKAGE_HOST_CSKY_QEMU=y
```

## configs/qemu_csky_ck807f_4.15_glibc_defconfig
```kconfig
BR2_csky=y
BR2_ck807=y
BR2_CSKY_FPU=y
BR2_TARGET_OPTIMIZATION="-mhard-float"
BR2_OPTIMIZE_2=y
BR2_SHARED_STATIC_LIBS=y
BR2_ROOTFS_DEVICE_TABLE="board/qemu/csky/device_table.txt"
BR2_ROOTFS_OVERLAY="board/qemu/csky/fs-overlay/"
BR2_LINUX_KERNEL=y
BR2_LINUX_KERNEL_CUSTOM_VERSION=y
BR2_LINUX_KERNEL_CUSTOM_VERSION_VALUE="4.15.15"
BR2_LINUX_KERNEL_USE_CUSTOM_CONFIG=y
BR2_LINUX_KERNEL_CUSTOM_CONFIG_FILE="board/qemu/csky/qemu_ck807_defconfig"
BR2_LINUX_KERNEL_VMLINUX=y
BR2_LINUX_KERNEL_DTS_SUPPORT=y
BR2_LINUX_KERNEL_USE_CUSTOM_DTS=y
BR2_LINUX_KERNEL_CUSTOM_DTS_PATH="board/qemu/csky/qemu.dts"
BR2_LINUX_KERNEL_EXT_CSKY_ARCH=y
BR2_PACKAGE_BUSYBOX_SHOW_OTHERS=y
BR2_PACKAGE_BASH=y
BR2_PACKAGE_HOST_CSKY_QEMU=y
BR2_PACKAGE_HOST_LINUX_HEADERS_CUSTOM_4_15=y
BR2_TOOLCHAIN_BUILDROOT=y
BR2_TOOLCHAIN_BUILDROOT_GLIBC=y
BR2_TOOLCHAIN_BUILDROOT_LIBC="glibc"
BR2_TARGET_ROOTFS_INITRAMFS=y
BR2_TOOLCHAIN_BUILDROOT_CXX=y
BR2_GCC_ENABLE_LTO=y
BR2_ROOTFS_DEVICE_CREATION_DYNAMIC_MDEV=y
BR2_PACKAGE_CSKY_CI=y
BR2_PACKAGE_LTP_TESTSUITE_ARCH_SUPPORTS=y
BR2_PACKAGE_LTP_TESTSUITE=y
```

## configs/qemu_csky_ck810_glibc_bt_defconfig
```kconfig
BR2_csky=y
BR2_ck810=y
BR2_OPTIMIZE_2=y
BR2_SHARED_STATIC_LIBS=y
BR2_TOOLCHAIN_EXTERNAL_CSKY_GLIBC=y
BR2_ROOTFS_DEVICE_TABLE="board/qemu/csky/device_table.txt"
BR2_ROOTFS_OVERLAY="board/qemu/csky/fs-overlay/"
BR2_LINUX_KERNEL=y
BR2_LINUX_KERNEL_CUSTOM_VERSION=y
BR2_LINUX_KERNEL_CUSTOM_VERSION_VALUE="4.14.15"
BR2_LINUX_KERNEL_USE_CUSTOM_CONFIG=y
BR2_LINUX_KERNEL_CUSTOM_CONFIG_FILE="board/qemu/csky/qemu_ck810_defconfig"
BR2_LINUX_KERNEL_VMLINUX=y
BR2_LINUX_KERNEL_DTS_SUPPORT=y
BR2_LINUX_KERNEL_USE_CUSTOM_DTS=y
BR2_LINUX_KERNEL_CUSTOM_DTS_PATH="board/qemu/csky/qemu.dts"
BR2_LINUX_KERNEL_EXT_CSKY_ARCH=y
BR2_PACKAGE_BUSYBOX_SHOW_OTHERS=y
BR2_PACKAGE_BASH=y
BR2_PACKAGE_HOST_CSKY_QEMU=y
BR2_PACKAGE_HOST_LINUX_HEADERS_CUSTOM_4_9=y
BR2_TOOLCHAIN_BUILDROOT=y
BR2_TOOLCHAIN_BUILDROOT_GLIBC=y
BR2_TOOLCHAIN_BUILDROOT_LIBC="glibc"
BR2_TARGET_ROOTFS_INITRAMFS=y
BR2_TOOLCHAIN_BUILDROOT_CXX=y
BR2_TOOLCHAIN_BUILDROOT_FORTRAN=y
BR2_GCC_ENABLE_LTO=y
BR2_GCC_ENABLE_OPENMP=y
BR2_ROOTFS_DEVICE_CREATION_DYNAMIC_MDEV=y
BR2_PACKAGE_LTP_TESTSUITE_ARCH_SUPPORTS=y
BR2_PACKAGE_LTP_TESTSUITE=y
BR2_PACKAGE_CSKY_TEST=y
```

## configs/qemu_csky_ck810_uclibc_bt_defconfig
```kconfig
BR2_csky=y
BR2_ck810=y
BR2_OPTIMIZE_2=y
BR2_SHARED_STATIC_LIBS=y
BR2_ROOTFS_DEVICE_TABLE="board/qemu/csky/device_table.txt"
BR2_ROOTFS_OVERLAY="board/qemu/csky/fs-overlay/"
BR2_LINUX_KERNEL=y
BR2_LINUX_KERNEL_CUSTOM_VERSION=y
BR2_LINUX_KERNEL_CUSTOM_VERSION_VALUE="4.9.56"
BR2_LINUX_KERNEL_USE_CUSTOM_CONFIG=y
BR2_LINUX_KERNEL_CUSTOM_CONFIG_FILE="board/qemu/csky/qemu_ck810_defconfig"
BR2_LINUX_KERNEL_VMLINUX=y
BR2_LINUX_KERNEL_DTS_SUPPORT=y
BR2_LINUX_KERNEL_USE_CUSTOM_DTS=y
BR2_LINUX_KERNEL_CUSTOM_DTS_PATH="board/qemu/csky/qemu.dts"
BR2_LINUX_KERNEL_EXT_CSKY_ARCH=y
BR2_PACKAGE_BUSYBOX_SHOW_OTHERS=y
BR2_PACKAGE_BASH=y
BR2_PACKAGE_HOST_CSKY_QEMU=y
BR2_PACKAGE_HOST_LINUX_HEADERS_CUSTOM_4_9=y
BBR2_TOOLCHAIN_BUILDROOT=y
BR2_TOOLCHAIN_BUILDROOT_UCLIBC=y
BR2_TOOLCHAIN_BUILDROOT_LIBC="uclibc"
BR2_TARGET_ROOTFS_INITRAMFS=y
BR2_TOOLCHAIN_BUILDROOT_CXX=y
BR2_TOOLCHAIN_BUILDROOT_WCHAR=y
BR2_TOOLCHAIN_BUILDROOT_LOCALE=y
BR2_ROOTFS_DEVICE_CREATION_DYNAMIC_MDEV=y
BR2_PACKAGE_CSKY_CI=y
BR2_PACKAGE_LTP_TESTSUITE_ARCH_SUPPORTS=y
BR2_PACKAGE_LTP_TESTSUITE=y
```

## configs/qemu_csky_ck810_uclibc_defconfig
```kconfig
BR2_csky=y
BR2_ck810=y
BR2_OPTIMIZE_2=y
BR2_SHARED_STATIC_LIBS=y
BR2_TOOLCHAIN_EXTERNAL_CSKY_UCLIBC=y
BR2_ROOTFS_DEVICE_TABLE="board/qemu/csky/device_table.txt"
BR2_ROOTFS_OVERLAY="board/qemu/csky/fs-overlay/"
BR2_LINUX_KERNEL=y
BR2_LINUX_KERNEL_CUSTOM_VERSION=y
BR2_LINUX_KERNEL_CUSTOM_VERSION_VALUE="4.14.15"
BR2_LINUX_KERNEL_USE_CUSTOM_CONFIG=y
BR2_LINUX_KERNEL_CUSTOM_CONFIG_FILE="board/qemu/csky/qemu_ck810_defconfig"
BR2_LINUX_KERNEL_VMLINUX=y
BR2_LINUX_KERNEL_DTS_SUPPORT=y
BR2_LINUX_KERNEL_USE_CUSTOM_DTS=y
BR2_LINUX_KERNEL_CUSTOM_DTS_PATH="board/qemu/csky/qemu.dts"
BR2_LINUX_KERNEL_EXT_CSKY_ARCH=y
BR2_PACKAGE_BUSYBOX_SHOW_OTHERS=y
BR2_PACKAGE_UCLIBC_NG_TEST=y
BR2_PACKAGE_BASH=y
BR2_TARGET_ROOTFS_INITRAMFS=y
BR2_PACKAGE_HOST_CSKY_QEMU=y
BR2_TOOLCHAIN_EXTERNAL=y
```

## configs/qemu_csky_ck810_uclibc_test_defconfig
```kconfig
BR2_csky=y
BR2_ck810=y
BR2_OPTIMIZE_2=y
BR2_SHARED_STATIC_LIBS=y
BR2_TOOLCHAIN_EXTERNAL_PREINSTALLED=y
BR2_TOOLCHAIN_EXTERNAL_PATH="$(TOPDIR)/../../install"
BR2_TOOLCHAIN_EXTERNAL_CSKY_UCLIBC=y
BR2_ROOTFS_DEVICE_TABLE="board/qemu/csky/device_table.txt"
BR2_ROOTFS_OVERLAY="board/csky-qa/fs-overlay/"
BR2_ROOTFS_POST_BUILD_SCRIPT="board/csky-qa/clean_lib.sh"
BR2_LINUX_KERNEL=y
BR2_LINUX_KERNEL_CUSTOM_VERSION=y
BR2_LINUX_KERNEL_CUSTOM_VERSION_VALUE="4.9.56"
BR2_LINUX_KERNEL_USE_CUSTOM_CONFIG=y
BR2_LINUX_KERNEL_CUSTOM_CONFIG_FILE="board/qemu/csky/qemu_ck810_defconfig"
BR2_LINUX_KERNEL_VMLINUX=y
BR2_LINUX_KERNEL_DTS_SUPPORT=y
BR2_LINUX_KERNEL_USE_CUSTOM_DTS=y
BR2_LINUX_KERNEL_CUSTOM_DTS_PATH="board/qemu/csky/qemu.dts"
BR2_LINUX_KERNEL_EXT_CSKY_ARCH=y
BR2_LINUX_KERNEL_EXT_CSKY_ARCH_GIT=y
BR2_LINUX_KERNEL_EXT_CSKY_ARCH_GIT_URL="ssh://${GITUSER}@192.168.0.78:29418/os/linux-csky"
BR2_PACKAGE_BUSYBOX_SHOW_OTHERS=y
BR2_PACKAGE_E2FSPROGS=y
BR2_PACKAGE_LIBFFI=y
BR2_PACKAGE_BASH=y
BR2_TARGET_ROOTFS_INITRAMFS=y
```

## configs/thead_610_compat_4.9_glibc_br_defconfig
```kconfig
# Architecture
BR2_csky=y
BR2_ck610=y

# Kernel headers
BR2_PACKAGE_HOST_LINUX_HEADERS_CUSTOM_4_9=y

# Kernel configuration
BR2_LINUX_KERNEL=y
BR2_LINUX_KERNEL_IMAGE=y
BR2_LINUX_KERNEL_CUSTOM_VERSION=y
BR2_LINUX_KERNEL_CUSTOM_VERSION_VALUE="4.9.56"
BR2_LINUX_KERNEL_USE_CUSTOM_CONFIG=y
BR2_LINUX_KERNEL_CUSTOM_CONFIG_FILE="board/csky-ci/defconfigs/qemu_ck610_defconfig"

# System configuration
BR2_OPTIMIZE_2=y
BR2_TARGET_OPTIMIZATION="-mno-stm"

# Rootfs
BR2_TARGET_ROOTFS_EXT2=y
BR2_SHARED_STATIC_LIBS=y
BR2_ROOTFS_DEVICE_TABLE="board/csky-ci/device_table.txt"
BR2_ROOTFS_DEVICE_CREATION_DYNAMIC_MDEV=y

# Toolchain & C library
BR2_TOOLCHAIN_BUILDROOT=y
BR2_TOOLCHAIN_BUILDROOT_GLIBC=y
BR2_TOOLCHAIN_BUILDROOT_CXX=y

# Packages on host
BR2_PACKAGE_HOST_QEMU=y
BR2_PACKAGE_HOST_QEMU_SYSTEM_MODE=y
BR2_PACKAGE_HOST_GDB=y

# Packages on board
BR2_PACKAGE_GDB=y
BR2_PACKAGE_GDB_SERVER=y

# Gitlab-CI
BR2_PACKAGE_CSKY_CI=y

# Others
BR2_PACKAGE_BUSYBOX_SHOW_OTHERS=y
BR2_PACKAGE_BASH=y
```

## configs/thead_610_compat_next_glibc_br_defconfig
```kconfig
# Architecture
BR2_csky=y
BR2_ck610=y

# Kernel configuration
BR2_LINUX_KERNEL=y
BR2_LINUX_KERNEL_UIMAGE=y
BR2_LINUX_KERNEL_CUSTOM_TARBALL=y
BR2_LINUX_KERNEL_CUSTOM_TARBALL_LOCATION="https://github.com/c-sky/csky-linux/archive/$(CSKY_LINUX_NEXT_VERSION).tar.gz"
BR2_LINUX_KERNEL_USE_ARCH_DEFAULT_CONFIG=y
BR2_LINUX_KERNEL_CONFIG_FRAGMENT_FILES="board/csky-ci/defconfigs/kernel.610.fragment board/csky-ci/defconfigs/kernel.pci-9pfs-gpu.fragment"

# System configuration
BR2_OPTIMIZE_2=y
BR2_TARGET_OPTIMIZATION="-mno-stm"

# Rootfs
BR2_TARGET_ROOTFS_EXT2=y
BR2_SHARED_STATIC_LIBS=y
BR2_ROOTFS_DEVICE_TABLE="board/csky-ci/device_table.txt"
BR2_ROOTFS_DEVICE_CREATION_DYNAMIC_MDEV=y

# Toolchain & C library
BR2_TOOLCHAIN_BUILDROOT=y
BR2_TOOLCHAIN_BUILDROOT_GLIBC=y
BR2_TOOLCHAIN_BUILDROOT_CXX=y

# Packages on host
BR2_PACKAGE_QEMU_ENHANCED=y
BR2_PACKAGE_HOST_GDB=y

# Packages on board
BR2_PACKAGE_GDB=y
BR2_PACKAGE_GDB_SERVER=y
BR2_PACKAGE_BUSYBOX_SHOW_OTHERS=y

# Gitlab-CI
BR2_PACKAGE_CSKY_CI=y

# Others
BR2_PACKAGE_BUSYBOX_SHOW_OTHERS=y
BR2_PACKAGE_BASH=y
```
