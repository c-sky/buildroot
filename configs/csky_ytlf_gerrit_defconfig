## configs/thead_810f_compat_4.14_uclibc_br_defconfig
```kconfig
# Architecture
BR2_csky=y
BR2_ck810=y
BR2_CSKY_FPU=y

# Kernel headers
BR2_PACKAGE_HOST_LINUX_HEADERS_CUSTOM_4_14=y

# Kernel configuration
BR2_LINUX_KERNEL=y
BR2_LINUX_KERNEL_IMAGE=y
BR2_LINUX_KERNEL_CUSTOM_VERSION=y
BR2_LINUX_KERNEL_CUSTOM_VERSION_VALUE="4.14.66"
BR2_LINUX_KERNEL_USE_CUSTOM_CONFIG=y
BR2_LINUX_KERNEL_CUSTOM_CONFIG_FILE="board/csky-ci/defconfigs/qemu_ck810_defconfig"

# System configuration
BR2_OPTIMIZE_2=y
BR2_TARGET_OPTIMIZATION="-mbacktrace"

# Rootfs
BR2_TARGET_ROOTFS_EXT2=y
BR2_SHARED_STATIC_LIBS=y
BR2_ROOTFS_DEVICE_TABLE="board/csky-ci/device_table.txt"
BR2_ROOTFS_DEVICE_CREATION_DYNAMIC_MDEV=y

# Toolchain & C library
BR2_TOOLCHAIN_BUILDROOT=y
BR2_TOOLCHAIN_BUILDROOT_UCLIBC=y
BR2_TOOLCHAIN_BUILDROOT_CXX=y
BR2_TOOLCHAIN_BUILDROOT_WCHAR=y
BR2_PTHREAD_DEBUG=y

# Packages on host
BR2_PACKAGE_HOST_QEMU=y
BR2_PACKAGE_HOST_QEMU_SYSTEM_MODE=y
BR2_PACKAGE_HOST_GDB=y

# Packages on board
BR2_PACKAGE_GDB=y
BR2_PACKAGE_GDB_SERVER=y

# Gitlab-CI
BR2_PACKAGE_CSKY_CI=y

# Others
BR2_PACKAGE_BUSYBOX_SHOW_OTHERS=y
BR2_PACKAGE_BASH=y
```

## configs/thead_810f_compat_4.9_uclibc_br_defconfig
```kconfig
# Architecture
BR2_csky=y
BR2_ck810=y
BR2_CSKY_FPU=y

# Kernel headers
BR2_PACKAGE_HOST_LINUX_HEADERS_CUSTOM_4_9=y

# Kernel configuration
BR2_LINUX_KERNEL=y
BR2_LINUX_KERNEL_CUSTOM_VERSION=y
BR2_LINUX_KERNEL_CUSTOM_VERSION_VALUE="4.9.56"
BR2_LINUX_KERNEL_USE_CUSTOM_CONFIG=y
BR2_LINUX_KERNEL_CUSTOM_CONFIG_FILE="board/csky-ci/defconfigs/qemu_ck810_defconfig"
BR2_LINUX_KERNEL_UIMAGE=y

# System configuration
BR2_OPTIMIZE_2=y
BR2_TARGET_OPTIMIZATION="-mbacktrace"

# Rootfs
BR2_TARGET_ROOTFS_EXT2=y
BR2_TARGET_ROOTFS_CPIO=y
BR2_TARGET_ROOTFS_CPIO_GZIP=y
BR2_SHARED_STATIC_LIBS=y
BR2_ROOTFS_DEVICE_TABLE="board/csky-ci/device_table.txt"
BR2_ROOTFS_DEVICE_CREATION_DYNAMIC_MDEV=y

# Toolchain & C library
BR2_TOOLCHAIN_BUILDROOT=y
BR2_TOOLCHAIN_BUILDROOT_UCLIBC=y
BR2_TOOLCHAIN_BUILDROOT_CXX=y
BR2_TOOLCHAIN_BUILDROOT_WCHAR=y
BR2_PTHREAD_DEBUG=y

# Packages on host
BR2_PACKAGE_QEMU_ENHANCED=y
BR2_PACKAGE_HOST_GDB=y

# Packages on board
BR2_PACKAGE_GDB=y
BR2_PACKAGE_GDB_SERVER=y

# Gitlab-CI
BR2_PACKAGE_CSKY_CI=y

# Others
BR2_PACKAGE_BUSYBOX_SHOW_OTHERS=y
BR2_PACKAGE_BASH=y
```

## configs/thead_860_compat_4.14_glibc_br_defconfig
```kconfig
# Architecture
BR2_csky=y
BR2_ck860=y

# Kernel headers
BR2_PACKAGE_HOST_LINUX_HEADERS_CUSTOM_4_14=y

# Kernel configuration
BR2_LINUX_KERNEL=y
BR2_LINUX_KERNEL_UIMAGE=y
BR2_LINUX_KERNEL_CUSTOM_VERSION=y
BR2_LINUX_KERNEL_CUSTOM_VERSION_VALUE="4.14.66"
BR2_LINUX_KERNEL_USE_ARCH_DEFAULT_CONFIG=y
BR2_LINUX_KERNEL_CONFIG_FRAGMENT_FILES="board/csky-ci/defconfigs/kernel.860.fragment board/csky-ci/defconfigs/kernel.pci-9pfs-gpu.fragment"

# System configuration
BR2_OPTIMIZE_2=y
BR2_TARGET_OPTIMIZATION="-mbacktrace"

# Rootfs
BR2_TARGET_ROOTFS_EXT2=y
BR2_TARGET_ROOTFS_CPIO=y
BR2_TARGET_ROOTFS_CPIO_GZIP=y
BR2_SHARED_STATIC_LIBS=y
BR2_ROOTFS_DEVICE_TABLE="board/csky-ci/device_table.txt"
BR2_ROOTFS_DEVICE_CREATION_DYNAMIC_MDEV=y

# Toolchain & C library
BR2_TOOLCHAIN_BUILDROOT=y
BR2_TOOLCHAIN_BUILDROOT_GLIBC=y
BR2_TOOLCHAIN_BUILDROOT_CXX=y

# Packages on host
BR2_PACKAGE_QEMU_ENHANCED=y
BR2_PACKAGE_HOST_GDB=y

# Packages on board
BR2_PACKAGE_GDB=y
BR2_PACKAGE_GDB_SERVER=y

# Gitlab-CI
BR2_PACKAGE_CSKY_CI=y

# Others
BR2_PACKAGE_BUSYBOX_SHOW_OTHERS=y
BR2_PACKAGE_BASH=y
```

## configs/thead_860_compat_4.19_glibc_br_defconfig
```kconfig
# Architecture
BR2_csky=y
BR2_ck860=y

# Kernel headers
BR2_PACKAGE_HOST_LINUX_HEADERS_CUSTOM_4_19=y

# Kernel configuration
BR2_LINUX_KERNEL=y
BR2_LINUX_KERNEL_UIMAGE=y
BR2_LINUX_KERNEL_CUSTOM_VERSION=y
BR2_LINUX_KERNEL_CUSTOM_VERSION_VALUE="4.19.10"
BR2_LINUX_KERNEL_USE_CUSTOM_CONFIG=y
BR2_LINUX_KERNEL_CUSTOM_CONFIG_FILE="board/csky-ci/defconfigs/qemu_ck860_defconfig"

# System configuration
BR2_OPTIMIZE_2=y
BR2_TARGET_OPTIMIZATION="-mbacktrace"

# Rootfs
BR2_TARGET_ROOTFS_EXT2=y
BR2_TARGET_ROOTFS_CPIO=y
BR2_TARGET_ROOTFS_CPIO_GZIP=y
BR2_SHARED_STATIC_LIBS=y
BR2_ROOTFS_DEVICE_TABLE="board/csky-ci/device_table.txt"
BR2_ROOTFS_DEVICE_CREATION_DYNAMIC_MDEV=y

# Toolchain & C library
BR2_TOOLCHAIN_BUILDROOT=y
BR2_TOOLCHAIN_BUILDROOT_GLIBC=y
BR2_TOOLCHAIN_BUILDROOT_CXX=y

# Packages on host
BR2_PACKAGE_HOST_QEMU=y
BR2_PACKAGE_HOST_GDB=y
BR2_PACKAGE_HOST_QEMU_SYSTEM_MODE=y

# Packages on board
BR2_PACKAGE_GDB=y
BR2_PACKAGE_GDB_SERVER=y
BR2_PACKAGE_LINUX_TOOLS_PERF=y

# Gitlab-CI
BR2_PACKAGE_CSKY_CI=y

# CI Testcases

# Others
BR2_PACKAGE_BUSYBOX_SHOW_OTHERS=y
BR2_PACKAGE_BASH=y
```

## configs/thead_860_compat_5.9_glibc_br_defconfig
```kconfig
# Architecture
BR2_csky=y
BR2_ck860=y

# Kernel
BR2_LINUX_KERNEL=y
BR2_LINUX_KERNEL_CUSTOM_VERSION=y
BR2_LINUX_KERNEL_CUSTOM_VERSION_VALUE="5.9.3"
BR2_LINUX_KERNEL_USE_ARCH_DEFAULT_CONFIG=y
BR2_LINUX_KERNEL_IMAGE=y
BR2_LINUX_KERNEL_PATCH="package/linux-patch-thead/5.9/"
BR2_LINUX_KERNEL_CONFIG_FRAGMENT_FILES="board/csky-ci/defconfigs/kernel.860.fragment board/csky-ci/defconfigs/kernel.pci-9pfs-gpu.fragment"


# System configuration
BR2_OPTIMIZE_2=y
BR2_TARGET_OPTIMIZATION="-mbacktrace"

# Rootfs
BR2_TARGET_ROOTFS_EXT2=y
BR2_TARGET_ROOTFS_CPIO=y
BR2_TARGET_ROOTFS_CPIO_GZIP=y
BR2_SHARED_STATIC_LIBS=y
BR2_ROOTFS_DEVICE_TABLE="board/csky-ci/device_table.txt"
BR2_ROOTFS_DEVICE_CREATION_DYNAMIC_MDEV=y

# Toolchain & C library
BR2_TOOLCHAIN_BUILDROOT=y
BR2_TOOLCHAIN_BUILDROOT_GLIBC=y
BR2_TOOLCHAIN_BUILDROOT_CXX=y

# Packages on host
BR2_PACKAGE_HOST_GDB=y
BR2_PACKAGE_QEMU_ENHANCED=y

# Packages on board
BR2_PACKAGE_GDB=y
BR2_PACKAGE_GDB_SERVER=y
BR2_PACKAGE_BASH=y
BR2_PACKAGE_LINUX_TOOLS_PERF=y
BR2_PACKAGE_BUSYBOX_SHOW_OTHERS=y

# Gitlab-CI
BR2_PACKAGE_CSKY_CI=y

# CI Testcases
```

## configs/thead_860_compat_next_glibc_br_defconfig
```kconfig
# Architecture
BR2_csky=y
BR2_ck860=y

# Kernel configuration
BR2_LINUX_KERNEL=y
BR2_LINUX_KERNEL_IMAGE=y
BR2_LINUX_KERNEL_CUSTOM_TARBALL=y
BR2_LINUX_KERNEL_CUSTOM_TARBALL_LOCATION="https://github.com/c-sky/csky-linux/archive/$(CSKY_LINUX_NEXT_VERSION).tar.gz"
BR2_LINUX_KERNEL_USE_CUSTOM_CONFIG=y
BR2_LINUX_KERNEL_CUSTOM_CONFIG_FILE="board/csky-ci/defconfigs/qemu_ck860_defconfig"

# System configuration
BR2_OPTIMIZE_2=y
BR2_TARGET_OPTIMIZATION="-mbacktrace"

# Rootfs
BR2_TARGET_ROOTFS_EXT2=y
BR2_TARGET_ROOTFS_EXT2_SIZE="200M"
BR2_SHARED_STATIC_LIBS=y
BR2_ROOTFS_DEVICE_TABLE="board/csky-ci/device_table.txt"
BR2_ROOTFS_DEVICE_CREATION_DYNAMIC_MDEV=y

# Toolchain & C library
BR2_TOOLCHAIN_BUILDROOT=y
BR2_TOOLCHAIN_BUILDROOT_GLIBC=y
BR2_TOOLCHAIN_BUILDROOT_CXX=y

# Packages on host
BR2_PACKAGE_HOST_GDB=y
BR2_PACKAGE_HOST_QEMU=y
BR2_PACKAGE_HOST_QEMU_SYSTEM_MODE=y

# Packages on board
BR2_PACKAGE_GDB=y
BR2_PACKAGE_GDB_SERVER=y
BR2_PACKAGE_BASH=y
BR2_PACKAGE_LINUX_TOOLS_PERF=y
BR2_PACKAGE_BUSYBOX_SHOW_OTHERS=y

# Gitlab-CI
BR2_PACKAGE_CSKY_CI=y

# CI Testcases
BR2_CSKY_CI_SSH=y
BR2_PACKAGE_LTP_CI=y
```

## configs/thead_860_fedora_next_glibc_br_defconfig
```kconfig
# Architecture
BR2_csky=y
BR2_ck860=y

# Kernel configuration
BR2_LINUX_KERNEL=y
BR2_LINUX_KERNEL_UIMAGE=y
BR2_LINUX_KERNEL_CUSTOM_TARBALL=y
BR2_LINUX_KERNEL_CUSTOM_TARBALL_LOCATION="https://github.com/c-sky/csky-linux/archive/$(CSKY_LINUX_NEXT_VERSION).tar.gz"
BR2_LINUX_KERNEL_USE_ARCH_DEFAULT_CONFIG=y
BR2_LINUX_KERNEL_CONFIG_FRAGMENT_FILES="board/csky-ci/defconfigs/kernel.860.fragment board/csky-ci/defconfigs/kernel.pci-9pfs-gpu.fragment board/csky-ci/defconfigs/qemu_ck860_defconfig"

# System configuration
BR2_OPTIMIZE_2=y
BR2_TARGET_OPTIMIZATION="-mbacktrace"

# Rootfs
BR2_TARGET_ROOTFS_EXT2=y
BR2_TARGET_ROOTFS_CPIO=y
BR2_TARGET_ROOTFS_CPIO_GZIP=y
BR2_SHARED_STATIC_LIBS=y
BR2_ROOTFS_DEVICE_TABLE="board/csky-ci/device_table.txt"
BR2_ROOTFS_DEVICE_CREATION_DYNAMIC_MDEV=y

# Toolchain & C library
BR2_TOOLCHAIN_BUILDROOT=y
BR2_TOOLCHAIN_BUILDROOT_GLIBC=y
BR2_TOOLCHAIN_BUILDROOT_CXX=y

# Packages on host
BR2_PACKAGE_HOST_GDB=y
BR2_PACKAGE_QEMU_ENHANCED=y

# Packages on board
BR2_PACKAGE_GDB=y
BR2_PACKAGE_GDB_SERVER=y
BR2_PACKAGE_BASH=y
BR2_PACKAGE_LINUX_TOOLS_PERF=y
BR2_PACKAGE_BUSYBOX_SHOW_OTHERS=y

# Gitlab-CI
BR2_PACKAGE_CSKY_CI=y

#For Fedora project compiling
BR2_PACKAGE_FEDORA_NEED=y
# For fedora Bootstrap rootfs
BR2_TARGET_TZ_INFO=y
BR2_PACKAGE_DIFFUTILS=y
BR2_PACKAGE_FINDUTILS=y

BR2_PACKAGE_GAWK=y

BR2_PACKAGE_GIT=y
BR2_PACKAGE_GREP=y

BR2_PACKAGE_PATCH=y
BR2_PACKAGE_PKGCONF=y
BR2_PACKAGE_SED=y
BR2_PACKAGE_TREE=y
BR2_PACKAGE_BZIP2=y
BR2_PACKAGE_GZIP=y
BR2_PACKAGE_LZ4=y
BR2_PACKAGE_LZIP=y
BR2_PACKAGE_LZOP=y
BR2_PACKAGE_P7ZIP=y
BR2_PACKAGE_PIGZ=y
BR2_PACKAGE_PIXZ=y
BR2_PACKAGE_UNRAR=y
BR2_PACKAGE_UNZIP=y
BR2_PACKAGE_XZ=y
BR2_PACKAGE_ZIP=y
BR2_PACKAGE_ZSTD=y
BR2_PACKAGE_LSOF=y
BR2_PACKAGE_CPIO=y
BR2_PACKAGE_PERL=y
BR2_PACKAGE_LIBZIP=y

BR2_PACKAGE_ZLIB=y

BR2_PACKAGE_OPENSSH=y

BR2_PACKAGE_COREUTILS=y
BR2_PACKAGE_TAR=y
BR2_PACKAGE_UTIL_LINUX=y
BR2_PACKAGE_LESS=y
BR2_PACKAGE_VIM=y
BR2_PACKAGE_NFS_UTILS=y
BR2_PACKAGE_RSYNC=y


BR2_PACKAGE_CHRONY=y
BR2_PACKAGE_KMOD=y
BR2_PACKAGE_UTIL_LINUX_LIBUUID=y
```

## configs/thead_910_enhanced_next_glibc_br_defconfig
```kconfig
# Architecture
BR2_riscv=y
BR2_RISCV_64=y
BR2_riscv_custom=y
BR2_RISCV_ISA_CUSTOM_RVM=y
BR2_RISCV_ISA_CUSTOM_RVF=y
BR2_RISCV_ISA_CUSTOM_RVD=y
BR2_RISCV_ISA_CUSTOM_CUSTOM=y
BR2_RISCV_ISA_CUSTOM_STR="xcki"
BR2_RISCV_ABI_LP64D=y

# System
BR2_TARGET_GENERIC_GETTY=y
BR2_TARGET_GENERIC_GETTY_PORT="ttyS0"

# Rootfs
BR2_TARGET_ROOTFS_EXT2=y
BR2_TARGET_ROOTFS_EXT2_SIZE="200M"
BR2_SHARED_STATIC_LIBS=y
BR2_ROOTFS_DEVICE_TABLE="board/csky-ci/device_table.txt"
BR2_ROOTFS_DEVICE_CREATION_DYNAMIC_MDEV=y

# Toolchain
BR2_TOOLCHAIN_EXTERNAL=y
BR2_TOOLCHAIN_EXTERNAL_GCC_8=y
BR2_TOOLCHAIN_EXTERNAL_CUSTOM_PREFIX="riscv64-unknown-linux-gnu"
BR2_TOOLCHAIN_EXTERNAL_CUSTOM_GLIBC=y
BR2_TOOLCHAIN_EXTERNAL_HEADERS_5_1=y
BR2_TOOLCHAIN_EXTERNAL_CXX=y
BR2_PACKAGE_HOST_GDB=y

# Linux headers same as kernel, a 5.1 series
BR2_PACKAGE_HOST_LINUX_HEADERS_CUSTOM_5_1=y

# Kernel
BR2_LINUX_KERNEL=y
BR2_LINUX_KERNEL_CUSTOM_VERSION=y
BR2_LINUX_KERNEL_CUSTOM_VERSION_VALUE="5.1.12"
BR2_LINUX_KERNEL_USE_ARCH_DEFAULT_CONFIG=y
BR2_LINUX_KERNEL_IMAGE=y
BR2_LINUX_KERNEL_PATCH="package/linux-patch-c910/5.1/"
BR2_LINUX_KERNEL_CONFIG_FRAGMENT_FILES="package/linux-patch-c910/linux-5.1.config.fragment package/linux-patch-c910/linux-5.1.config.xcki.fragment"

# Bootloader
BR2_TARGET_OPENSBI=y
BR2_TARGET_OPENSBI_USE_PLAT=y
BR2_TARGET_OPENSBI_PLAT="qemu/virt"

# Qemu

# Gitlab-CI

# Others
BR2_PACKAGE_BUSYBOX_SHOW_OTHERS=y
BR2_PACKAGE_BASH=y
```

## configs/thead_9xx_compat_next_glibc_br_defconfig
```kconfig
# Architecture
BR2_riscv=y
BR2_RISCV_64=y

# System
BR2_TARGET_GENERIC_GETTY=y

# Rootfs
BR2_TARGET_ROOTFS_EXT2=y
BR2_TARGET_ROOTFS_CPIO=y
BR2_TARGET_ROOTFS_CPIO_GZIP=y
BR2_SHARED_STATIC_LIBS=y
BR2_ROOTFS_DEVICE_TABLE="board/csky-ci/device_table.txt"
BR2_ROOTFS_DEVICE_CREATION_DYNAMIC_MDEV=y

# Toolchain
BR2_TOOLCHAIN_BUILDROOT=y
BR2_TOOLCHAIN_BUILDROOT_GLIBC=y
BR2_TOOLCHAIN_BUILDROOT_CXX=y
BR2_PACKAGE_HOST_GDB=y

# Linux headers same as kernel, a 5.1 series
BR2_PACKAGE_HOST_LINUX_HEADERS_CUSTOM_5_1=y

# Kernel
BR2_LINUX_KERNEL=y
BR2_LINUX_KERNEL_CUSTOM_TARBALL=y
BR2_LINUX_KERNEL_CUSTOM_TARBALL_LOCATION="https://github.com/c-sky/csky-linux/archive/$(CSKY_LINUX_NEXT_RISCV_VERSION).tar.gz"
BR2_LINUX_KERNEL_USE_ARCH_DEFAULT_CONFIG=y
BR2_LINUX_KERNEL_IMAGE=y
BR2_LINUX_KERNEL_CONFIG_FRAGMENT_FILES="package/linux-patch-c910/linux-5.1.config.fragment board/csky-ci/defconfigs/kernel.pci-9pfs-gpu.fragment"

# Bootloader
BR2_TARGET_OPENSBI=y
BR2_TARGET_OPENSBI_USE_PLAT=y

# Qemu
BR2_PACKAGE_QEMU_ENHANCED=y

# Gitlab-CI
BR2_PACKAGE_CSKY_CI=y

# Others
BR2_PACKAGE_BUSYBOX_SHOW_OTHERS=y
BR2_PACKAGE_BASH=y
```

## configs_enhanced/thead_807f_enhanced_4.9_glibc_br_defconfig
```kconfig
BR2_csky=y
BR2_ck807=y
BR2_CSKY_FPU=y
BR2_OPTIMIZE_2=y
BR2_SHARED_STATIC_LIBS=y
BR2_TOOLCHAIN_EXTERNAL=y
BR2_TOOLCHAIN_EXTERNAL_DOWNLOAD=y
BR2_TOOLCHAIN_EXTERNAL_URL="https://cop-image-prod.oss-cn-hangzhou.aliyuncs.com/resource/420257228264570880/1575455658565/csky-linux-gnuabiv2-tools-x86_64-glibc-linux-4.9.56-20191122.tar.gz"
BR2_TOOLCHAIN_EXTERNAL_CUSTOM_PREFIX="$(ARCH)-abiv2-linux"
BR2_TOOLCHAIN_EXTERNAL_GCC_6=y
BR2_TOOLCHAIN_EXTERNAL_HEADERS_4_9=y
BR2_TOOLCHAIN_EXTERNAL_CUSTOM_GLIBC=y
BR2_TOOLCHAIN_EXTERNAL_CXX=y
BR2_TOOLCHAIN_EXTERNAL_OPENMP=y
BR2_TARGET_OPTIMIZATION="-mbacktrace"
BR2_ROOTFS_DEVICE_CREATION_DYNAMIC_MDEV=y
BR2_ROOTFS_DEVICE_TABLE="board/csky-ci/device_table.txt"
BR2_SYSTEM_BIN_SH_BASH=y
BR2_LINUX_KERNEL=y
BR2_LINUX_KERNEL_CUSTOM_VERSION=y
BR2_LINUX_KERNEL_CUSTOM_VERSION_VALUE="4.9.56"
BR2_LINUX_KERNEL_USE_CUSTOM_CONFIG=y
BR2_LINUX_KERNEL_CUSTOM_CONFIG_FILE="board/csky-ci/defconfigs/qemu_ck810_defconfig"
BR2_LINUX_KERNEL_CONFIG_FRAGMENT_FILES="package/csky-qa/linux-fpu.config.fragment"
BR2_LINUX_KERNEL_IMAGE=y
# BR2_PACKAGE_CSKY_CI is not set
BR2_PACKAGE_BUSYBOX_SHOW_OTHERS=y
BR2_PACKAGE_ZLIB=y
BR2_TARGET_ROOTFS_CPIO=y
BR2_TARGET_ROOTFS_CPIO_GZIP=y
BR2_TARGET_ROOTFS_EXT2=y
BR2_TARGET_ROOTFS_EXT2_SIZE="200M"
BR2_PACKAGE_HOST_DTC=y
BR2_PACKAGE_BUSYBOX_CONFIG_FRAGMENT_FILES="package/csky-qa/busybox.fragment"
```

## configs_enhanced/thead_9xxf_enhanced_5.4_glibc_br_defconfig
```kconfig
# Architecture
BR2_riscv=y
BR2_riscv_custom=y

# System
BR2_TARGET_GENERIC_GETTY_PORT="ttyS0"

# Rootfs
BR2_TARGET_ROOTFS_CPIO=y
BR2_TARGET_ROOTFS_CPIO_GZIP=y
BR2_TARGET_ROOTFS_EXT2=y
BR2_SHARED_STATIC_LIBS=y
BR2_ROOTFS_DEVICE_TABLE="board/csky-ci/device_table.txt"
BR2_ROOTFS_DEVICE_CREATION_DYNAMIC_MDEV=y

# Toolchain
# Linux headers same as kernel, a 5.4 series
# Kernel
BR2_LINUX_KERNEL=y
BR2_LINUX_KERNEL_CUSTOM_VERSION=y
BR2_LINUX_KERNEL_CUSTOM_VERSION_VALUE="5.4.36"
BR2_LINUX_KERNEL_USE_ARCH_DEFAULT_CONFIG=y
BR2_LINUX_KERNEL_IMAGE=y
BR2_LINUX_KERNEL_PATCH="package/linux-patch-c910/5.4/"
BR2_LINUX_KERNEL_CONFIG_FRAGMENT_FILES="package/linux-patch-c910/linux-5.1.config.fragment package/csky-qa/linux-riscv-vdsp.config.fragment package/csky-qa/linux-riscv-xthead.config.fragment board/csky-ci/defconfigs/kernel.pci-9pfs-gpu.fragment"

# Bootloader
BR2_TARGET_OPENSBI=y
BR2_TARGET_OPENSBI_USE_PLAT=y
BR2_TARGET_OPENSBI_PLAT="qemu/virt"

# Qemu
BR2_PACKAGE_QEMU_ENHANCED=y
# Gitlab-CI
BR2_PACKAGE_CSKY_CI=y

# Others
BR2_PACKAGE_BUSYBOX_SHOW_OTHERS=y
BR2_PACKAGE_BASH=y
BR2_PACKAGE_KEXEC=y

BR2_RISCV_ISA_CUSTOM_RVC=y
BR2_RISCV_ISA_CUSTOM_RVM=y
BR2_RISCV_ISA_CUSTOM_RVF=y
BR2_RISCV_ISA_CUSTOM_RVD=y
BR2_RISCV_ISA_CUSTOM_THEAD=y
BR2_RISCV_ABI_LP64D=y
BR2_TOOLCHAIN_EXTERNAL=y
BR2_TOOLCHAIN_EXTERNAL_DOWNLOAD=y
BR2_TOOLCHAIN_EXTERNAL_URL="https://occ-oss-prod.oss-cn-hangzhou.aliyuncs.com/resource/1355977/1590850156697/riscv64-linux-x86_64-20200528.tar.gz"
BR2_TOOLCHAIN_EXTERNAL_CUSTOM_PREFIX="riscv64-unknown-linux-gnu"
BR2_TOOLCHAIN_EXTERNAL_GCC_8=y
BR2_TOOLCHAIN_EXTERNAL_HEADERS_5_1=y
BR2_TOOLCHAIN_EXTERNAL_CUSTOM_GLIBC=y
BR2_TOOLCHAIN_EXTERNAL_CXX=y
BR2_PACKAGE_HOST_GDB=y
BR2_PACKAGE_LINUX_TOOLS_PERF=y
BR2_PACKAGE_NTFS_3G=y
BR2_PACKAGE_NTFS_3G_NTFSPROGS=y
BR2_PACKAGE_HOST_DTC=y
BR2_PACKAGE_BUSYBOX_CONFIG_FRAGMENT_FILES="package/csky-qa/busybox-riscv.fragment"
```
