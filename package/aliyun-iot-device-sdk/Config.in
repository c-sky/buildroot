## package/aliyun-iot-device-sdk/Config.in
```kconfig
config BR2_PACKAGE_ALIYUN_IOT_DEVICE_SDK
	bool "aliyun-iot-device-sdk"
	help
	  aliyun-iot-device-sdk is from aliyun, See:

	  http://www.c-sky.club/showdoc/index.php?s=/6&page_id=50

	  https://help.aliyun.com/document_detail/42648.html?spm=5176.60471.237208.5.sUwAzq

	  https://help.aliyun.com/document_detail/42655.html?spm=5176.doc42648.6.563.NKpXhK

if BR2_PACKAGE_ALIYUN_IOT_DEVICE_SDK

menu "aliyun iot key setting"

comment "setup key to connect the aliyun cloud."

config BR2_PACKAGE_ALIYUN_IOT_DEVICE_SDK_PRODUCT_KEY
	string "Product Key"

config BR2_PACKAGE_ALIYUN_IOT_DEVICE_SDK_PRODUCT_SECRET
	string "Product Secret"

config BR2_PACKAGE_ALIYUN_IOT_DEVICE_SDK_DEVICE_NAME
	string "Device Name"

config BR2_PACKAGE_ALIYUN_IOT_DEVICE_SDK_DEVICE_SECRET
	string "Device Secret"
endmenu
endif
```

## package/atomicbench/Config.in
```kconfig
config BR2_PACKAGE_ATOMICBENCH
 bool "atomicbench"
 help
  AtomicBench is a benchmark that measures the performance of
  SMP CPU used in C11/C11++ atomic interface
  https://github.com/plctlab/atomic_benchmark/

if BR2_PACKAGE_ATOMICBENCH

    config BR2_PACKAGE_ATOMICBENCH_MODE
	string "ATOMICBENCH TEST MODE"
	default "binary"
	help
	  support binary and source

endif
```

## package/circustent/Config.in
```kconfig
config BR2_PACKAGE_CIRCUSTENT
 bool "circustent"
 help
  The CircusTent infrastructure is designed to provide users 
  and architects the ability to discover the relevant performance 
  of a target system architecture's memory subsystem using atomic memory operations. 
  Atomic memory operations have traditionally been considered to be latent or low performance 
  given the difficulty in their respective implementations.

  https://github.com/tactcomplabs/circustent
```

## package/csky-addons/Config.in
```kconfig
# Prompt-less option, because this package is not doing anything except
# downloading source. The real work is done by a Linux
# extension.
config BR2_PACKAGE_CSKY_ADDONS
	bool
	depends on BR2_LINUX_KERNEL
	help
	  Linux addons for C-CSKY CPU

	  This is only the download helper for the kernel patch.

	  https://github.com/c-sky/addons-linux
```

## package/csky-ai/Config.in
```kconfig
comment "csky-ai needs a Linux kernel to be built"
	depends on !BR2_LINUX_KERNEL

menu "C-SKY AI"
config BR2_PACKAGE_CSKY_AI
	bool "C-SKY AI Related"
	depends on BR2_LINUX_KERNEL
	depends on (BR2_LINUX_KERNEL_CUSTOM_CONFIG_FILE = "board/csky/dh7200_evb_ai/linux.config") || \
		   (BR2_LINUX_KERNEL_CUSTOM_CONFIG_FILE = "board/csky/anole_ck810/linux.config")
	default n
	help
	  C-SKY AI (Artificial Intelligence) related package from www.c-sky.com

	  https://github.com/c-sky/linux-ai

if BR2_PACKAGE_CSKY_AI
config BR2_PACKAGE_CSKY_AI_VERSION
	string "Git version"
	default ""
endif

source "package/csky-ai/Config.in.options"
endmenu
```

## package/csky-arch/Config.in
```kconfig
config BR2_PACKAGE_CSKY_ARCH
	bool
	depends on BR2_LINUX_KERNEL
	default y if BR2_csky
	help
	  C-SKY ISA backend for old version linux
```

## package/csky-ci/Config.in
```kconfig
config BR2_PACKAGE_CSKY_CI
	bool "csky-ci"
	depends on BR2_LINUX_KERNEL
	default y if (BR2_csky || BR2_riscv)
	select BR2_PACKAGE_LINUX_TOOLS_PERF if !BR2_ck610
	select BR2_PACKAGE_HOST_DTC if !BR2_ck610
	select BR2_PACKAGE_OPENSSH if !BR2_riscv
	select BR2_PACKAGE_COREMARK
	help
	  C-Sky ci test script
```

## package/csky-debug/Config.in.host
```kconfig
config BR2_PACKAGE_HOST_CSKY_DEBUG
	bool "csky-debug"
	help
	  C-SKY Jtag Debuger Sever
```

## package/csky-examples/Config.in
```kconfig
# csky examples for linux
menu "C-SKY Examples"
config BR2_PACKAGE_CSKY_EXAMPLES
	bool "C-SKY Linux examples"
	depends on BR2_LINUX_KERNEL
	help
	  Linux examples for C-SKY from the www.c-sky.com

	  https://github.com/c-sky/linux-sdk-examples

if BR2_PACKAGE_CSKY_EXAMPLES

config BR2_PACKAGE_CSKY_EXAMPLES_VERSION
	string "Git version"
	default ""

endif # csky examples

source "package/csky-examples/Config.in.options"
endmenu
```

## package/csky-glibc-ci/Config.in
```kconfig
menu "C-SKY Glibc Ci Test"
config BR2_PACKAGE_CSKY_GLIBC_CI
        bool "csky glibc-ci"
	depends on BR2_LINUX_KERNEL
	depends on BR2_csky
	depends on BR2_TOOLCHAIN_BUILDROOT_GLIBC
	select BR2_PACKAGE_OPENSSH
	select BR2_PACKAGE_PYTHON3
	help
          C-Sky glibc ci test script
endmenu
```

## package/csky-jtag/Config.in
```kconfig
config BR2_PACKAGE_CSKY_JTAG
	bool "csky debug server console"
	default y
	help
		Insall the jtag software Debugserverconsole
```

## package/csky-qemu/Config.in.host
```kconfig
config BR2_PACKAGE_HOST_CSKY_QEMU
	bool "csky-qemu"
	depends on BR2_HOSTARCH = "x86_64"
	select BR2_PACKAGE_HOST_DTC
	help
	  C-SKY qemu

choice
	bool "Repo Source"
	depends on BR2_PACKAGE_HOST_CSKY_QEMU
	default BR2_CSKY_QEMU_GITHUB

config BR2_CSKY_QEMU_GITHUB
	bool "Github"

config BR2_CSKY_QEMU_GERRIT
	bool "Gerrit"

endchoice
```

## package/csky-test/Config.in.host
```kconfig
config BR2_PACKAGE_CSKY_TEST
        bool "csky-ci-test"
	depends on BR2_LINUX_KERNEL
	depends on BR2_csky
	help
          C-Sky ci test script

config BR2_CSKY_TEST_CPU
        string
        depends on BR2_PACKAGE_CSKY_TEST
        default "ck610"     if BR2_ck610
        default "ck807"     if BR2_ck807
        default "ck810"     if BR2_ck810

config BR2_CSKY_TEST_LIBC
        string
        depends on BR2_PACKAGE_CSKY_TEST
        default "glibc"     if BR2_TOOLCHAIN_USES_GLIBC
        default "uclibc"    if BR2_TOOLCHAIN_USES_UCLIBC

config BR2_CSKY_TEST_QEMU
        bool "csky-ci-test run with qemu"
        depends on BR2_PACKAGE_CSKY_TEST
        default y          if BR2_PACKAGE_HOST_CSKY_QEMU

config BR2_CSKY_TEST_GDB_FILE
        string "csky-ci-test gdbinit"
        depends on !BR2_CSKY_TEST_QEMU
        depends on BR2_PACKAGE_CSKY_TEST

config BR2_CSKY_TEST_NFS_PATH
        string "csky-ci-test nfs path"
        depends on !BR2_CSKY_TEST_QEMU
        depends on BR2_PACKAGE_CSKY_TEST

config BR2_PACKAGE_CSKY_TEST_LTP
        bool "csky-ci-test ltp"
        depends on BR2_PACKAGE_CSKY_TEST
        select BR2_PACKAGE_LTP_TESTSUITE
        default y

config BR2_PACKAGE_CSKY_TEST_DHRYSTONE
        bool "csky-ci-test dhrystone"
        depends on BR2_PACKAGE_CSKY_TEST
        select BR2_PACKAGE_DHRYSTONE
        default y if !BR2_CSKY_TEST_QEMU

config BR2_PACKAGE_CSKY_TEST_WHETSTONE
        bool "csky-ci-test whetstone"
        depends on BR2_PACKAGE_CSKY_TEST
        select BR2_PACKAGE_WHETSTONE
        default y if !BR2_CSKY_TEST_QEMU
```

## package/dhrystone-ci/Config.in
```kconfig
#You should source this file in ../csky-ci/Config.in
config BR2_PACKAGE_DHRYSTONE_CI
	bool "dhrystone-ci"
	depends on BR2_PACKAGE_CSKY_CI
	select BR2_PACKAGE_DHRYSTONE
```

## package/fedora-need/Config.in
```kconfig
config BR2_PACKAGE_FEDORA_NEED
	bool "more packages for fedora"
	depends on BR2_LINUX_KERNEL
	default y if (BR2_csky || BR2_riscv)
	select BR2_PACKAGE_HOST_DTC if !BR2_ck610
	select BR2_PACKAGE_OPENSSH if !BR2_riscv
	select BR2_PACKAGE_LIBFFI
	select BR2_PACKAGE_BOTAN
	select BR2_PACKAGE_STRACE
	help
	  Build more packages for fedora project
```

## package/flamegraph/Config.in
```kconfig
config BR2_PACKAGE_FLAMEGRAPH
        bool "flamegraph"
	depends on BR2_LINUX_KERNEL
	help
          linux perf flame graph
```

## package/go-ci/Config.in
```kconfig
config BR2_PACKAGE_GO_CI
	bool "go ci test"
	depends on BR2_RISCV_64
	help
	  base on buildroot GO CI test

comment "go ci need host go bootstrap supports"
	depends on !BR2_RISCV_64

if BR2_PACKAGE_GO_CI

choice
	prompt "Code Source"
	default BR2_PACKAGE_GO_CI_INTERNAL
	help
		Select the code source
config BR2_PACKAGE_GO_CI_INTERNAL
	bool "internal code"
config BR2_PACKAGE_GO_CI_EXTERNAL
	bool "external code"

endchoice

endif
```

## package/greenlet-ci/Config.in
```kconfig
config BR2_PACKAGE_GREENLET_CI
	bool "greenlet-ci"
	depends on BR2_PACKAGE_CSKY_CI
	select BR2_PACKAGE_PYTHON
	select BR2_PACKAGE_GREENLET
```

## package/greenlet/Config.in
```kconfig
config BR2_PACKAGE_GREENLET
        bool "python greenlet"
	depends on BR2_LINUX_KERNEL
	depends on BR2_PACKAGE_PYTHON
	help
```

## package/hackbench/Config.in
```kconfig
config BR2_PACKAGE_HACKBENCH
	bool "hackbench"
	depends on BR2_LINUX_KERNEL
	default y
```

## package/herdtools7/Config.in.host
```kconfig
config BR2_PACKAGE_HOST_HERDTOOLS7
	bool "host herdtools7"
	depends on BR2_PACKAGE_HOST_OCAML
	help
	  The Herd toolsuite to deal with .cat memory models (version 7.xx)

	  https://github.com/herd/herdtools7

comment "herdtools7 needs ocaml ocaml-dune ocaml-menhir"
	depends on  !BR2_PACKAGE_HOST_OCAML
```

## package/hw-c810/Config.in
```kconfig
config BR2_PACKAGE_HW_C810
	bool
	depends on BR2_ck810 || BR2_ck807
	default y if (BR2_ck810 || BR2_ck807)
```
