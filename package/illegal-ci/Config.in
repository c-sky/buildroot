## package/illegal-ci/Config.in
```kconfig
config BR2_PACKAGE_ILLEGAL_CI
	bool "illegal-ci"
	help
		illegal inst test for CPU bit
```

## package/iotkit-embedded/Config.in
```kconfig
config BR2_PACKAGE_ALIYUN_IOTKIT_EMBEDDED
	bool "Alibaba Cloud iotkit-embedded"
	help
	  iotkit-embedded is from Alibaba Cloud, See:

	  https://help.aliyun.com/document_detail/42648.html?spm=5176.60471.237208.5.sUwAzq

	  https://help.aliyun.com/document_detail/42655.html?spm=5176.doc42648.6.563.NKpXhK

if BR2_PACKAGE_ALIYUN_IOTKIT_EMBEDDED

menu "IoT key setting"

comment "setup key to connect the Alibaba Cloud."

config BR2_PACKAGE_IOTKIT_EMBEDDED_PRODUCT_KEY
	string "Product Key"

config BR2_PACKAGE_IOTKIT_EMBEDDED_DEVICE_NAME
	string "Device Name"

config BR2_PACKAGE_IOTKIT_EMBEDDED_DEVICE_SECRET
	string "Device Secret"
endmenu
endif
```

## package/jamvm-csky/Config.in
```kconfig
config BR2_PACKAGE_CSKY_JAMVM_CLASSPATH
	bool "C-SKY jamvm"
	select BR2_PACKAGE_LIBFFI
	select BR2_PACKAGE_CLASSPATH_ARCH_SUPPORTS

config BR2_PACKAGE_JAMVM_CSKY
	bool
	depends on BR2_TOOLCHAIN_HAS_THREADS
	depends on !BR2_STATIC_LIBS
	depends on BR2_PACKAGE_LIBFFI
	select BR2_PACKAGE_ZLIB
	select BR2_PACKAGE_CLASSPATH
	default y if BR2_PACKAGE_CSKY_JAMVM_CLASSPATH \
		&& !BR2_PACKAGE_JAMVM
	help
	  JamVM is a new Java Virtual Machine which conforms to the
	  JVM specification version 2 (blue book).

	  http://jamvm.sf.net

comment "jamvm needs a toolchain w/ threads, dynamic library"
	depends on BR2_PACKAGE_JAMVM_CSKY
	depends on BR2_PACKAGE_CLASSPATH_ARCH_SUPPORTS
	depends on !BR2_TOOLCHAIN_HAS_THREADS || BR2_STATIC_LIBS
```

## package/klitmus-test/Config.in
```kconfig
config BR2_PACKAGE_KLITMUS_TEST
	bool "klitmus test"
	depends on BR2_PACKAGE_HOST_HERDTOOLS7
	help
	  The tests can also be used for kernel memroy order test.

comment "litmus test needs herdtools7"
	depends on  !BR2_PACKAGE_HOST_HERDTOOLS7
```

## package/litmus-test/Config.in
```kconfig
config BR2_PACKAGE_LITMUS_TEST
	bool "riscv litmus test"
	depends on BR2_riscv
	depends on BR2_PACKAGE_HOST_HERDTOOLS7
	help
	  The tests can also be used for memroy order test.

	  https://github.com/litmus-tests/litmus-tests-riscv

if BR2_PACKAGE_LITMUS_TEST

choice
	prompt "LITMUS TEST MODE"
	default BR2_PACKAGE_LITMUS_TEST_PART
	help
	  Select the mode of litmus you wish to use.

	config BR2_PACKAGE_LITMUS_TEST_PART
		bool "part"

	config BR2_PACKAGE_LITMUS_TEST_FULL
		bool "full"
endchoice

config BR2_PACKAGE_LITMUS_TEST_MODE
	string "LITMUS TEST MODE"
	default "part"
	help
	  support part and master

config BR2_PACKAGE_LITMUS_TEST_CORE
	int "riscv litmus test core num"
	default 4

endif

comment "riscv litmus test needs herdtools7"
	depends on  !BR2_PACKAGE_HOST_HERDTOOLS7
```

## package/lmbench-ci/Config.in
```kconfig
#You should source this file in ../csky-ci/Config.in
config BR2_PACKAGE_LMBENCH_CI
	bool "lmbench-ci"
	depends on BR2_PACKAGE_CSKY_CI
	select BR2_PACKAGE_LMBENCH
```

## package/ltp-ci/Config.in
```kconfig
#You should source this file in ../csky-ci/Config.in
config BR2_PACKAGE_LTP_CI
	default y if BR2_TOOLCHAIN_USES_GLIBC && BR2_csky
	bool "ltp-ci"
	depends on BR2_PACKAGE_CSKY_CI
	select BR2_PACKAGE_LTP_TESTSUITE
```

## package/misc-download-c860/Config.in
```kconfig
config BR2_PACKAGE_MISC_DOWNLOAD_C860
	bool "misc-download-c860"
	depends on BR2_ck860
	depends on BR2_LINUX_KERNEL
	default y if BR2_ck860
	help
	  https://github.com/c-sky/860_misc_downloads.git
```

## package/misc-download-c910/Config.in
```kconfig
config BR2_PACKAGE_MISC_DOWNLOAD_C910
	bool "misc-download-c910"
	depends on BR2_riscv
	depends on BR2_LINUX_KERNEL
	default y if BR2_riscv
	help
	  https://github.com/c-sky/910_misc_downloads.git
```

## package/ntfs3g-ci/Config.in
```kconfig
config BR2_PACKAGE_NTFS3G_CI
	default y
	bool "ntfs3g-ci"
	depends on BR2_PACKAGE_CSKY_CI
	select BR2_PACKAGE_NTFS_3G
	select BR2_PACKAGE_NTFS_3G_NTFSPROGS
```

## package/ocaml-dune/Config.in.host
```kconfig
config BR2_PACKAGE_HOST_OCAML_DUNE
	bool "host ocaml-dune"
	depends on BR2_PACKAGE_HOST_OCAML
	help
	  Ocaml Language Dune Package.

	  https://github.com/ocaml/dune

comment "ocaml-dune needs ocaml"
	depends on  !BR2_PACKAGE_HOST_OCAML
```

## package/ocaml-menhir/Config.in.host
```kconfig
config BR2_PACKAGE_HOST_OCAML_MENHIR
	bool "host ocaml-menhir"
	depends on BR2_PACKAGE_HOST_OCAML
	depends on BR2_PACKAGE_HOST_OCAML_DUNE
	help
	  Ocaml Language Menhir Package.

	  https://gitlab.inria.fr/fpottier/menhir

comment "ocaml-menhir needs ocaml and ocaml-dune"
	depends on  !BR2_PACKAGE_HOST_OCAML || !BR2_PACKAGE_HOST_OCAML_DUNE
```

## package/ocaml/Config.in.host
```kconfig
# All host ocaml packages should depend on this option
config BR2_PACKAGE_HOST_OCAML_ARCH_SUPPORTS
	bool
	default y if BR2_HOSTARCH = "x86_64" || BR2_HOSTARCH = "x86"

config BR2_PACKAGE_HOST_OCAML
	bool "host ocaml"
	depends on BR2_TOOLCHAIN_HAS_THREADS
	depends on !BR2_STATIC_LIBS
	depends on BR2_HOST_GCC_AT_LEAST_4_9
    depends on BR2_PACKAGE_HOST_OCAML_ARCH_SUPPORTS
	help
	  Ocaml Language.

	  https://www.ocaml.org/

comment "ocaml needs a toolchain w/ wchar, threads, dynamic library, gcc >= 4.9, host gcc >= 4.9"
	depends on  !BR2_TOOLCHAIN_HAS_THREADS || \
		BR2_STATIC_LIBS || 	!BR2_HOST_GCC_AT_LEAST_4_9
```

## package/openjdk-ci/Config.in
```kconfig
config BR2_PACKAGE_OPENJDK_CI
	bool "openjdk-ci"
	depends on BR2_PACKAGE_CSKY_CI
	depends on BR2_PACKAGE_OPENJDK
	help
		openjdk ci for jdk test

comment "openjdk ci needs openjdk"
	depends on !BR2_PACKAGE_OPENJDK
```

## package/opensbi-c910/Config.in
```kconfig
comment "opensbi needs a Linux kernel to be built"
	depends on BR2_riscv
	depends on !BR2_LINUX_KERNEL

config BR2_PACKAGE_OPENSBI_C910
	bool "opensbi-c910"
	depends on BR2_riscv
	depends on BR2_LINUX_KERNEL
	default y if BR2_riscv
	help
	  T-HEAD ISA c910 support, base on:

	  https://github.com/riscv/opensbi.git

config BR2_TARGET_OPENSBI_C910_PLAT
	string "OpenSBI Platform"
	default "thead/c910"
	depends on BR2_PACKAGE_OPENSBI_C910
	help
	  Specifies the OpenSBI platform to build. If no platform is
	  specified only the OpenSBI platform independent static
	  library libsbi.a is built. If a platform is specified then
	  the platform specific static library libplatsbi.a and firmware
	  examples are built.
```

## package/perf-ci/Config.in
```kconfig
config BR2_PACKAGE_PERF_CI
	default y if !BR2_ck610
	bool "perf-ci"
	depends on BR2_PACKAGE_CSKY_CI
```

## package/pts-ci/Config.in
```kconfig
config BR2_PACKAGE_PTS_CI
	bool "pts-ci"
	depends on BR2_PACKAGE_CSKY_CI
	select BR2_PACKAGE_ATOMICBENCH
	select BR2_PACKAGE_CIRCUSTENT
	select BR2_PACKAGE_LMBENCH
	select BR2_PACKAGE_RAMSMP
	select BR2_PACKAGE_RAMSPEED
	select BR2_PACKAGE_TINYMEMBENCH
```

## package/python-gpio/Config.in
```kconfig
config BR2_PACKAGE_PYTHON_GPIO
	bool "python-gpio"
	help
	  A Python module to control the GPIO.

	  https://pypi.python.org/pypi/gpio/0.2.0
```

## package/python3-ci/Config.in
```kconfig
config BR2_PACKAGE_PYTHON3_CI
	bool "openjdk-ci"
	depends on BR2_PACKAGE_CSKY_CI
	depends on BR2_PACKAGE_PYTHON3
	help
		python3 ci for python test

comment "python3 ci needs python3"
	depends on !BR2_PACKAGE_PYTHON3
```

## package/riscv-pk-c910/Config.in
```kconfig
comment "riscv-pk needs a Linux kernel to be built"
	depends on BR2_riscv
	depends on !BR2_LINUX_KERNEL

config BR2_PACKAGE_RISCV_PK_C910
	bool "riscv-pk-c910"
	depends on BR2_riscv
	depends on BR2_LINUX_KERNEL
	default y if BR2_riscv
	help
	  T-HEAD ISA c910 support, base on:

	  https://github.com/riscv/riscv-pk.git
```

## package/riscv-readme/Config.in
```kconfig
config BR2_PACKAGE_RISCV_README
	bool
	depends on BR2_riscv
	default y if BR2_riscv
```

## package/torture-ci/Config.in
```kconfig
config BR2_PACKAGE_TORTURE_CI
	bool "torture-test"
	depends on BR2_PACKAGE_CSKY_CI
```

## package/uclibc-ci/Config.in
```kconfig
#You should source this file in ../csky-ci/Config.in
config BR2_PACKAGE_UCLIBC_CI
	bool "uclibc-ci"
	depends on BR2_PACKAGE_CSKY_CI
	depends on BR2_TOOLCHAIN_BUILDROOT_UCLIBC
	select BR2_PACKAGE_UCLIBC_NG_TEST
```
