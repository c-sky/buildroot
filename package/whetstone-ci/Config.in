## package/whetstone-ci/Config.in
```kconfig
#You should source this file in ../csky-ci/Config.in
config BR2_PACKAGE_WHETSTONE_CI
	bool "whetstone-ci"
	depends on BR2_PACKAGE_CSKY_CI
	select BR2_PACKAGE_WHETSTONE
```

## package/zero-stage-boot/Config.in
```kconfig
config BR2_PACKAGE_ZERO_STAGE_BOOT
	bool "zero-stage-boot"
	depends on BR2_LINUX_KERNEL
	default y if BR2_riscv
```

## toolchain/toolchain-external/toolchain-external-csky/Config.in
```kconfig
config BR2_TOOLCHAIN_EXTERNAL_CSKY
	bool "C-SKY linux toolchain"
	depends on BR2_csky
	depends on BR2_HOSTARCH = "x86_64"
	select BR2_INSTALL_LIBSTDCPP
	select BR2_TOOLCHAIN_HEADERS_AT_LEAST_4_9
	select BR2_TOOLCHAIN_HAS_SSP
	select BR2_TOOLCHAIN_HAS_THREADS
	select BR2_TOOLCHAIN_HAS_THREADS_NPTL
	select BR2_USE_WCHAR
	help
	  Toolchain for the C-SKY cores, from
	  https://c-sky.github.io
```
